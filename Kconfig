## Kconfig
```kconfig
# Copyright (c) 2026 Yuzuki Tsuru
# SPDX-License-Identifier: Apache-2.0

config MGBA
	bool "mGBA Game Boy Advance emulator core"
	depends on RISCV
	select FILE_SYSTEM
	help
	  Build the Game Boy Advance core of mGBA (the git submodule mgba/)
	  as a library without threading, debugger, scripting or image
	  codecs. The mGBA software renderer draws RGB565 frames; the
	  built-in BIOS replacement is used, no BIOS file is needed.

if MGBA

config MGBA_RVV
	bool "Vector versions of hot loops (needs the V extension)"
	default y if SUN252I_F101_RVV
	help
	  The emulator library is built with the V extension; copies and
	  fills, and the background renderer use the vector unit.

config MGBA_MAX_ROM_SIZE_MB
	int "Largest ROM that is read into memory (MiB)"
	default 32
	range 1 32

endif # MGBA
```

## aic8800/Kconfig
```kconfig
# Copyright (c) 2026 Yuzuki Tsuru
# SPDX-License-Identifier: Apache-2.0

config AIC8800
	bool "AIC8800 WiFi driver"
	depends on RISCV
	select SD_STACK
	select SDIO_STACK
	select SDHC
	select GPIO
	select HWINFO
	select MINIMAL_LIBC_RAND if MINIMAL_LIBC
	select NETWORKING
	select NET_L2_ETHERNET
	select WIFI
	select WIFI_USE_NATIVE_NETWORKING
	select NET_L2_WIFI_MGMT
	select NET_IPV4
	select NET_UDP
	select NET_TCP
	select NET_SOCKETS
	select NET_DRIVERS
	select NET_LOOPBACK
	select NET_DHCPV4
	select NET_MGMT
	select NET_MGMT_EVENT
	help
	  FullMAC WiFi driver of the AIC8800 family on an SDIO bus: the
	  host side of the MAC (command queue, TX/RX descriptors), the
	  firmware download, a port of wpa_supplicant for the station
	  and access point modes, and the Zephyr network interface.

if AIC8800

module = AIC8800
module-str = AIC8800
source "subsys/logging/Kconfig.template.log_config"

choice AIC8800_CHIP
	prompt "AIC chip"
	default AIC8800D80

config AIC8800D
	bool "AIC8800D"

config AIC8800DW
	bool "AIC8800DW"

config AIC8800DC
	bool "AIC8800DC (AIC8800D40)"

config AIC8800D80
	bool "AIC8800D80"

endchoice

choice AIC8800_INTERFACE
	prompt "Chip interface"
	default AIC8800_INTF_SDIO

config AIC8800_INTF_SDIO
	bool "SDIO"

config AIC8800_INTF_USB
	bool "USB"
	depends on BROKEN
	help
	  The USB transport is not ported.

endchoice

config AIC8800_SDIO_DEV
	string "SDHC device of the chip"
	default "smhc2"
	help
	  Devicetree node label of the SD host controller the chip is
	  wired to.

# The control links between the driver tasks and the supplicant are TCP connections on the
# loopback interface (two connections per link, up to three links), on top of the sockets of the
# application.
config NET_MAX_CONN
	default 16

config NET_MAX_CONTEXTS
	default 24

# every control link socket is a file descriptor too, three per link while one is set up
config ZVFS_OPEN_MAX
	default 32

config AIC8800_WPA3
	bool "WPA3 (SAE)"
	depends on MBEDTLS
	select MBEDTLS_ECP_C
	select MBEDTLS_ECP_DP_SECP256R1_ENABLED
	help
	  Build the SAE handshake of the supplicant on top of mbedTLS.

config AIC8800_P2P
	bool "Wi-Fi Direct (P2P), WPS and Hotspot 2.0"
	default y

config AIC8800_WIFI_MODE_RFTEST
	bool "RF test firmware"
	default y

endif # AIC8800
```

## aic8800/dts/bindings/wifi/aicsemi,aic8800.yaml
```yaml
# Copyright (c) 2026 Yuzuki Tsuru
# SPDX-License-Identifier: Apache-2.0

description: |
  AIC8800 family WiFi chip on an SDIO bus. The node is a child of the SD host
  controller the chip is wired to, for example:

    &smhc2 {
        non-removable;
        aic8800 {
            compatible = "aicsemi,aic8800";
            reg-on-gpios = <&gpioa 0 GPIO_ACTIVE_HIGH>;
        };
    };

compatible: "aicsemi,aic8800"

include: base.yaml

properties:
  reg-on-gpios:
    type: phandle-array
    required: true
    description: |
      Power enable of the chip (REG_ON). The chip is powered down when the
      line is inactive and enumerates on the bus after it is raised.

  wakeup-gpios:
    type: phandle-array
    description: |
      Line the chip uses to wake the host (WAKEUP_AP). It is only configured
      as an input; the card interrupt travels on the SDIO data line.
```

## android-screen-mirror/Kconfig
```kconfig
# Copyright (c) 2026 Yuzuki Tsuru
# SPDX-License-Identifier: Apache-2.0

config MIRROR
	bool "Android screen mirror client"
	depends on NETWORKING && NET_TCP && FILE_SYSTEM
	select PSA_CRYPTO
	select MBEDTLS
	select MBEDTLS_DECLARE_PRIVATE_IDENTIFIERS
	select PSA_WANT_KEY_TYPE_RSA_KEY_PAIR_GENERATE
	select PSA_WANT_KEY_TYPE_RSA_KEY_PAIR_IMPORT
	select PSA_WANT_KEY_TYPE_RSA_KEY_PAIR_EXPORT
	select PSA_WANT_KEY_TYPE_RSA_PUBLIC_KEY
	select PSA_WANT_ALG_RSA_PKCS1V15_SIGN
	select PSA_WANT_ALG_RSA_PSS
	select PSA_WANT_ALG_RSA_OAEP
	select PSA_WANT_ALG_SHA_1
	select MBEDTLS_PK_PARSE_C
	select MBEDTLS_PK_WRITE_C
	select MBEDTLS_BASE64_C
	select MBEDTLS_PEM_PARSE_C
	select MBEDTLS_PEM_WRITE_C
	select MBEDTLS_X509_CRT_WRITE_C
	select MBEDTLS_X509_CRT_PARSE_C
	select MBEDTLS_X509_RSASSA_PSS_SUPPORT
	select RING_BUFFER_LARGE
	select PSA_WANT_ALG_HKDF
	select PSA_WANT_ALG_SHA_256
	select PSA_WANT_ALG_SHA_512
	select PSA_WANT_ALG_GCM
	select PSA_WANT_KEY_TYPE_AES
	select MBEDTLS_SSL_KEYING_MATERIAL_EXPORT
	help
	  An ADB client over TCP and a client of the scrcpy server: starts the
	  server on the phone and delivers its H.264 stream and a control
	  channel for touch and key events.

if MIRROR

config MIRROR_ADB_MAX_PAYLOAD
	int "Largest ADB payload the client accepts (bytes)"
	default 65536
	range 4096 262144

config MIRROR_ADB_RX_BUFFER
	int "Receive buffer of a data stream (bytes)"
	default 262144
	help
	  The video stream is buffered here while the decoder works; when it is
	  full the TCP window closes.

config MIRROR_ADB_TRACE
	int "Print every received ADB packet header (0 or 1)"
	default 0
	range 0 1

endif # MIRROR
```

## bochs/Kconfig
```kconfig
# Copyright (c) 2026 Yuzuki Tsuru
# SPDX-License-Identifier: Apache-2.0

config BOCHS
	bool "Bochs x86 PC emulator (386/486 class, no FPU)"
	depends on RISCV && CPP
	select FILE_SYSTEM
	help
	  Build the Bochs emulator (git submodule bochs/Bochs, LGPL-2.1+) as a
	  library: the 486 level CPU without FPU, the ISA PC devices (PIC,
	  PIT, DMA, CMOS, keyboard controller, floppy, IDE disk, serial, VGA),
	  no GUI, no plugins, no networking. Disk images and the BIOS are read
	  through the Zephyr file system.

if BOCHS

config BOCHS_ICACHE_ENTRIES
	int "Decoded instruction cache entries (32 bytes each, power of 2)"
	default 4096
	help
	  The stock value is 512K entries (16 MiB); the board has 16 MB of
	  RAM in total. Only the single stepping loop uses this cache.

config BOCHS_PAGE_STAMP_ENTRIES
	int "Self-modifying code stamps (4 bytes each, power of 2)"
	default 16384
	help
	  One stamp per 4 KiB page of the physical space; the stock table covers
	  the whole 4 GiB (1M entries, 4 MiB allocated at start). Pages share a
	  stamp when the table is smaller, which only causes extra flushes of
	  the decoded instruction cache. 16384 entries cover 64 MiB.

config BOCHS_TRACE_ENTRIES
	int "Trace cache entries (24 bytes each, power of 2)"
	default 4096
	help
	  The stock value is 64K entries.

config BOCHS_TRACE_POOL
	int "Trace cache pool, decoded instructions"
	default 8192
	help
	  The stock value is 576K instructions (tens of MiB), a trace takes up
	  to 33.

config BOCHS_TEXT_MIRROR
	bool "Print the guest text screen on the serial console"
	help
	  Prints the changed rows of the text screen as "|row|text" lines. In a
	  graphics mode (Windows) the lines are noise, so it is off by default.

config BOCHS_SELFTEST
	bool "Run self tests of the C library, floating point and softfloat before the emulator"
	help
	  Prints "memtest:", "fp:" and "softfloat:" lines with the result.

config BOCHS_DIGEST
	bool "Print a digest of the guest registers every virtual second"
	help
	  A timer prints DG lines (virtual ticks, eip, cs, general registers, flags)
	  every virtual second, to compare a run with another build of Bochs
	  (see patches/0004-digest.patch).

config BOCHS_DIGEST_PERIOD
	int "Digest period in virtual microseconds"
	depends on BOCHS_DIGEST
	default 1000000
	help
	  With IPS = 3000000 one virtual microsecond is 3 ticks.

config BOCHS_DIGEST_CODE
	bool "Print the code bytes at eip with each digest (and a buffer compare)"
	depends on BOCHS_DIGEST

config BOCHS_DIGEST_FROM
	int "Digest window start (virtual ticks)"
	depends on BOCHS_DIGEST
	default 0

config BOCHS_DIGEST_TO
	int "Digest window end (virtual ticks, 0: no window)"
	depends on BOCHS_DIGEST
	default 0

config BOCHS_HEARTBEAT
	bool "Print the guest instruction pointer once a second"
	help
	  A thread reports the guest EIP and the virtual time, to see whether
	  the guest runs.

endif
```

## dlna/Kconfig
```kconfig
# SPDX-License-Identifier: Apache-2.0

menuconfig DLNA
	bool "DLNA / UPnP media renderer"
	depends on NETWORKING && NET_IPV4 && NET_UDP && NET_TCP
	select NET_SOCKETS
	select NET_IPV4_IGMP
	help
	  A UPnP AV MediaRenderer:1 (the "cast to this device" target of phones and PCs): SSDP
	  announcement and search answers, the device description, the AVTransport, RenderingControl and
	  ConnectionManager services over SOAP, and event notices for the transport state. What is played
	  is up to the application, which gives a table of callbacks to dlna_start().

if DLNA

config DLNA_HTTP_PORT
	int "TCP port of the description and control server"
	default 49152
	range 1024 65535

config DLNA_MAX_REQUEST
	int "Largest control request in bytes (the media metadata of a controller can be several KiB)"
	default 12288
	range 2048 65536

config DLNA_MAX_SUBSCRIBERS
	int "Event subscribers"
	default 4
	range 1 8

config DLNA_STACK_SIZE
	int "Stack of the SSDP and the HTTP threads in bytes"
	default 6144

config DLNA_THREAD_PRIORITY
	int "Priority of the SSDP and the HTTP threads"
	default 9

config DLNA_ANNOUNCE_INTERVAL_S
	int "Seconds between the alive notices (the advertised lifetime is twice this)"
	default 600
	range 30 1800

endif # DLNA
```

## doom/Kconfig
```kconfig
# Copyright (c) 2026 Yuzuki Tsuru
# SPDX-License-Identifier: Apache-2.0

config DOOM
	bool "Doom (doomgeneric engine)"
	depends on RISCV
	select FILE_SYSTEM
	help
	  Build the doomgeneric port of the Doom engine (doom/doomgeneric,
	  GPL-2.0) as a library. The WAD, the config and the saved games are
	  read through the Zephyr file system; the picture is 320x200 RGB565.
	  The game data is not part of the module: put doom1.wad (or the
	  Freedoom WADs) on the card.

if DOOM

config DOOM_ZONE_SIZE_MB
	int "Memory of the zone allocator (MiB)"
	default 6
	range 4 32
	help
	  Doom allocates this once from the malloc arena.

config DOOM_SOUND
	bool "Sound effects"
	default y
	depends on I2S && AUDIO_CODEC
	help
	  Mix the effects of the game (the music is not played) and play
	  them through doom_audio_read(), which the application sends to the
	  codec.

endif # DOOM
```

## gbsp/Kconfig
```kconfig
# Copyright (c) 2026 Yuzuki Tsuru
# SPDX-License-Identifier: GPL-2.0-or-later

config GBSP
	bool "gpSP Game Boy Advance emulator core with a RISC-V dynamic recompiler"
	depends on RISCV
	select FILE_SYSTEM
	help
	  Build the gpSP core (core/) as a library. It translates the ARM code
	  of the game to RISC-V when CONFIG_GBSP_DYNAREC is on, and interprets it
	  otherwise. The built-in open source BIOS is used, no BIOS file is
	  needed. The interface is the one of the mGBA module (gbsp_zephyr/gbsp.h, the functions are called gbsp_*).

if GBSP

config GBSP_DYNAREC
	bool "Dynamic recompiler (translates the ARM code to RISC-V)"
	default y
	help
	  Without it the core interprets the game code, which is much slower.
	  The translated code is kept in two caches that are allocated when a
	  game starts.

config GBSP_ROM_CACHE_KB
	int "Translation cache for the ROM code (KiB)"
	depends on GBSP_DYNAREC
	default 2048
	help
	  When it is full all of it is emptied and the code is translated again. A scene whose
	  code does not fit translates about a thousand blocks per frame, which is more than ten
	  times the normal cost of a frame (Kirby has such a scene with 1 MiB, none with 2 MiB).

config GBSP_ROM_PREFETCH
	bool "Read the ROM ahead in a background thread (large ROMs only)"
	select FS_FATFS_REENTRANT
	help
	  Measured on Kirby (16 MiB ROM, 5 MiB resident): few of the page misses are sequential,
	  so few hit the staging buffer, and the speculative reads compete with the demanded ones
	  for the card: the worst frame went from 50 ms to 119 ms. Off by default.

config GBSP_ROM_READAHEAD
	int "Pages of the ROM read with one card access, and fetched ahead"
	default 4
	range 1 8
	help
	  A page of a ROM that does not fit in memory is read from the card when the game needs
	  it (32 KiB, about 2 ms). On a miss this many consecutive pages are read at once, and the
	  same number after them by a background thread, so that the next misses find their page
	  in a staging buffer.

config GBSP_ROM_STAGE_PAGES
	int "Staging buffers of the read-ahead (32 KiB each, from the malloc arena while a game runs)"
	default 8
	range 4 32

config GBSP_ROM_PREFETCH_PRIORITY
	int "Priority of the read-ahead thread (lower is more urgent)"
	default 11
	help
	  Below the emulation and the user interface: it reads while they wait.

config GBSP_RAM_CACHE_KB
	int "Translation cache for the code that runs from RAM (KiB)"
	depends on GBSP_DYNAREC
	default 256

config GBSP_RVV
	bool "Vector version of the tile renderer (needs the V extension)"
	default y if SUN252I_F101_RVV
	help
	  The rows of 4 bit tiles that are drawn as colour indices are expanded on the vector unit.
	  The application must switch CONFIG_SUN252I_F101_RVV on (vector registers are saved on a
	  context switch).

config GBSP_OPT_LEVEL
	string "Optimisation level of the core (-O3, -O2, -Os)"
	default "-O3"

config GBSP_MAX_ROM_SIZE_MB
	int "Largest ROM (MiB)"
	default 32
	range 1 32
	help
	  Blocks of the ROM are kept in memory as far as the memory goes; the
	  rest is read from the file when the game needs it.

config GBSP_ROM_BUFFER_MB
	int "Memory for the ROM (MiB)"
	default 6
	range 1 32
	help
	  The ROM is kept in memory as far as this goes; the pages of a larger ROM are read from
	  the file when the game needs them.

endif # GBSP
```

## ios-screen-mirror/Kconfig
```kconfig
# Copyright (c) 2026 Yuzuki Tsuru
# SPDX-License-Identifier: Apache-2.0

config IOS_MIRROR
	bool "iOS screen mirror (AirPlay receiver)"
	depends on NETWORKING && NET_TCP && NET_UDP
	select MDNS_RESPONDER
	select DNS_SD
	select NET_HOSTNAME_ENABLE
	select DNS_RESOLVER
	select MBEDTLS
	select MBEDTLS_SHA512
	select MBEDTLS_CIPHER_AES_ENABLED
	select MBEDTLS_CIPHER_MODE_CTR_ENABLED
	select MBEDTLS_CIPHER_MODE_CBC_ENABLED
	help
	  An AirPlay screen mirroring receiver. The iPhone finds the board
	  in the Screen Mirroring list of the control center and sends its
	  screen as an H.264 stream, which the application decodes and shows.
	  The protocol library is RPiPlay (GPL-3.0, git submodule) with its
	  FairPlay handshake; this module is therefore GPL-3.0 as a whole.

if IOS_MIRROR

config IOS_MIRROR_NAME
	string "Name shown in the Screen Mirroring list"
	default "F101 Mirror"

config IOS_MIRROR_PORT
	int "TCP port of the AirPlay server (0: any free port)"
	default 7000
	range 0 65535

config IOS_MIRROR_WIDTH
	int "Display width announced to the phone (pixels)"
	default 1920
	help
	  The phone picks the size of its stream from this one; the largest portrait stream the
	  decoder has the memory for is about 450x970, a landscape one of 1920x1080 is refused.

config IOS_MIRROR_HEIGHT
	int "Display height announced to the phone (pixels)"
	default 1080

config IOS_MIRROR_THREAD_STACK
	int "Stack of the threads of the AirPlay library (bytes)"
	default 32768

config IOS_MIRROR_THREAD_PRIORITY
	int "Priority of the threads of the AirPlay library"
	default 8

endif # IOS_MIRROR
```
