## litehtml/Kconfig
```kconfig
# Copyright (c) 2026 Yuzuki Tsuru
# SPDX-License-Identifier: Apache-2.0

config LITEHTML
	bool "litehtml HTML/CSS renderer"
	depends on CPP && RISCV
	help
	  Build litehtml (the litehtml submodule) as a separate static library
	  with the C++ standard library of the toolchain, and link it into the
	  image. The library draws a page into an RGB565 buffer with a bitmap
	  font, see include/litehtml_zephyr/lh.h.

config LITEHTML_PAGED_HEAP
	bool "Heap for the pages in demand paged memory"
	depends on LITEHTML && DEMAND_PAGING && BACKING_STORE_SWAP && FILE_SYSTEM
	help
	  malloc() and friends can be served from a region that is bigger than
	  the RAM and swapped to a file of the SD card, see
	  include/litehtml_zephyr/lh_paged.h. malloc(), calloc(), realloc(),
	  aligned_alloc() and free() of the image are wrapped at link time.
```

## mgba/Kconfig
```kconfig
# Copyright (c) 2026 Yuzuki Tsuru
# SPDX-License-Identifier: Apache-2.0

config MGBA
	bool "mGBA Game Boy Advance emulator core"
	depends on RISCV
	select FILE_SYSTEM
	help
	  Build the Game Boy Advance core of mGBA (the git submodule mgba/)
	  as a library without threading, debugger, scripting or image
	  codecs. The mGBA software renderer draws RGB565 frames; the
	  built-in BIOS replacement is used, no BIOS file is needed.

if MGBA

config MGBA_RVV
	bool "Vector versions of hot loops (needs the V extension)"
	default y if SUN252I_F101_RVV
	help
	  The emulator library is built with the V extension; copies and
	  fills, and the background renderer use the vector unit.

config MGBA_ROM_DEMAND_PAGED
	bool "Map the ROM as a demand paged file"
	depends on DEMAND_PAGING && BACKING_STORE_FS
	help
	  Instead of reading the whole ROM into memory it is mapped from
	  the file system and the pages come in when the emulation touches
	  them, so a 16 MiB ROM needs only the page frames that are left.
	  Needs the MMU of the kernel and enough page frames: the memory
	  that is not malloc arena or image.

config MGBA_MAX_ROM_SIZE_MB
	int "Largest ROM that is read into memory (MiB)"
	default 32
	range 1 32
	help
	  With MGBA_ROM_DEMAND_PAGED the limit is the address space of the
	  cartridge, 32 MiB.

endif # MGBA
```

## micropython/Kconfig
```kconfig
# Copyright (c) 2026 Yuzuki Tsuru
# SPDX-License-Identifier: Apache-2.0

# The options of the port itself are the MICROPY_* ones of
# micropython/ports/zephyr/Kconfig.

config F101_MICROPY_SCREEN_CONSOLE
	bool "Show the console output on the LCD"
	default y
	depends on DISPLAY
	select CHARACTER_FRAMEBUFFER
	help
	  Everything MicroPython prints is also drawn into a character grid on the
	  frame buffer plane. The UART stays the keyboard.
```

## miracast/Kconfig
```kconfig
# SPDX-License-Identifier: Apache-2.0

menuconfig MIRACAST
	bool "Miracast Wi-Fi Display sink"
	depends on NETWORKING && NET_IPV4 && NET_UDP && NET_TCP
	select NET_SOCKETS
	help
	  A Wi-Fi Display sink with RTSP capability negotiation and RTP/MPEG-TS
	  demultiplexing. The application supplies an IP link to the source and
	  consumes H.264 Annex B and LPCM (or optional AAC) payloads. Protected
	  content, UIBC, and interleaved TCP media are not supported.

if MIRACAST

config MIRACAST_PLAYER
	bool "H.264 and LPCM player on the Sunxi display and audio devices"
	depends on DISPLAY_SUNXI && VDEC && I2S && AUDIO_CODEC
	help
	  Decode received video and audio on separate threads with bounded queues.
	  Applications control the player from their UI or application thread and
	  supply its media callback to the receiver. The device tree must provide
	  the ve, audio_codec and codec_analog nodes and a chosen display.

config MIRACAST_STACK_SIZE
	int "Network receiver stack size"
	default 8192
	range 4096 32768

config MIRACAST_THREAD_PRIORITY
	int "Network receiver priority"
	default 7

config MIRACAST_TIMEOUT_MS
	int "RTSP request and inactivity timeout in milliseconds"
	default 30000
	range 5000 120000

endif
```

## mp5-player/src/debug/Kconfig
```kconfig
menu "Debugging"

config MP5_DEBUG
	bool "Numbers about the user interface and the self tests"
	default y
	help
	  The frame rate of a swiped list and the time a screen takes to its first picture are
	  printed when they happen.

config MP5_SELFTEST
	bool "Play the default video and seek, pause and change the volume by itself"
	depends on MP5_DEBUG && MP5_FEATURE_VIDEO
	help
	  For a check without touching the screen: the steps and the positions are printed.

config MP5_THEME_TEST
	bool "Switch the settings by itself and print the result (ends with PASS or FAIL)"
	depends on MP5_DEBUG && MP5_FEATURE_SETTINGS
	help
	  Theme, brightness, saved passwords, a Wi-Fi scan and joining the saved network, and
	  starting and leaving a game, for the features that are built.

endmenu
```

## mp5-player/src/features/games/Kconfig
```kconfig
menu "Games"

config MP5_FEATURE_GAMES
	bool "NES, Game Boy, Game Boy Color and Game Boy Advance"
	default y
	depends on MP5_FEATURE_FILES
	select MGBA
	select NES
	select CRC
	select RING_BUFFER
	select STATIC_INIT_GNU
	select I2S
	select AUDIO
	select AUDIO_CODEC
	select DMA

config MP5_GAMES_HOT_RAM
	bool "Run the Game Boy Advance core from RAM"
	default y
	depends on XIP && MP5_FEATURE_GAMES
	select CODE_DATA_RELOCATION
	help
	  In an XIP image every instruction that is not in the cache comes from the flash window.
	  The interpreter is a big loop that does not fit the cache, so the files that run for every
	  frame (about 270 KiB of text) are copied to RAM at boot. The memory comes out of the page
	  frames of the paged ROM.

config MP5_GAME
	string "Game to start at boot, for a check without touching (empty: none)"
	default ""
	depends on MP5_FEATURE_GAMES

config MP5_GAMES_PAGED_ROM
	bool "Game Boy Advance ROMs of up to 32 MiB (MMU, the ROM is paged in from the card)"
	default y
	depends on MP5_FEATURE_GAMES
	select SUN252I_F101_MMU
	select DEMAND_PAGING
	select DEMAND_PAGING_ALLOW_IRQ
	select MGBA_ROM_DEMAND_PAGED
	help
	  The ROM is not read into the memory but mapped from its file, the pages come in when the
	  game touches them. Without it a ROM is read as a whole and the limit is 6 MiB, because
	  the video player needs the rest of the memory for its pictures. The data accesses are
	  translated by the MMU (a few percent of the speed of the emulator) and the memory that is
	  not the image or the malloc arena (a fixed size then) is the page frames of the ROM.

choice BACKING_STORE_CHOICE
	default BACKING_STORE_FS if MP5_GAMES_PAGED_ROM
endchoice

choice EVICTION_CHOICE
	default EVICTION_LRU if MP5_GAMES_PAGED_ROM
endchoice

config MGBA_MAX_ROM_SIZE_MB
	# without paging a bigger game is refused: the video player needs the memory for its pictures
	default 32 if MP5_GAMES_PAGED_ROM
	default 6 if MP5_FEATURE_GAMES

endmenu
```

## mp5-player/src/features/net/Kconfig
```kconfig
menu "Network"

config MP5_FEATURE_NET
	bool "Wi-Fi and the time from the network"
	default y
	select AIC8800
	select NETWORKING
	select NET_IPV4
	select NET_UDP
	select NET_TCP
	select NET_DHCPV4
	select NET_MGMT
	select NET_MGMT_EVENT
	select NET_MGMT_EVENT_INFO
	select NET_L2_ETHERNET
	select WIFI
	select NET_L2_WIFI_MGMT
	select NET_SOCKETS
	select DNS_RESOLVER
	select SNTP
	select TEST_RANDOM_GENERATOR

config MP5_FEATURE_BT
	bool "Bluetooth connection shown in the settings"
	default y
	depends on MP5_FEATURE_NET
	select BT
	select BT_PERIPHERAL
	select AIC8800_BT

config MP5_UTC_OFFSET_MIN
	int "Offset of the local time from UTC in minutes (the clock shows local time)"
	default 480
	range -720 840
	depends on MP5_FEATURE_NET

config MP5_NTP_SERVER
	string "Time server"
	default "ntp.aliyun.com"
	depends on MP5_FEATURE_NET

# tuning of the Zephyr options of the features: stacks that were used up to the last byte
config SYSTEM_WORKQUEUE_STACK_SIZE
	default 4096 if MP5_FEATURE_NET
config NET_MGMT_EVENT_STACK_SIZE
	default 3072 if MP5_FEATURE_NET
config NET_RX_STACK_SIZE
	default 3072 if MP5_FEATURE_NET
config NET_TX_STACK_SIZE
	default 2048 if MP5_FEATURE_NET
config NET_TCP_WORKQ_STACK_SIZE
	default 3072 if MP5_FEATURE_NET
config NET_SOCKETS_SERVICE_STACK_SIZE
	default 3072 if MP5_FEATURE_NET
config BT_RX_STACK_SIZE
	default 2048 if MP5_FEATURE_BT
config BT_LONG_WQ_STACK_SIZE
	default 3072 if MP5_FEATURE_BT
config BT_MAX_CONN
	default 1 if MP5_FEATURE_BT
config BT_DEVICE_NAME
	default "MP5 Player" if MP5_FEATURE_BT

endmenu
```

## mp5-player/src/features/photos/Kconfig
```kconfig
config MP5_FEATURE_PHOTOS
	bool "Photo viewer (JPEG and PNG, pinch zoom)"
	default y
	depends on MP5_FEATURE_FILES
	select VDEC
```

## mp5-player/src/features/usbdisplay/Kconfig
```kconfig
config MP5_FEATURE_USB_DISPLAY
	bool "USB second screen with touch"
	default y
	select VDEC
	select CHERRYUSB
	select CHERRYUSB_DEVICE
	select CHERRYUSB_DEVICE_DISPLAY
	select CHERRYUSB_DEVICE_HID

choice CHERRYUSB_DEVICE_SPEED
	default CHERRYUSB_DEVICE_SPEED_HS if MP5_FEATURE_USB_DISPLAY
endchoice

choice CHERRYUSB_DEVICE_IP
	default CHERRYUSB_DEVICE_MUSB_SUNXI if MP5_FEATURE_USB_DISPLAY
endchoice
```

## mp5-player/src/gfx/Kconfig
```kconfig
menu "Drawing accelerators"

config MP5_GFX_RVV
	bool "Vector blends for the software renderer of LVGL"
	default y
	select SUN252I_F101_RVV
	help
	  Checked against the C code of LVGL at boot; the vector code is switched off when it
	  differs.

config MP5_GFX_G2D
	bool "Fill large plain rectangles of the user interface with the 2D accelerator"
	depends on G2D
	help
	  Measured on the board and left off: the fills run one after the other with the
	  processor waiting, the same memory bus is used, and ten full redraws of the home
	  screen take 1281 ms instead of 810 ms. A decode error of the video engine was seen once
	  while it was on.

config MP5_GFX_G2D_MIN_PIXELS
	int "Smallest rectangle in pixels that the accelerator fills"
	default 20000
	depends on MP5_GFX_G2D

endmenu
```

## ncnn/Kconfig
```kconfig
# Copyright (c) 2026 Yuzuki Tsuru
# SPDX-License-Identifier: Apache-2.0

config NCNN
	bool "ncnn neural network inference framework"
	depends on CPP && RISCV
	help
	  Build ncnn (the ncnn submodule) as a separate static library with its
	  own STL and math emulation, on top of the minimal C library. The
	  library is compiled with the architecture options of the image, so
	  with the V extension (RISCV_ISA_EXT_V) the vector kernels of ncnn
	  are used.

if NCNN

config NCNN_BENCHMARK
	bool "ncnn benchmark (benchncnn)"
	default y
	help
	  Build the benchncnn program as ncnn_bench_main(argc, argv), with the
	  network descriptions built in and random weights.

config NCNN_BENCHMARK_MODELS
	string "Networks to run"
	depends on NCNN_BENCHMARK
	help
	  Comma separated names of the networks benchncnn runs, empty: all of
	  them. The int8 networks are never run, ncnn is built without int8.
	  The networks run from the smallest to the biggest. One during which
	  an allocation fails is not reported.

config NCNN_BENCHMARK_MAX_WEIGHTS_MB
	int "Biggest network to try (MB of fp32 weights)"
	depends on NCNN_BENCHMARK
	default 5
	help
	  Networks with more weights than this are not run at all (0: no
	  limit). The weights are in RAM and the layers make a second copy of
	  them while they are set up, with 13 MB of heap on a 16 MB board only
	  the small networks fit. ncnn does not check the allocation of the
	  weights and crashes when they do not fit, so the big networks (some
	  have hundreds of MB of weights) must not be tried.

endif # NCNN
```

## nekobox/src/core/Kconfig
```kconfig
config MP5_CPU_MHZ
	int "CPU clock in MHz, 0 keeps what the boot stub set up (600)"
	default 960
	help
	  The CPU PLL is raised in steps of 72 MHz and the memory is checked after each step. The
	  voltage is not changed.
```

## nekobox/src/debug/Kconfig
```kconfig
menu "Debugging"

config NEKOBOX_DEBUG
	bool "Numbers about the user interface and the self tests"
	default y
	help
	  The frame rate of a swiped list and the time a screen takes to its first picture are
	  printed when they happen.

config NEKOBOX_SELFTEST
	bool "Play the default video and seek, pause and change the volume by itself"
	depends on NEKOBOX_DEBUG && NEKOBOX_FEATURE_VIDEO
	help
	  For a check without touching the screen: the steps and the positions are printed.

config NEKOBOX_THEME_TEST
	bool "Switch the settings by itself and print the result (ends with PASS or FAIL)"
	depends on NEKOBOX_DEBUG && NEKOBOX_FEATURE_SETTINGS
	help
	  Theme, brightness, saved passwords, a Wi-Fi scan and joining the saved network, and
	  starting and leaving a game, for the features that are built.

config NEKOBOX_SOAK
	bool "Play every video and game on the card, twice, and print the free memory after each"
	depends on NEKOBOX_DEBUG
	help
	  Finds memory that is not given back: the largest block and the free memory in total
	  of the malloc arena are printed before the first file and after every one. Ends with PASS
	  or FAIL.

config NEKOBOX_RADIO_TEST
	bool "Start the Wi-Fi chip, scan and stop it again several times, and print the free memory"
	depends on NEKOBOX_DEBUG && NEKOBOX_FEATURE_NET
	help
	  Checks that the driver can be shut down completely and started again: after every stop the
	  memory of the driver must be back in the arena. Ends with PASS or FAIL.

config NEKOBOX_PROFILE
	bool "Sample where the game thread spends its time and print the busiest code blocks"
	depends on NEKOBOX_DEBUG && NEKOBOX_FEATURE_GAMES
	help
	  20 seconds after a game starts, 6000 samples of the program counter are taken (one a
	  millisecond) and the busiest 64 byte blocks are printed as "prof <address> <count>".

endmenu
```

## nekobox/src/features/calculator/Kconfig
```kconfig
config NEKOBOX_FEATURE_CALCULATOR
	bool "Calculator"
	default y
	help
	  The Calculator tile on the home screen, a four function pocket calculator.
```

## nekobox/src/features/dlna/Kconfig
```kconfig
menu "DLNA cast target"

config NEKOBOX_FEATURE_DLNA
	bool "DLNA media renderer (cast videos from a phone or PC)"
	default y
	depends on NEKOBOX_FEATURE_NET && NEKOBOX_FEATURE_VIDEO && NEKOBOX_FEATURE_SETTINGS
	select DLNA
	help
	  The player shows up as a media renderer in the cast menu of phones and PCs. A cast video is
	  fetched over HTTP into the card and played as it arrives, once its MP4 header and initial
	  buffer are available. Off by default at run time: start it from the DLNA home tile or the
	  settings switch. Wi-Fi stays on while the receiver is enabled.

config NEKOBOX_DLNA_BUFFER_KB
	int "Initial download buffer (KiB)"
	default 512
	range 64 4096
	depends on NEKOBOX_FEATURE_DLNA
	help
	  Start playback after this many bytes have been synced to the card and the MP4 movie box
	  is complete. Smaller files start once the download finishes.

config NEKOBOX_DLNA_NAME
	string "Name shown in the cast menu"
	default "NekoBox"
	depends on NEKOBOX_FEATURE_DLNA

config NEKOBOX_DLNA_MAX_WIDTH
	int "Maximum cast video width"
	default 640
	range 16 4096
	depends on NEKOBOX_FEATURE_DLNA
	help
	  Bound decoded video dimensions before starting the decoder. Portrait videos may use
	  the rotated dimensions. Senders still choose the stream; oversized videos are refused.

config NEKOBOX_DLNA_MAX_HEIGHT
	int "Maximum cast video height"
	default 360
	range 16 4096
	depends on NEKOBOX_FEATURE_DLNA

config NEKOBOX_DLNA_DIR
	string "Directory on the card for the fetched videos (emptied at every start)"
	default "/SD:/dlna"
	depends on NEKOBOX_FEATURE_DLNA

# Wi-Fi control links coexist with the renderer, callbacks and recently closed TCP connections.
config NET_MAX_CONN
	default 64 if NEKOBOX_FEATURE_DLNA

config NET_MAX_CONTEXTS
	default 48 if NEKOBOX_FEATURE_DLNA

config ZVFS_OPEN_MAX
	default 64 if NEKOBOX_FEATURE_DLNA

endmenu
```

## nekobox/src/features/files/Kconfig
```kconfig
config NEKOBOX_FEATURE_FILES
	bool "File browser"
	default y
	help
	  The Files tile and the list of the SD card. Videos, photos and games open from it.
```
