## CMakeLists.txt
```
# SPDX-License-Identifier: Apache-2.0
cmake_minimum_required(VERSION 3.20.0)
list(APPEND ZEPHYR_EXTRA_MODULES ${CMAKE_CURRENT_LIST_DIR}/../..)
find_package(Zephyr REQUIRED HINTS $ENV{ZEPHYR_BASE})
project(bochs_pc)
target_sources(app PRIVATE src/main.c)
```

## Kconfig
```
# SPDX-License-Identifier: Apache-2.0

mainmenu "Bochs PC"

config SAMPLE_PC_DISK
	string "Hard disk image (flat file) on the SD card, empty for no disk"
	default ""

config SAMPLE_PC_DISK_CYLINDERS
	int "Disk geometry: cylinders"
	default 914

config SAMPLE_PC_DISK_HEADS
	int "Disk geometry: heads"
	default 16

config SAMPLE_PC_DISK_SPT
	int "Disk geometry: sectors per track"
	default 63

config SAMPLE_PC_PATCH_AUTOEXEC
	bool "Disable the SmartDrive and VBMOUSE lines of AUTOEXEC.BAT in the image"
	help
	  The 450 MB image of the v86 demo loads C:\\VBADOS\\VBMOUSE.EXE (a
	  VirtualBox mouse driver) from AUTOEXEC.BAT, which stops with
	  "Error in EXE file" here, and SmartDrive takes memory the guest does
	  not have. Both lines are turned into remarks, in place and with the
	  same length, at the file offset of that image (63808512).

config SAMPLE_PC_IPS
	int "Instructions per virtual second"
	default 3000000
	help
	  The guest's clock (timer ticks, the countdown of the Windows 95 boot
	  menu, delay loops that wait for the PIT) runs at this many
	  instructions per second. The board executes about 3 million
	  guest instructions per second, so with the default of 50 million a
	  30 second countdown would take half an hour.

config SAMPLE_PC_VERIFY
	bool "Print the crc32 of the whole disk image at start"
	help
	  Reads the image once (about 15 s for 128 MB) and prints "crc32 <file> <value>",
	  to compare with the crc32 of the original file.

config SAMPLE_PC_MEGS
	int "Guest memory in MiB"
	default 10

config SAMPLE_PC_TEST_PATTERN
	bool "Show a test pattern instead of starting the emulator"
	help
	  Puts a 720x400 RGB565 test picture on the video plane the way the
	  emulator does, to check the display path on its own.

source "Kconfig.zephyr"
```

## prj.conf
```kconfig
CONFIG_CPP=y
CONFIG_STD_CPP17=y
CONFIG_BOCHS=y
CONFIG_PRINTK=y
CONFIG_LOG=y
CONFIG_LOG_PRINTK=n
CONFIG_SHELL=n
CONFIG_DEVMEM_SHELL=n
CONFIG_MAIN_STACK_SIZE=65536
CONFIG_COMMON_LIBC_MALLOC_ARENA_SIZE=-1
CONFIG_HEAP_MEM_POOL_SIZE=131072

CONFIG_SDHC=y
CONFIG_DISK_ACCESS=y
CONFIG_DISK_DRIVER_SDMMC=y
CONFIG_FILE_SYSTEM=y
CONFIG_FAT_FILESYSTEM_ELM=y
CONFIG_FS_FATFS_EXFAT=y
CONFIG_FS_FATFS_LFN=y
CONFIG_FS_FATFS_LFN_MODE_STACK=y

CONFIG_DISPLAY=y
CONFIG_G2D=n
CONFIG_USB_PHY_SUNXI=n
CONFIG_ADC=n
CONFIG_SPI=n
CONFIG_I2C=n
CONFIG_MIPI_DBI=n
CONFIG_WDT_SUNXI=n
CONFIG_DISPLAY_SUNXI_FB_DIV=1

# Windows 95 disk image on the SD card (Bochs images, geometry 507/16/63).
# For Windows 3.1 use /SD:/Win31.img with 260 cylinders.
CONFIG_SAMPLE_PC_DISK="/SD:/windows95b.img"
CONFIG_SAMPLE_PC_DISK_CYLINDERS=507
CONFIG_SAMPLE_PC_DISK_HEADS=16
CONFIG_SAMPLE_PC_DISK_SPT=63

# The guest text screen (BIOS, boot messages) goes to the serial console as "|row|text"
# lines; in a graphics mode these lines are noise.
CONFIG_BOCHS_TEXT_MIRROR=y
```

## src/main.c
```c
/*
 * Copyright (c) 2026 Yuzuki Tsuru
 * SPDX-License-Identifier: Apache-2.0
 */

#include <stdio.h>
#include <string.h>
#include <ff.h>
#include <zephyr/fs/fs.h>
#include <stdlib.h>
#include <zephyr/cache.h>
#include <zephyr/device.h>
#include <zephyr/drivers/display/display_sunxi.h>
#include <zephyr/kernel.h>

int bochs_run(int argc, char *argv[]);
void bx_mem_file(const char *name, const char *data, size_t len);

static FATFS fat_fs;
static struct fs_mount_t mp = {
	.type = FS_FATFS,
	.fs_data = &fat_fs,
	.mnt_point = "/SD:",
};

static char rc[1024];

#ifdef CONFIG_SAMPLE_PC_TEST_PATTERN
#define TW 720
#define TH 400

/* eight colour bars, a white frame, a diagonal and a marker in the top left corner */
static void test_pattern(void)
{
	static const uint16_t bars[8] = {0xffff, 0xffe0, 0x07ff, 0x07e0, 0xf81f, 0xf800, 0x001f, 0x0000};
	const struct device *disp = DEVICE_DT_GET(DT_CHOSEN(zephyr_display));
	uint16_t *pic = aligned_alloc(64, TW * TH * 2);
	struct display_sunxi_rgb img = {
		.data = pic, .width = TW, .height = TH, .stride = TW * 2,
	};

	for (int y = 0; y < TH; y++) {
		for (int x = 0; x < TW; x++) {
			uint16_t c = bars[x * 8 / TW];

			if (x < 2 || y < 2 || x >= TW - 2 || y >= TH - 2 || x == y) {
				c = 0xffff;
			}
			if (x < 40 && y < 40) {
				c = 0xf800;
			}
			pic[y * TW + x] = c;
		}
	}
	sys_cache_data_flush_range(pic, TW * TH * 2);
	printk("test pattern: %d\n", display_sunxi_show_rgb(disp, &img));
	while (1) {
		k_sleep(K_SECONDS(10));
	}
}
#endif

int main(void)
{
#ifdef CONFIG_SAMPLE_PC_TEST_PATTERN
	test_pattern();
#endif
	static char *argv[] = {"bochs", "-q", "-f", "mem:bochsrc", NULL};
	int n;
	int ret;

	ret = fs_mount(&mp);

	printk("sd mount: %d\n", ret);
	if (ret == 0) {
		struct fs_dir_t dir;
		struct fs_dirent ent;

		fs_dir_t_init(&dir);
		if (fs_opendir(&dir, "/SD:") == 0) {
			while (fs_readdir(&dir, &ent) == 0 && ent.name[0] != '\0') {
				printk("sd: %s %s %u\n", ent.type == FS_DIR_ENTRY_DIR ? "dir " : "file",
				       ent.name, (unsigned int)ent.size);
			}
			fs_closedir(&dir);
		}
	}

	if (ret == 0 && CONFIG_SAMPLE_PC_DISK[0] != '\0') {
		/* Bochs leaves "<image>.lock" behind when it does not exit cleanly */
		char lock[96];

		snprintf(lock, sizeof(lock), "%s.lock", CONFIG_SAMPLE_PC_DISK);
		printk("lock file removed: %d\n", fs_unlink(lock));
	}
#ifdef CONFIG_SAMPLE_PC_VERIFY
	if (ret == 0 && CONFIG_SAMPLE_PC_DISK[0] != '\0') {
		static uint32_t table[256];
		static uint8_t buf[32768];
		struct fs_file_t f;
		uint32_t crc = 0xffffffffU;
		ssize_t got;

		for (uint32_t i = 0; i < 256; i++) {
			uint32_t c = i;

			for (int k = 0; k < 8; k++) {
				c = (c >> 1) ^ (0xedb88320U & -(c & 1));
			}
			table[i] = c;
		}
		fs_file_t_init(&f);
		if (fs_open(&f, CONFIG_SAMPLE_PC_DISK, FS_O_READ) == 0) {
			while ((got = fs_read(&f, buf, sizeof(buf))) > 0) {
				for (ssize_t i = 0; i < got; i++) {
					crc = table[(crc ^ buf[i]) & 0xff] ^ (crc >> 8);
				}
			}
			fs_close(&f);
			printk("crc32 %s %08x\n", CONFIG_SAMPLE_PC_DISK, (unsigned int)~crc);
		}
	}
#endif
#ifdef CONFIG_SAMPLE_PC_PATCH_AUTOEXEC
	if (ret == 0 && CONFIG_SAMPLE_PC_DISK[0] != '\0') {
		static const char autoexec[] = "rem     \r\nREM VBMOUSE.EXE      ";
		struct fs_file_t f;

		fs_file_t_init(&f);
		if (fs_open(&f, CONFIG_SAMPLE_PC_DISK, FS_O_RDWR) == 0) {
			ret = fs_seek(&f, 63808512, FS_SEEK_SET);
			if (ret == 0) {
				ret = fs_write(&f, autoexec, sizeof(autoexec) - 1);
			}
			fs_close(&f);
			printk("autoexec patched: %d\n", ret);
		}
	}
#endif

	n = snprintf(rc, sizeof(rc),
		     "romimage: file=mem:BIOS-bochs-legacy\n"
		     "vgaromimage: file=mem:VGABIOS-lgpl-latest\n"
		     "megs: %d\n"
		     "cpu: count=1, ips=%d\n"
		     "boot: disk\n"
		     "display_library: nogui\n"
		     "vga: extension=none\n"
		     "mouse: enabled=0\n"
		     "clock: sync=none, time0=1000000000\n"
		     "port_e9_hack: enabled=1\n"
		     "log: -\n"
		     "panic: action=fatal\n"
		     "error: action=ignore\n"
		     "info: action=ignore\n"
		     "debug: action=ignore\n",
		     CONFIG_SAMPLE_PC_MEGS, CONFIG_SAMPLE_PC_IPS);
	if (CONFIG_SAMPLE_PC_DISK[0] != '\0') {
		n += snprintf(rc + n, sizeof(rc) - n,
			      "ata0-master: type=disk, path=\"%s\", mode=flat, cylinders=%d, heads=%d, spt=%d\n",
			      CONFIG_SAMPLE_PC_DISK, CONFIG_SAMPLE_PC_DISK_CYLINDERS,
			      CONFIG_SAMPLE_PC_DISK_HEADS, CONFIG_SAMPLE_PC_DISK_SPT);
	}
	bx_mem_file("bochsrc", rc, n);

	return bochs_run(4, argv);
}
```
