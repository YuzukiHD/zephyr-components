## CMakeLists.txt
```
# SPDX-License-Identifier: Apache-2.0

cmake_minimum_required(VERSION 3.20.0)
# the Doom module is two directories up
list(APPEND ZEPHYR_EXTRA_MODULES ${CMAKE_CURRENT_SOURCE_DIR}/../..)

find_package(Zephyr REQUIRED HINTS $ENV{ZEPHYR_BASE})
project(doom_player)

target_sources(app PRIVATE src/main.c src/video.c src/audio.c src/pad.c)
target_include_directories(app PRIVATE src)
```

## Kconfig
```
# SPDX-License-Identifier: Apache-2.0

mainmenu "Doom player"

config SAMPLE_DOOM_WAD
	string "WAD file"
	default "/SD:/doom1.wad"

config SAMPLE_DOOM_RATE
	int "Sound output rate"
	default 48000

source "Kconfig.zephyr"
```

## prj.conf
```kconfig
CONFIG_DOOM=y
CONFIG_CRC=y

CONFIG_SDHC=y
CONFIG_DISK_ACCESS=y
CONFIG_DISK_DRIVER_SDMMC=y
CONFIG_FILE_SYSTEM=y
CONFIG_FAT_FILESYSTEM_ELM=y
CONFIG_FS_FATFS_EXFAT=y
CONFIG_FS_FATFS_LFN=y
CONFIG_FS_FATFS_LFN_MODE_STACK=y
CONFIG_LOG=y
CONFIG_LOG_PRINTK=n
CONFIG_PRINTK=y
CONFIG_SHELL=n
CONFIG_DEVMEM_SHELL=n
CONFIG_MAIN_STACK_SIZE=16384
CONFIG_COMMON_LIBC_MALLOC_ARENA_SIZE=-1
CONFIG_HEAP_MEM_POOL_SIZE=262144
CONFIG_MAIN_THREAD_PRIORITY=6

# drivers the player does not use
CONFIG_G2D=n
CONFIG_USB_PHY_SUNXI=n
CONFIG_ADC=n
CONFIG_SPI=n
CONFIG_I2C=n
CONFIG_MIPI_DBI=n
CONFIG_WDT_SUNXI=n
CONFIG_VDEC=n

CONFIG_FPU=y
CONFIG_FPU_SHARING=y
CONFIG_I2S=y
CONFIG_AUDIO=y
CONFIG_AUDIO_CODEC=y
CONFIG_DMA=y
CONFIG_GPIO=y
CONFIG_RING_BUFFER=y

# the pad: LVGL on the ARGB frame buffer plane, over the video plane
CONFIG_DISPLAY=y
CONFIG_DISPLAY_SUNXI_ARGB8888=y
CONFIG_LVGL=y
CONFIG_LV_COLOR_DEPTH_32=y
CONFIG_LV_Z_MEM_POOL_SIZE=131072
CONFIG_LV_Z_VDB_SIZE=4
CONFIG_LV_FONT_MONTSERRAT_16=y
CONFIG_LV_FONT_MONTSERRAT_28=y
CONFIG_LV_Z_SHELL=n
CONFIG_STATIC_INIT_GNU=y
CONFIG_SUN252I_F101_RVV=y
```

## boards/yuzukineko.conf
```kconfig
# The touch panel: the controller is on I2C, five points,
# and an input thread above the game thread so that fingers are not lost while a tic runs.
CONFIG_I2C=y
CONFIG_INPUT=y
CONFIG_INPUT_GT967_MAX_TOUCH_POINTS=5
CONFIG_INPUT_THREAD_PRIORITY_OVERRIDE=y
CONFIG_INPUT_THREAD_PRIORITY=4
CONFIG_INPUT_QUEUE_MAX_MSGS=64
```

## src/main.c
```c
/*
 * Copyright (c) 2026 Yuzuki Tsuru
 * SPDX-License-Identifier: Apache-2.0
 */

/* Runs Doom from a WAD on the SD card. */

#include <errno.h>
#include <ff.h>
#include <stdio.h>
#include <string.h>
#include <zephyr/fs/fs.h>
#include <zephyr/kernel.h>
#include <zephyr/sys/printk.h>
#include <doom_zephyr/doom.h>

#include "app.h"

#define RATE		CONFIG_SAMPLE_DOOM_RATE
#define REPORT_MS	5000

static FATFS fat_fs;
static struct fs_mount_t mp = {
	.type = FS_FATFS,
	.fs_data = &fat_fs,
	.mnt_point = "/SD:",
};

static char wad_path[128];

/* the configured WAD, or else the first .wad file in the root of the card */
static int pick_wad(void)
{
	struct fs_dirent ent;
	struct fs_dir_t dir;

	strncpy(wad_path, CONFIG_SAMPLE_DOOM_WAD, sizeof(wad_path) - 1);
	if (fs_stat(wad_path, &ent) == 0) {
		return 0;
	}
	fs_dir_t_init(&dir);
	if (fs_opendir(&dir, "/SD:") != 0) {
		return -ENOENT;
	}
	wad_path[0] = '\0';
	while (fs_readdir(&dir, &ent) == 0 && ent.name[0] != '\0') {
		size_t n = strlen(ent.name);

		if (ent.type == FS_DIR_ENTRY_FILE && n > 4 &&
		    (strcmp(ent.name + n - 4, ".wad") == 0 || strcmp(ent.name + n - 4, ".WAD") == 0)) {
			snprintf(wad_path, sizeof(wad_path), "/SD:/%s", ent.name);
			break;
		}
	}
	fs_closedir(&dir);

	return wad_path[0] == '\0' ? -ENOENT : 0;
}

int main(void)
{
	int64_t t_report;
	uint32_t frames = 0, drawn = 0;
	int ret;

	ret = fs_mount(&mp);
	if (ret != 0) {
		printk("cannot mount the SD card: %d\n", ret);
		return 0;
	}
	if (video_init() != 0) {
		printk("video not available\n");
		return 0;
	}
	doom_audio_init(RATE);
	if (audio_init(RATE) != 0) {
		printk("audio not available\n");
	}
	if (pick_wad() != 0) {
		printk("no .wad file on the card\n");
		return 0;
	}
	printk("WAD %s\n", wad_path);
	doom_set_frame_buffer(video_acquire());
	pad_start();
	ret = doom_open(wad_path, "/SD:");
	if (ret != 0) {
		printk("cannot start Doom: %d\n", ret);
		return 0;
	}

	t_report = k_uptime_get();
	while (true) {
		doom_set_frame_buffer(video_acquire());
		if (doom_run_frame()) {
			video_present(DOOM_WIDTH, DOOM_HEIGHT);
			drawn++;
		}
		frames++;
		if (k_uptime_get() - t_report >= REPORT_MS) {
			printk("doom: %u passes, %u pictures, sound underruns %u\n", frames, drawn,
			       audio_underruns());
			frames = drawn = 0;
			t_report = k_uptime_get();
		}
	}

	return 0;
}
```

## src/app.h
```c
/*
 * Copyright (c) 2026 Yuzuki Tsuru
 * SPDX-License-Identifier: Apache-2.0
 */

#ifndef APP_H_
#define APP_H_

#include <stdbool.h>
#include <stddef.h>
#include <stdint.h>

/* video.c: RGB565 frame to the video plane */
int video_init(void);
/** The buffer the next frame is drawn into, and its hand-over to the display */
uint16_t *video_acquire(void);
void video_present(unsigned int width, unsigned int height);

/* audio.c: sound effects of the engine to the codec */
int audio_init(unsigned int rate);
unsigned int audio_underruns(void);

/* pad.c: on-screen keys */
int pad_start(void);

#endif
```

## src/audio.c
```c
/*
 * Copyright (c) 2026 Yuzuki Tsuru
 * SPDX-License-Identifier: Apache-2.0
 */

/*
 * A thread asks the engine for the mixed sound effects block by block and
 * hands them to the codec; the codec consumes at a fixed rate, which paces it.
 */

#include <errno.h>
#include <string.h>
#include <zephyr/audio/codec.h>
#include <zephyr/device.h>
#include <zephyr/drivers/i2s.h>
#include <zephyr/kernel.h>
#include <zephyr/sys/printk.h>
#include <doom_zephyr/doom.h>

#include "app.h"

#define BLOCK_FRAMES	512
#define BLOCK_BYTES	(BLOCK_FRAMES * 2 * sizeof(int16_t))
#define SLAB_BLOCKS	4
#define PREFILL		2

static const struct device *const i2s = DEVICE_DT_GET(DT_NODELABEL(audio_codec));
static const struct device *const ctl = DEVICE_DT_GET(DT_NODELABEL(codec_analog));

K_MEM_SLAB_DEFINE_STATIC(slab, BLOCK_BYTES, SLAB_BLOCKS, 4);
K_THREAD_STACK_DEFINE(audio_stack, 4096);
static struct k_thread thread;

static unsigned int rate;
static volatile unsigned int underruns, slab_waits;

static void audio_main(void *a, void *b, void *c)
{
	struct i2s_config cfg = {
		.word_size = 16,
		.channels = 2,
		.format = I2S_FMT_DATA_FORMAT_I2S,
		.options = I2S_OPT_BIT_CLK_MASTER | I2S_OPT_FRAME_CLK_MASTER,
		.frame_clk_freq = rate,
		.mem_slab = &slab,
		.block_size = BLOCK_BYTES,
		.timeout = 2000,
	};
	bool running = false;
	int queued = 0;

	if (i2s_configure(i2s, I2S_DIR_TX, &cfg) != 0) {
		printk("audio: i2s_configure failed\n");
		return;
	}
	audio_codec_start_output(ctl);
	audio_codec_set_property(ctl, AUDIO_PROPERTY_OUTPUT_VOLUME, AUDIO_CHANNEL_ALL,
				 (audio_property_value_t){.vol = 150});

	while (true) {
		void *blk;
		int ret;

		if (k_mem_slab_alloc(&slab, &blk, K_NO_WAIT) != 0) {
			slab_waits++;
			if (k_mem_slab_alloc(&slab, &blk, K_SECONDS(2)) != 0) {
				continue;
			}
		}
		doom_audio_read(blk, BLOCK_FRAMES);
		ret = i2s_write(i2s, blk, BLOCK_BYTES);
		if (ret == -EIO) {
			/* the stream ran dry: start it again */
			underruns++;
			running = false;
			queued = 0;
			k_mem_slab_free(&slab, blk);
			i2s_trigger(i2s, I2S_DIR_TX, I2S_TRIGGER_PREPARE);
			continue;
		} else if (ret != 0) {
			k_mem_slab_free(&slab, blk);
			continue;
		}
		if (!running && ++queued >= PREFILL &&
		    i2s_trigger(i2s, I2S_DIR_TX, I2S_TRIGGER_START) == 0) {
			running = true;
		}
	}
}

int audio_init(unsigned int out_rate)
{
	if (!device_is_ready(i2s) || !device_is_ready(ctl)) {
		return -ENODEV;
	}
	rate = out_rate;
	k_thread_create(&thread, audio_stack, K_THREAD_STACK_SIZEOF(audio_stack), audio_main, NULL, NULL, NULL,
			3, 0, K_NO_WAIT);
	k_thread_name_set(&thread, "audio");

	return 0;
}

unsigned int audio_underruns(void)
{
	return underruns;
}
```

## src/pad.c
```c
/*
 * Copyright (c) 2026 Yuzuki Tsuru
 * SPDX-License-Identifier: Apache-2.0
 */

/*
 * The keys of the console as translucent LVGL buttons on the ARGB plane, over
 * the game picture (which the video plane shows scaled to the panel).
 *
 * With a touch panel (the chosen zephyr,touch) the fingers are read straight from the input
 * events, one per touch slot, and each is matched against the buttons here: LVGL's pointer
 * handles one finger, a game needs the directions and a button at the same time. The buttons
 * only show the state.
 */

#include <lvgl.h>
#include <zephyr/devicetree.h>
#include <zephyr/kernel.h>
#include <zephyr/sys/printk.h>
#include <doom_zephyr/doom.h>

#include "app.h"

#define HAS_TOUCH	DT_NODE_EXISTS(DT_CHOSEN(zephyr_touch))

#if HAS_TOUCH
#include <zephyr/input/input.h>
#endif

#define STACK_SIZE	4096
#define PRIORITY	7

K_THREAD_STACK_DEFINE(pad_stack, STACK_SIZE);
static struct k_thread thread;

#define MAX_KEYS	12
#define HIT_MARGIN	12
/*
 * The controller now and then reports a frame without the finger while it stays on the glass,
 * which would be a release and a new press: a key is held this long after its finger left.
 */
#define RELEASE_HOLD_MS	50

static struct pad_key {
	lv_obj_t *obj;
	int x, y, w, h;
	unsigned char key;
	bool shown;
	uint32_t hold_until;
} pad_keys_tbl[MAX_KEYS];
static int nkeys;

#if HAS_TOUCH
#define TOUCH_SLOTS	5

static struct {
	int x, y;
	bool down;
} fingers[TOUCH_SLOTS];
static int cur_slot;

static void touch_event(struct input_event *evt, void *user_data)
{
	switch (evt->code) {
	case INPUT_ABS_MT_SLOT:
		cur_slot = CLAMP(evt->value, 0, TOUCH_SLOTS - 1);
		break;
	case INPUT_ABS_X:
		fingers[cur_slot].x = evt->value;
		break;
	case INPUT_ABS_Y:
		fingers[cur_slot].y = evt->value;
		break;
	case INPUT_BTN_TOUCH:
		fingers[cur_slot].down = evt->value != 0;
		break;
	}
}
INPUT_CALLBACK_DEFINE(DEVICE_DT_GET(DT_CHOSEN(zephyr_touch)), touch_event, NULL);

/* hands the key changes to the engine and shows the state on the buttons */
static void touch_scan(void)
{
	uint32_t now = k_uptime_get_32();

	for (int k = 0; k < nkeys; k++) {
		struct pad_key *key = &pad_keys_tbl[k];
		bool pressed = false;

		for (int f = 0; f < TOUCH_SLOTS; f++) {
			if (fingers[f].down && fingers[f].x >= key->x - HIT_MARGIN &&
			    fingers[f].x < key->x + key->w + HIT_MARGIN &&
			    fingers[f].y >= key->y - HIT_MARGIN &&
			    fingers[f].y < key->y + key->h + HIT_MARGIN) {
				pressed = true;
			}
		}
		if (pressed) {
			key->hold_until = now + RELEASE_HOLD_MS;
		} else if ((int32_t)(now - key->hold_until) < 0) {
			pressed = true;
		}
		if (pressed != key->shown) {
			if (pressed) {
				lv_obj_add_state(key->obj, LV_STATE_PRESSED);
			} else {
				lv_obj_remove_state(key->obj, LV_STATE_PRESSED);
			}
			doom_key(pressed ? 1 : 0, key->key);
			key->shown = pressed;
		}
	}
}
#endif /* HAS_TOUCH */

#if !HAS_TOUCH
static void key_event(lv_event_t *e)
{
	unsigned char key = (unsigned char)(uintptr_t)lv_event_get_user_data(e);
	lv_event_code_t code = lv_event_get_code(e);

	if (code == LV_EVENT_PRESSED) {
		doom_key(1, key);
	} else if (code == LV_EVENT_RELEASED || code == LV_EVENT_PRESS_LOST) {
		doom_key(0, key);
	}
}
#endif

static void key_add(int x, int y, int w, int h, const char *text, unsigned char key, int radius)
{
	lv_obj_t *b = lv_button_create(lv_screen_active());
	lv_obj_t *l = lv_label_create(b);

	lv_obj_set_size(b, w, h);
	lv_obj_align(b, LV_ALIGN_TOP_LEFT, x, y);
	lv_obj_set_style_radius(b, radius, 0);
	lv_obj_set_style_bg_color(b, lv_color_white(), 0);
	lv_obj_set_style_bg_opa(b, LV_OPA_30, 0);
	lv_obj_set_style_bg_color(b, lv_color_make(255, 200, 60), LV_STATE_PRESSED);
	lv_obj_set_style_bg_opa(b, LV_OPA_70, LV_STATE_PRESSED);
	lv_obj_set_style_border_color(b, lv_color_white(), 0);
	lv_obj_set_style_border_opa(b, LV_OPA_50, 0);
	lv_obj_set_style_border_width(b, 2, 0);
	lv_obj_set_style_shadow_width(b, 0, 0);
	lv_obj_set_style_text_font(l, &lv_font_montserrat_28, 0);
	lv_obj_set_style_text_color(l, lv_color_white(), 0);
	lv_label_set_text(l, text);
	lv_obj_center(l);
#if !HAS_TOUCH
	lv_obj_add_event_cb(b, key_event, LV_EVENT_ALL, (void *)(uintptr_t)key);
#endif

	if (nkeys < MAX_KEYS) {
		pad_keys_tbl[nkeys++] = (struct pad_key){
			.obj = b, .x = x, .y = y, .w = w, .h = h, .key = key,
		};
	}
}

static void pad_main(void *a, void *b, void *c)
{
	lv_obj_set_style_bg_opa(lv_screen_active(), LV_OPA_TRANSP, 0);

	/*
	 * The layout was drawn for a 1024x600 panel, the keys at the bottom stay at the bottom of
	 * a taller one. The picture is scaled to the middle.
	 */
	const int dy = lv_display_get_vertical_resolution(NULL) - 600;

	key_add(30, 330 + dy, 90, 90, LV_SYMBOL_LEFT, DOOM_KEY_LEFT, 20);
	key_add(210, 330 + dy, 90, 90, LV_SYMBOL_RIGHT, DOOM_KEY_RIGHT, 20);
	key_add(120, 240 + dy, 90, 90, LV_SYMBOL_UP, DOOM_KEY_UP, 20);
	key_add(120, 420 + dy, 90, 90, LV_SYMBOL_DOWN, DOOM_KEY_DOWN, 20);

	key_add(830, 360 + dy, 110, 110, "FIRE", DOOM_KEY_FIRE, LV_RADIUS_CIRCLE);
	key_add(700, 440 + dy, 110, 110, "USE", DOOM_KEY_USE, LV_RADIUS_CIRCLE);

	key_add(20, 20, 120, 60, "ESC", DOOM_KEY_ESCAPE, 16);
	key_add(880, 20, 120, 60, "ENTER", DOOM_KEY_ENTER, 16);
	key_add(20, 100, 120, 60, "STR<", DOOM_KEY_STRAFE_L, 16);
	key_add(880, 100, 120, 60, "STR>", DOOM_KEY_STRAFE_R, 16);
	key_add(400, 520 + dy, 100, 60, "Y", DOOM_KEY_Y, 30);
	key_add(524, 520 + dy, 100, 60, "N", DOOM_KEY_N, 30);
	printk("pad: %d keys, display %dx%d, touch %s\n", nkeys,
	       lv_display_get_horizontal_resolution(NULL), lv_display_get_vertical_resolution(NULL),
	       HAS_TOUCH ? "on" : "off");

	while (true) {
#if HAS_TOUCH
		touch_scan();
#endif
		lv_timer_handler();
		k_msleep(16);
	}
}

int pad_start(void)
{
	k_tid_t tid = k_thread_create(&thread, pad_stack, STACK_SIZE, pad_main, NULL, NULL, NULL,
				      PRIORITY, 0, K_NO_WAIT);

	k_thread_name_set(tid, "pad");

	return 0;
}
```

## src/video.c
```c
/*
 * Copyright (c) 2026 Yuzuki Tsuru
 * SPDX-License-Identifier: Apache-2.0
 */

/*
 * The frame of the console is RGB565 and goes to the scaling video plane of
 * the display engine as it is. The emulator draws the next frame into its own
 * buffer while the plane still scans out the last one, so each frame is copied
 * into one of three buffers (the one shown last stays valid for one more
 * refresh).
 */

#include <errno.h>
#include <stdlib.h>
#include <string.h>
#include <zephyr/cache.h>
#include <zephyr/device.h>
#include <zephyr/drivers/display/display_sunxi.h>
#include <zephyr/kernel.h>
#include <zephyr/sys/atomic.h>
#include <zephyr/sys/printk.h>
#include <doom_zephyr/doom.h>

#include "app.h"

#define STRIDE	(DOOM_WIDTH * 2)
#define BUF_SZ	ROUND_UP(STRIDE * DOOM_HEIGHT, 64)
#define NBUF	4

static const struct device *const disp = DEVICE_DT_GET(DT_CHOSEN(zephyr_display));
static uint8_t *buf[NBUF];
static unsigned int cur;
static atomic_t ready_idx;
static unsigned int ready_w, ready_h;

K_SEM_DEFINE(frame_sem, 0, 1);
K_THREAD_STACK_DEFINE(video_stack, 8192);
static struct k_thread video_thread;

/*
 * Putting a picture up can wait for the next refresh; that must not hold the
 * emulation, which is paced by the sound. Only the newest picture is shown.
 */
static void video_main(void *a, void *b, void *c)
{
	bool warned = false;

	while (true) {
		struct display_sunxi_rgb img = {.width = 0};
		int idx, ret;

		k_sem_take(&frame_sem, K_FOREVER);
		idx = atomic_get(&ready_idx);
		img.data = buf[idx];
		img.width = ready_w;
		img.height = ready_h;
		img.stride = STRIDE;
		img.nonblock = false;
		ret = display_sunxi_show_rgb(disp, &img);
		if (ret != 0 && !warned) {
			printk("video: show_rgb failed: %d\n", ret);
			warned = true;
		}
	}
}

int video_init(void)
{
	if (!device_is_ready(disp)) {
		return -ENODEV;
	}
	for (int i = 0; i < NBUF; i++) {
		buf[i] = aligned_alloc(64, BUF_SZ);
		if (buf[i] == NULL) {
			return -ENOMEM;
		}
	}
	k_thread_create(&video_thread, video_stack, K_THREAD_STACK_SIZEOF(video_stack), video_main,
			NULL, NULL, NULL, 5, 0, K_NO_WAIT);
	k_thread_name_set(&video_thread, "video");

	return 0;
}

uint16_t *video_acquire(void)
{
	return (uint16_t *)buf[(cur + 1) % NBUF];
}

void video_present(unsigned int width, unsigned int height)
{
	cur = (cur + 1) % NBUF;
	sys_cache_data_flush_range(buf[cur], STRIDE * height);
	ready_w = width;
	ready_h = height;
	atomic_set(&ready_idx, cur);
	k_sem_give(&frame_sem);
}
```
