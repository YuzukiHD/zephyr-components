## CMakeLists.txt
```
# SPDX-License-Identifier: Apache-2.0

cmake_minimum_required(VERSION 3.20.0)
# the gpSP module is two directories up
list(APPEND ZEPHYR_EXTRA_MODULES ${CMAKE_CURRENT_SOURCE_DIR}/../..)

find_package(Zephyr REQUIRED HINTS $ENV{ZEPHYR_BASE})
project(gbsp_player)

target_sources(app PRIVATE src/main.c src/video.c src/audio.c src/pad.c)
target_include_directories(app PRIVATE src)

if(CONFIG_SAMPLE_GBA_PROFILE)
  target_sources(app PRIVATE src/profile.c)
endif()
```

## Kconfig
```
# SPDX-License-Identifier: Apache-2.0

mainmenu "GBA player (gpSP)"

config SAMPLE_GBA_ROM
	string "ROM file"
	default "/SD:/Pokemon-FireRed.gba"

config SAMPLE_GBA_RATE
	int "Sound output rate"
	default 48000
	help
	  48000 or 44100.

config SAMPLE_GBA_VIDEO_DIV
	int "Draw one frame in this many (2 = 30 fps)"
	default 2
	range 1 4
	help
	  A frame that is not drawn runs the emulation and the sound but not the
	  renderer, which leaves time for the heavy scenes. The sound is not
	  affected, the picture is.

config SAMPLE_GBA_CPU_MHZ
	int "CPU clock in MHz, 0 keeps what the boot loader set up (600)"
	default 0
	help
	  The CPU PLL is raised in steps of 120 MHz and the memory is checked
	  after each step. The voltage is not changed.

config SAMPLE_GBA_BENCH
	bool "Run the emulation unpaced for a fixed number of frames and print the time"

config SAMPLE_GBA_BENCH_FRAMESKIP
	int "Frames skipped between two drawn frames in the benchmark"
	depends on SAMPLE_GBA_BENCH
	default 0

config SAMPLE_GBA_BENCH_FRAMES
	int "Frames of the benchmark, a checksum of the picture is printed every 200"
	depends on SAMPLE_GBA_BENCH
	default 1200

config SAMPLE_GBA_ROM_DIAG
	bool "Print size, padding and read speed of the ROM files on the card, then stop"

config SAMPLE_GBA_PROFILE
	bool "Sample the program counter of the emulation thread and print a histogram"

config SAMPLE_GBA_PROFILE_DELAY_S
	int "Seconds after the start before the profile is taken"
	depends on SAMPLE_GBA_PROFILE
	default 4
	help
	  Put it into the scene that is to be looked at.

source "Kconfig.zephyr"
```

## prj.conf
```kconfig
CONFIG_GBSP=y
CONFIG_CPP=y
CONFIG_STD_CPP17=y
# the headers in shim/ are written for the minimal C library
CONFIG_MINIMAL_LIBC=y
CONFIG_CRC=y

CONFIG_SDHC=y
CONFIG_DISK_ACCESS=y
CONFIG_DISK_DRIVER_SDMMC=y
CONFIG_FILE_SYSTEM=y
CONFIG_FAT_FILESYSTEM_ELM=y
CONFIG_FS_FATFS_EXFAT=y
CONFIG_FS_FATFS_LFN=y
CONFIG_FS_FATFS_LFN_MODE_STACK=y
# the ROM read-ahead thread reads the card while the emulation does
CONFIG_LOG=y
CONFIG_LOG_PRINTK=n
CONFIG_PRINTK=y
CONFIG_SHELL=n
CONFIG_DEVMEM_SHELL=n
CONFIG_MAIN_STACK_SIZE=16384
CONFIG_COMMON_LIBC_MALLOC_ARENA_SIZE=-1
CONFIG_HEAP_MEM_POOL_SIZE=262144
CONFIG_MAIN_THREAD_PRIORITY=6

# drivers the player does not use
CONFIG_G2D=n
CONFIG_USB_PHY_SUNXI=n
CONFIG_ADC=n
CONFIG_SPI=n
CONFIG_I2C=n
CONFIG_MIPI_DBI=n
CONFIG_WDT_SUNXI=n
CONFIG_VDEC=n

CONFIG_FPU=y
CONFIG_FPU_SHARING=y
CONFIG_I2S=y
CONFIG_AUDIO=y
CONFIG_AUDIO_CODEC=y
CONFIG_DMA=y
CONFIG_GPIO=y
CONFIG_RING_BUFFER=y

# the pad: LVGL on the ARGB frame buffer plane, over the video plane
CONFIG_DISPLAY=y
CONFIG_DISPLAY_SUNXI_ARGB8888=y
CONFIG_LVGL=y
CONFIG_LV_COLOR_DEPTH_32=y
CONFIG_LV_Z_MEM_POOL_SIZE=131072
CONFIG_LV_Z_VDB_SIZE=4
CONFIG_LV_FONT_MONTSERRAT_16=y
CONFIG_LV_FONT_MONTSERRAT_28=y
CONFIG_LV_Z_SHELL=n
CONFIG_STATIC_INIT_GNU=y
CONFIG_GBSP_MAX_ROM_SIZE_MB=32
CONFIG_SAMPLE_GBA_CPU_MHZ=960
CONFIG_SAMPLE_GBA_VIDEO_DIV=1
CONFIG_SUN252I_F101_RVV=y
```

## boards/yuzukineko.conf
```kconfig
# The touch panel: the controller is on I2C (the player switches I2C off elsewhere), five points,
# and an input thread above the emulation thread so that fingers are not lost while a frame runs.
CONFIG_I2C=y
CONFIG_INPUT=y
CONFIG_INPUT_GT967_MAX_TOUCH_POINTS=5
CONFIG_INPUT_THREAD_PRIORITY_OVERRIDE=y
CONFIG_INPUT_THREAD_PRIORITY=4
CONFIG_INPUT_QUEUE_MAX_MSGS=64
```

## src/main.c
```c
/*
 * Copyright (c) 2026 Yuzuki Tsuru
 * SPDX-License-Identifier: Apache-2.0
 */

/*
 * Runs a Game Boy Advance ROM from the SD card. Real time comes from the
 * sound: the emulation stops while the audio ring holds enough.
 */

#include <errno.h>
#include <ff.h>
#include <stdio.h>
#include <stdlib.h>
#include <string.h>
#include <zephyr/fs/fs.h>
#include <zephyr/kernel.h>
#include <zephyr/sys/crc.h>
#include <zephyr/drivers/clock_control.h>
#include <zephyr/dt-bindings/clock/sun252i-f101-ccu.h>
#include <zephyr/sys/printk.h>
#include <gbsp_zephyr/gbsp.h>

#include "app.h"

#define RATE		CONFIG_SAMPLE_GBA_RATE
/* the emulation waits while this many frames of sound are queued */
#define HIGH_WATER	(RATE / 15)
/*
 * Below SKIP_BELOW queued sound frames the emulation catches up by drawing one frame in four,
 * until the queue has grown to SKIP_RESUME again. The gap keeps it from falling back to
 * the normal rate, which a heavy scene cannot keep up with, as soon as the queue recovers.
 */
#define SKIP_BELOW	1500
#define SKIP_RESUME	2800
#define SKIP_COUNT	3
/* the frames skipped between two drawn ones in normal running */
#define SKIP_BASE	(CONFIG_SAMPLE_GBA_VIDEO_DIV - 1)
#define REPORT_MS	5000
#define SAVE_MS		3000

static FATFS fat_fs;
static struct fs_mount_t mp = {
	.type = FS_FATFS,
	.fs_data = &fat_fs,
	.mnt_point = "/SD:",
};

/* A busy loop over a checksummed block of memory: a CPU that is too fast corrupts it */
static bool cpu_selftest(void)
{
	static uint32_t blk[16 * 1024];
	uint32_t sum = 0, ref;

	for (unsigned int i = 0; i < ARRAY_SIZE(blk); i++) {
		blk[i] = i * 2654435761U;
	}
	for (int round = 0; round < 50; round++) {
		sum = 0;
		for (unsigned int i = 0; i < ARRAY_SIZE(blk); i++) {
			sum = (sum << 1 | sum >> 31) ^ blk[i] ^ (sum * 3U);
		}
		if (round == 0) {
			ref = sum;
		} else if (sum != ref) {
			return false;
		}
	}

	return true;
}

static void cpu_clock_setup(void)
{
	const struct device *cctl = DEVICE_DT_GET(DT_NODELABEL(cctl));
	uint32_t rate, target = CONFIG_SAMPLE_GBA_CPU_MHZ * 1000000U;

	clock_control_get_rate(cctl, (clock_control_subsys_t)CLK_CPU, &rate);
	/* in steps, each one checked: the voltage is not changed */
	while (target != 0U && rate < target) {
		uint32_t next = MIN(rate + 72000000U, target);
		bool ok;

		if (clock_control_set_rate(cctl, (clock_control_subsys_t)CLK_CPU,
					   (clock_control_subsys_rate_t)next) != 0) {
			printk("cpu: %u MHz refused\n", next / 1000000U);
			break;
		}
		ok = cpu_selftest();
		if (!ok) {
			printk("cpu: %u MHz BAD\n", next / 1000000U);
			clock_control_set_rate(cctl, (clock_control_subsys_t)CLK_CPU,
					       (clock_control_subsys_rate_t)rate);
			printk("cpu: back to %u MHz\n", rate / 1000000U);
			return;
		}
		rate = next;
	}
}

static char rom_path[128], save_path[128];

static bool ext_ok(const char *name, size_t n, bool gba_only)
{
	static const char *const ext[] = {".gba", ".GBA", ".gbc", ".GBC", ".gb", ".GB"};

	for (int i = 0; i < ARRAY_SIZE(ext); i++) {
		size_t e = strlen(ext[i]);

		if (gba_only && i >= 2) {
			break;
		}
		if (n > e && strcmp(name + n - e, ext[i]) == 0) {
			return true;
		}
	}

	return false;
}

/* the configured ROM, or else the first fitting file in the root of the card; GBA ROMs first */
static int pick_rom(void)
{
	struct fs_dirent ent;
	struct fs_dir_t dir;
	char *dot;

	strncpy(rom_path, CONFIG_SAMPLE_GBA_ROM, sizeof(rom_path) - 1);
	if (fs_stat(rom_path, &ent) != 0) {
		fs_dir_t_init(&dir);
		if (fs_opendir(&dir, "/SD:") != 0) {
			return -ENOENT;
		}
		rom_path[0] = '\0';
		for (int pass = 0; pass < 2 && rom_path[0] == '\0'; pass++) {
			fs_closedir(&dir);
			if (fs_opendir(&dir, "/SD:") != 0) {
				return -ENOENT;
			}
			while (fs_readdir(&dir, &ent) == 0 && ent.name[0] != '\0') {
				size_t n = strlen(ent.name);

				if (ent.type == FS_DIR_ENTRY_FILE && n > 4 &&
				    ext_ok(ent.name, n, pass == 0) &&
				    ent.size <= CONFIG_GBSP_MAX_ROM_SIZE_MB * 1024UL * 1024UL) {
					snprintf(rom_path, sizeof(rom_path), "/SD:/%s", ent.name);
					break;
				}
			}
		}
		fs_closedir(&dir);
		if (rom_path[0] == '\0') {
			return -ENOENT;
		}
	}
	strncpy(save_path, rom_path, sizeof(save_path) - 5);
	dot = strrchr(save_path, '.');
	strcpy(dot != NULL && dot > strrchr(save_path, '/') ? dot : save_path + strlen(save_path),
	       ".sav");

	return 0;
}

#ifdef CONFIG_SAMPLE_GBA_ROM_DIAG
/* how much of each ROM file is real data, and what random reads from the card cost */
static void rom_diag(void)
{
	struct fs_dirent ent;
	struct fs_dir_t dir;
	static const uint32_t chunks[] = {4096, 16384, 65536, 262144};
	uint8_t *buf = aligned_alloc(64, 262144);

	fs_dir_t_init(&dir);
	if (buf == NULL || fs_opendir(&dir, "/SD:") != 0) {
		return;
	}
	while (fs_readdir(&dir, &ent) == 0 && ent.name[0] != '\0') {
		char path[160];
		struct fs_file_t f;
		size_t n = strlen(ent.name);
		uint32_t pad = 0, pad_end = 0;
		uint32_t seed = 12345;

		if (ent.type != FS_DIR_ENTRY_FILE || !ext_ok(ent.name, n, false)) {
			continue;
		}
		snprintf(path, sizeof(path), "/SD:/%s", ent.name);
		fs_file_t_init(&f);
		if (fs_open(&f, path, FS_O_READ) != 0) {
			continue;
		}
		/* trailing 0xFF / 0x00 bytes */
		for (uint32_t end = ent.size; end > 0; ) {
			uint32_t len = MIN(end, 65536U);
			bool all = true;

			fs_seek(&f, end - len, FS_SEEK_SET);
			fs_read(&f, buf, len);
			for (uint32_t i = len; i > 0; i--) {
				uint8_t c = buf[i - 1];

				if (c != 0xFF && c != 0x00) {
					all = false;
					pad += len - i;
					break;
				}
			}
			if (!all) {
				break;
			}
			pad += len;
			end -= len;
		}
		pad_end = ent.size - pad;
		printk("rom: %s size %u, data ends at %u (padding %u)\n", ent.name, (unsigned int)ent.size,
		       pad_end, pad);
		for (int c = 0; c < ARRAY_SIZE(chunks); c++) {
			uint32_t t0 = k_cycle_get_32();
			const int reads = 64;

			for (int i = 0; i < reads; i++) {
				seed = seed * 1103515245U + 12345U;
				uint32_t off = ((seed >> 8) % (ent.size / chunks[c])) * chunks[c];

				fs_seek(&f, off, FS_SEEK_SET);
				fs_read(&f, buf, chunks[c]);
			}
			printk("rom: %s random %u KiB reads: %u us each\n", ent.name, chunks[c] / 1024,
			       (uint32_t)(k_cyc_to_us_floor64(k_cycle_get_32() - t0) / reads));
		}
		fs_close(&f);
	}
	fs_closedir(&dir);
	free(buf);
}
#endif

int main(void)
{
	static int16_t pcm[2 * 2048];
	int64_t t_report, t_save;
	uint32_t frames = 0, emu_us = 0, pushed = 0, skipped = 0;
	bool catching_up = false;
	int drawn;
	int ret;

	cpu_clock_setup();
	ret = fs_mount(&mp);
	if (ret != 0) {
		printk("cannot mount the SD card: %d\n", ret);
		return 0;
	}
	if (video_init() != 0 || audio_init(RATE) != 0) {
		printk("video or audio not available\n");
		return 0;
	}
#ifdef CONFIG_SAMPLE_GBA_ROM_DIAG
	rom_diag();
	return 0;
#endif
	if (pick_rom() != 0) {
		printk("no .gba/.gb/.gbc file on the card\n");
		return 0;
	}
	printk("ROM %s, save %s\n", rom_path, save_path);
	ret = gbsp_open(rom_path, save_path, RATE);
	if (ret != 0) {
		printk("cannot start %s: %d\n", rom_path, ret);
		return 0;
	}
	pad_start();
#ifdef CONFIG_SAMPLE_GBA_PROFILE
	{
		extern void profile_start(struct k_thread *target);

		profile_start(k_current_get());
	}
#endif

#ifdef CONFIG_SAMPLE_GBA_BENCH
	{
		/* no sound pacing, no skipping, no display: the cost of the emulation alone */
		static int16_t sink[2 * 2048];
		uint32_t t0 = k_cycle_get_32(), worst = 0;
		const int n_frames = CONFIG_SAMPLE_GBA_BENCH_FRAMES;
		/* every 200 frames: average and worst frame, frames over 16.7 ms, ROM pages read */
		uint32_t w_sum = 0, w_max = 0, w_slow = 0;
		struct gbsp_stats prev = {0};

		for (int i = 0; i < n_frames; i++) {
			uint32_t c0 = k_cycle_get_32(), us;

			gbsp_set_frame_buffer(video_acquire());
			gbsp_set_frameskip(CONFIG_SAMPLE_GBA_BENCH_FRAMESKIP);
			gbsp_run_frame();
			while (gbsp_audio_read(sink, ARRAY_SIZE(sink) / 2) > 0) {
			}
			us = k_cyc_to_us_floor32(k_cycle_get_32() - c0);
			worst = MAX(worst, k_cycle_get_32() - c0);
			w_sum += us;
			w_max = MAX(w_max, us);
			w_slow += us > 16667 ? 1 : 0;
			if ((i + 1) % 200 == 0) {
				unsigned int w, h;
				const uint16_t *f = gbsp_frame(&w, &h);
				struct gbsp_stats st;

				gbsp_get_stats(&st);
				printk("bench: frame %d crc %08x: %u us avg, %u us worst, %u over 16.7 ms, "
				       "%u ROM pages (%u from read-ahead) in %u us, %u blocks translated, flushes rom %u ram %u\n",
				       i + 1, (uint32_t)crc32_ieee((const uint8_t *)f, w * 2 * h), w_sum / 200,
				       w_max, w_slow, st.rom_loads - prev.rom_loads, st.rom_hits - prev.rom_hits,
				       st.rom_load_us - prev.rom_load_us, st.translations - prev.translations,
				       st.rom_flushes - prev.rom_flushes, st.ram_flushes - prev.ram_flushes);
				w_sum = w_max = w_slow = 0;
				prev = st;
			}
		}
		printk("bench: %d frames, %u us/frame, worst %u us\n", n_frames,
		       (uint32_t)(k_cyc_to_us_floor64(k_cycle_get_32() - t0) / n_frames),
		       (uint32_t)k_cyc_to_us_floor64(worst));
		return 0;
	}
#endif
	t_report = t_save = k_uptime_get();
	while (true) {
		uint32_t c0 = k_cycle_get_32();
		size_t n;

		gbsp_set_keys(pad_keys());
		gbsp_set_frame_buffer(video_acquire());
		/* behind the sound: draw less until it has caught up */
		{
			size_t queued = audio_queued();

			if (queued < SKIP_BELOW) {
				catching_up = true;
			} else if (queued > SKIP_RESUME) {
				catching_up = false;
			}
			gbsp_set_frameskip(catching_up ? MAX(SKIP_COUNT, SKIP_BASE) : SKIP_BASE);
		}
		drawn = gbsp_run_frame();
		emu_us += k_cyc_to_us_floor32(k_cycle_get_32() - c0);
		if (drawn) {
			unsigned int w, h;

			gbsp_frame(&w, &h);
			video_present(w, h);
		} else {
			skipped++;
		}
		while ((n = gbsp_audio_read(pcm, ARRAY_SIZE(pcm) / 2)) > 0) {
			size_t done = 0;

			pushed += n;

			while (done < n) {
				done += audio_push(pcm + done * 2, n - done);
				if (done < n) {
					k_msleep(1);
				}
			}
		}
		frames++;

		while (audio_queued() > HIGH_WATER) {
			k_msleep(1);
		}
		if (k_uptime_get() - t_save >= SAVE_MS) {
			gbsp_save_flush();
			t_save = k_uptime_get();
		}
		if (k_uptime_get() - t_report >= REPORT_MS) {
			printk("gba: %u frames, emulation %u us/frame, sound %u frames pushed, "
			       "queued %u, underruns %u, ring empty %u, slab full %u, skipped %u\n", frames,
			       emu_us / frames, pushed, (unsigned int)audio_queued(),
			       audio_underruns(), audio_starved(), audio_slab_waits(), skipped);
			frames = emu_us = pushed = skipped = 0;
			t_report = k_uptime_get();
		}
	}

	return 0;
}
```

## src/audio.c
```c
/*
 * Copyright (c) 2026 Yuzuki Tsuru
 * SPDX-License-Identifier: Apache-2.0
 */

/*
 * The emulation pushes resampled stereo frames into a ring; a thread cuts it
 * into blocks for the codec. The codec consumes at a fixed rate, so a full ring
 * is what slows the emulation down to real time.
 */

#include <errno.h>
#include <string.h>
#include <zephyr/audio/codec.h>
#include <zephyr/device.h>
#include <zephyr/drivers/i2s.h>
#include <zephyr/kernel.h>
#include <zephyr/sys/printk.h>
#include <zephyr/sys/ring_buffer.h>

#include "app.h"

#define BLOCK_FRAMES	512
#define BLOCK_BYTES	(BLOCK_FRAMES * 2 * sizeof(int16_t))
#define SLAB_BLOCKS	6
#define PREFILL		3
#define RING_BLOCKS	8

static const struct device *const i2s = DEVICE_DT_GET(DT_NODELABEL(audio_codec));
static const struct device *const ctl = DEVICE_DT_GET(DT_NODELABEL(codec_analog));

K_MEM_SLAB_DEFINE_STATIC(slab, BLOCK_BYTES, SLAB_BLOCKS, 4);
K_THREAD_STACK_DEFINE(audio_stack, 4096);
static struct k_thread thread;
RING_BUF_DECLARE(ring, RING_BLOCKS * BLOCK_BYTES);

static unsigned int rate;
static volatile unsigned int underruns, starved, slab_waits;

static void audio_main(void *a, void *b, void *c)
{
	struct i2s_config cfg = {
		.word_size = 16,
		.channels = 2,
		.format = I2S_FMT_DATA_FORMAT_I2S,
		.options = I2S_OPT_BIT_CLK_MASTER | I2S_OPT_FRAME_CLK_MASTER,
		.frame_clk_freq = rate,
		.mem_slab = &slab,
		.block_size = BLOCK_BYTES,
		.timeout = 2000,
	};
	bool running = false;
	int queued = 0;

	if (i2s_configure(i2s, I2S_DIR_TX, &cfg) != 0) {
		printk("audio: i2s_configure failed\n");
		return;
	}
	audio_codec_start_output(ctl);
	/* small speaker: digital volume raised from the default */
	audio_codec_set_property(ctl, AUDIO_PROPERTY_OUTPUT_VOLUME, AUDIO_CHANNEL_ALL,
				 (audio_property_value_t){.vol = 150});

	while (true) {
		void *blk;
		uint32_t n;
		int ret;

		if (ring_buf_size_get(&ring) < BLOCK_BYTES) {
			if (running) {
				starved++;
			}
			k_msleep(1);
			continue;
		}
		if (k_mem_slab_alloc(&slab, &blk, K_NO_WAIT) != 0) {
			slab_waits++;
			if (k_mem_slab_alloc(&slab, &blk, K_SECONDS(2)) != 0) {
				continue;
			}
		}
		n = ring_buf_get(&ring, blk, BLOCK_BYTES);
		__ASSERT_NO_MSG(n == BLOCK_BYTES);
		ret = i2s_write(i2s, blk, BLOCK_BYTES);
		if (ret == -EIO) {
			/* the stream ran dry: start it again */
			underruns++;
			running = false;
			queued = 0;
			k_mem_slab_free(&slab, blk);
			i2s_trigger(i2s, I2S_DIR_TX, I2S_TRIGGER_PREPARE);
			continue;
		} else if (ret != 0) {
			k_mem_slab_free(&slab, blk);
			continue;
		}
		if (!running && ++queued >= PREFILL &&
		    i2s_trigger(i2s, I2S_DIR_TX, I2S_TRIGGER_START) == 0) {
			running = true;
		}
	}
}

int audio_init(unsigned int out_rate)
{
	if (!device_is_ready(i2s) || !device_is_ready(ctl)) {
		return -ENODEV;
	}
	rate = out_rate;
	k_thread_create(&thread, audio_stack, K_THREAD_STACK_SIZEOF(audio_stack), audio_main, NULL, NULL, NULL,
			3, 0, K_NO_WAIT);
	k_thread_name_set(&thread, "audio");

	return 0;
}

size_t audio_push(const int16_t *pcm, size_t frames)
{
	return ring_buf_put(&ring, (const uint8_t *)pcm, frames * 4) / 4;
}

size_t audio_queued(void)
{
	return ring_buf_size_get(&ring) / 4;
}

unsigned int audio_underruns(void)
{
	return underruns;
}

unsigned int audio_starved(void)
{
	return starved;
}

unsigned int audio_slab_waits(void)
{
	return slab_waits;
}
```

## src/pad.c
```c
/*
 * Copyright (c) 2026 Yuzuki Tsuru
 * SPDX-License-Identifier: Apache-2.0
 */

/*
 * The keys of the console as translucent LVGL buttons on the ARGB plane, over
 * the game picture (which the video plane shows scaled to the panel).
 *
 * With a touch panel (the chosen zephyr,touch) the fingers are read straight from the input
 * events, one per touch slot, and each is matched against the buttons here: LVGL's pointer
 * handles one finger, a game needs the directions and a button at the same time. The buttons
 * only show the state.
 */

#include <lvgl.h>
#include <zephyr/devicetree.h>
#include <zephyr/kernel.h>
#include <zephyr/sys/atomic.h>
#include <gbsp_zephyr/gbsp.h>

#include "app.h"

#define HAS_TOUCH	DT_NODE_EXISTS(DT_CHOSEN(zephyr_touch))

#if HAS_TOUCH
#include <zephyr/input/input.h>
#endif

#define STACK_SIZE	4096
#define PRIORITY	7

K_THREAD_STACK_DEFINE(pad_stack, STACK_SIZE);
static struct k_thread thread;
static atomic_t keys;

#define MAX_KEYS	10
#define HIT_MARGIN	12
/*
 * The controller now and then reports a frame without the finger while it stays on the glass,
 * which would be a release and a new press: a key is held this long after its finger left.
 */
#define RELEASE_HOLD_MS	50

static struct pad_key {
	lv_obj_t *obj;
	int x, y, w, h;
	uint32_t bit;
	bool shown;
	uint32_t hold_until;
} pad_keys_tbl[MAX_KEYS];
static int nkeys;

#if HAS_TOUCH
#define TOUCH_SLOTS	5

static struct {
	int x, y;
	bool down;
} fingers[TOUCH_SLOTS];
static int cur_slot;

static void touch_event(struct input_event *evt, void *user_data)
{
	switch (evt->code) {
	case INPUT_ABS_MT_SLOT:
		cur_slot = CLAMP(evt->value, 0, TOUCH_SLOTS - 1);
		break;
	case INPUT_ABS_X:
		fingers[cur_slot].x = evt->value;
		break;
	case INPUT_ABS_Y:
		fingers[cur_slot].y = evt->value;
		break;
	case INPUT_BTN_TOUCH:
		fingers[cur_slot].down = evt->value != 0;
		break;
	}
}
INPUT_CALLBACK_DEFINE(DEVICE_DT_GET(DT_CHOSEN(zephyr_touch)), touch_event, NULL);

/* the keys that have a finger on them; also shows the state on the buttons */
static uint32_t touch_scan(void)
{
	uint32_t mask = 0;
	uint32_t now = k_uptime_get_32();

	for (int k = 0; k < nkeys; k++) {
		struct pad_key *key = &pad_keys_tbl[k];
		bool pressed = false;

		for (int f = 0; f < TOUCH_SLOTS; f++) {
			if (fingers[f].down && fingers[f].x >= key->x - HIT_MARGIN &&
			    fingers[f].x < key->x + key->w + HIT_MARGIN &&
			    fingers[f].y >= key->y - HIT_MARGIN &&
			    fingers[f].y < key->y + key->h + HIT_MARGIN) {
				pressed = true;
			}
		}
		if (pressed) {
			key->hold_until = now + RELEASE_HOLD_MS;
		} else if ((int32_t)(now - key->hold_until) < 0) {
			pressed = true;
		}
		if (pressed) {
			mask |= key->bit;
		}
		if (pressed != key->shown) {
			if (pressed) {
				lv_obj_add_state(key->obj, LV_STATE_PRESSED);
			} else {
				lv_obj_remove_state(key->obj, LV_STATE_PRESSED);
			}
			key->shown = pressed;
		}
	}

	return mask;
}
#endif /* HAS_TOUCH */

static void key_event(lv_event_t *e)
{
	uint32_t bit = (uint32_t)(uintptr_t)lv_event_get_user_data(e);

	/* only these events change a key: drawing and style events arrive while it is held */
	switch (lv_event_get_code(e)) {
	case LV_EVENT_PRESSED:
		atomic_or(&keys, bit);
		break;
	case LV_EVENT_RELEASED:
	case LV_EVENT_PRESS_LOST:
		atomic_and(&keys, ~bit);
		break;
	default:
		break;
	}
}

static void key_add(int x, int y, int w, int h, const char *text, uint32_t bit, int radius)
{
	lv_obj_t *b = lv_button_create(lv_screen_active());
	lv_obj_t *l = lv_label_create(b);

	lv_obj_set_size(b, w, h);
	lv_obj_align(b, LV_ALIGN_TOP_LEFT, x, y);
	lv_obj_set_style_radius(b, radius, 0);
	lv_obj_set_style_bg_color(b, lv_color_white(), 0);
	lv_obj_set_style_bg_opa(b, LV_OPA_30, 0);
	lv_obj_set_style_bg_color(b, lv_color_make(255, 200, 60), LV_STATE_PRESSED);
	lv_obj_set_style_bg_opa(b, LV_OPA_70, LV_STATE_PRESSED);
	lv_obj_set_style_border_color(b, lv_color_white(), 0);
	lv_obj_set_style_border_opa(b, LV_OPA_50, 0);
	lv_obj_set_style_border_width(b, 2, 0);
	lv_obj_set_style_shadow_width(b, 0, 0);
	lv_obj_set_style_text_font(l, &lv_font_montserrat_28, 0);
	lv_obj_set_style_text_color(l, lv_color_white(), 0);
	lv_label_set_text(l, text);
	lv_obj_center(l);
	lv_obj_add_event_cb(b, key_event, LV_EVENT_ALL, (void *)(uintptr_t)bit);

	if (nkeys < MAX_KEYS) {
		pad_keys_tbl[nkeys++] = (struct pad_key){
			.obj = b, .x = x, .y = y, .w = w, .h = h, .bit = bit,
		};
	}
}

static void pad_main(void *a, void *b, void *c)
{
	lv_obj_set_style_bg_opa(lv_screen_active(), LV_OPA_TRANSP, 0);

	/*
	 * The layout was drawn for a 1024x600 panel, the keys at the bottom stay at the bottom of
	 * a taller one. The picture fills the width of the panel and the keys are drawn over it.
	 */
	const int dy = lv_display_get_vertical_resolution(NULL) - 600;

	key_add(30, 330 + dy, 90, 90, LV_SYMBOL_LEFT, GBSP_KEY_LEFT, 20);
	key_add(210, 330 + dy, 90, 90, LV_SYMBOL_RIGHT, GBSP_KEY_RIGHT, 20);
	key_add(120, 240 + dy, 90, 90, LV_SYMBOL_UP, GBSP_KEY_UP, 20);
	key_add(120, 420 + dy, 90, 90, LV_SYMBOL_DOWN, GBSP_KEY_DOWN, 20);

	key_add(830, 360 + dy, 100, 100, "A", GBSP_KEY_A, LV_RADIUS_CIRCLE);
	key_add(720, 430 + dy, 100, 100, "B", GBSP_KEY_B, LV_RADIUS_CIRCLE);

	key_add(20, 20, 140, 70, "L", GBSP_KEY_L, 16);
	key_add(864, 20, 140, 70, "R", GBSP_KEY_R, 16);

	key_add(380, 520 + dy, 120, 60, "SELECT", GBSP_KEY_SELECT, 30);
	key_add(524, 520 + dy, 120, 60, "START", GBSP_KEY_START, 30);

	while (true) {
#if HAS_TOUCH
		atomic_set(&keys, touch_scan());
#endif
		lv_timer_handler();
		k_msleep(16);
	}
}

int pad_start(void)
{
	k_tid_t tid = k_thread_create(&thread, pad_stack, STACK_SIZE, pad_main, NULL, NULL, NULL,
				      PRIORITY, 0, K_NO_WAIT);

	k_thread_name_set(tid, "pad");

	return 0;
}

uint32_t pad_keys(void)
{
	return atomic_get(&keys);
}
```

## src/profile.c
```c
/*
 * Copyright (c) 2026 Yuzuki Tsuru
 * SPDX-License-Identifier: Apache-2.0
 */

/*
 * A poor man's profiler: a thread that preempts the emulation every
 * millisecond reads the program counter the emulation thread was interrupted
 * at, and after a while prints the busiest 64 byte blocks of code.
 */

#include <stdlib.h>
#include <zephyr/arch/exception.h>
#include <zephyr/kernel.h>
#include <zephyr/sys/printk.h>

#define MAX_SAMPLES	6000
#define CODE_LO		0x40000000UL
/* the translated code is a block of memory of its own: its samples are counted together and
 * printed as the address 0xffffffc0 */
#define JIT_MARK	0xffffffc0UL

extern char __rom_region_end[];
extern uint8_t *rom_translation_cache;
extern uint8_t *ram_translation_cache;

K_THREAD_STACK_DEFINE(prof_stack, 2048);
static struct k_thread prof_thread;
static uint32_t pcs[MAX_SAMPLES];

static int cmp(const void *a, const void *b)
{
	uint32_t x = *(const uint32_t *)a, y = *(const uint32_t *)b;

	return x < y ? -1 : (x > y);
}

static void prof_main(void *target, void *b, void *c)
{
	struct k_thread *t = target;
	int n = 0, bad = 0;

	k_sleep(K_SECONDS(CONFIG_SAMPLE_GBA_PROFILE_DELAY_S));
	while (n < MAX_SAMPLES) {
		const struct arch_esf *esf = (const struct arch_esf *)t->callee_saved.sp;
		unsigned long pc = esf->mepc;

		if (pc >= CODE_LO && pc < (unsigned long)__rom_region_end) {
			pcs[n++] = pc & ~63UL;
		} else if (pc >= (unsigned long)rom_translation_cache &&
			   pc < (unsigned long)rom_translation_cache + 2 * 1024 * 1024) {
			pcs[n++] = JIT_MARK;
		} else {
			bad++;
		}
		k_msleep(1);
	}
	qsort(pcs, n, sizeof(pcs[0]), cmp);
	printk("profile: %d samples, %d unusable\n", n, bad);
	for (int top = 0; top < 160; top++) {
		int best = -1, best_cnt = 0;

		for (int i = 0; i < n;) {
			int j = i;

			while (j < n && pcs[j] == pcs[i]) {
				j++;
			}
			if (pcs[i] != 0 && j - i > best_cnt) {
				best_cnt = j - i;
				best = i;
			}
			i = j;
		}
		if (best < 0) {
			break;
		}
		uint32_t v = pcs[best];

		printk("prof %08x %d\n", v, best_cnt);
		for (int i = best; i < n && pcs[i] == v; i++) {
			pcs[i] = 0;
		}
	}
}

void profile_start(struct k_thread *target)
{
	k_thread_create(&prof_thread, prof_stack, K_THREAD_STACK_SIZEOF(prof_stack), prof_main,
			target, NULL, NULL, 1, 0, K_NO_WAIT);
}
```

## src/video.c
```c
/*
 * Copyright (c) 2026 Yuzuki Tsuru
 * SPDX-License-Identifier: Apache-2.0
 */

/*
 * The frame of the console is RGB565 and goes to the scaling video plane of
 * the display engine as it is. The emulator draws the next frame into its own
 * buffer while the plane still scans out the last one, so each frame is copied
 * into one of three buffers (the one shown last stays valid for one more
 * refresh).
 */

#include <errno.h>
#include <stdlib.h>
#include <string.h>
#include <zephyr/cache.h>
#include <zephyr/device.h>
#include <zephyr/drivers/display/display_sunxi.h>
#include <zephyr/kernel.h>
#include <zephyr/sys/atomic.h>
#include <zephyr/sys/printk.h>
#include <gbsp_zephyr/gbsp.h>

#include "app.h"

#define STRIDE	(GBSP_WIDTH * 2)
#define BUF_SZ	ROUND_UP(GBSP_FRAME_BYTES, 64)
#define NBUF	4

static const struct device *const disp = DEVICE_DT_GET(DT_CHOSEN(zephyr_display));
static uint8_t *buf[NBUF];
/*
 * Who has which buffer: the emulator draws into `drawing`, hands it over as `ready`, the video
 * thread takes it (`inflight`) and when the display has switched to it, it is `shown`. A buffer
 * that is any of these is not given to the emulator, which at 60 fps can run several frames in a
 * row after a stall and would otherwise draw into the picture that is being scanned out.
 */
static int drawing = -1, ready = -1, inflight = -1, shown = -1;
static struct k_spinlock own_lock;
static unsigned int ready_w, ready_h;

K_SEM_DEFINE(frame_sem, 0, 1);
K_THREAD_STACK_DEFINE(video_stack, 8192);
static struct k_thread video_thread;

/*
 * Putting a picture up can wait for the next refresh; that must not hold the
 * emulation, which is paced by the sound. Only the newest picture is shown.
 */
static void video_main(void *a, void *b, void *c)
{
	bool warned = false;

	while (true) {
		struct display_sunxi_rgb img = {.width = 0};
		int idx = 0, ret;

		k_sem_take(&frame_sem, K_FOREVER);
		K_SPINLOCK(&own_lock) {
			idx = ready;
			inflight = idx;
		}
		img.data = buf[idx];
		img.width = ready_w;
		img.height = ready_h;
		img.stride = STRIDE;
		img.nonblock = false;
		ret = display_sunxi_show_rgb(disp, &img);
		K_SPINLOCK(&own_lock) {
			shown = idx;
			inflight = -1;
		}
		if (ret != 0 && !warned) {
			printk("video: show_rgb failed: %d\n", ret);
			warned = true;
		}
	}
}

int video_init(void)
{
	if (!device_is_ready(disp)) {
		return -ENODEV;
	}
	for (int i = 0; i < NBUF; i++) {
		buf[i] = aligned_alloc(64, BUF_SZ);
		if (buf[i] == NULL) {
			return -ENOMEM;
		}
	}
	k_thread_create(&video_thread, video_stack, K_THREAD_STACK_SIZEOF(video_stack), video_main,
			NULL, NULL, NULL, 5, 0, K_NO_WAIT);
	k_thread_name_set(&video_thread, "video");

	return 0;
}

uint16_t *video_acquire(void)
{
	int pick = -1;

	K_SPINLOCK(&own_lock) {
		for (int i = 0; i < NBUF; i++) {
			if (i != ready && i != inflight && i != shown) {
				pick = i;
				break;
			}
		}
		drawing = pick;
	}

	return (uint16_t *)buf[pick];
}

void video_present(unsigned int width, unsigned int height)
{
	sys_cache_data_flush_range(buf[drawing], STRIDE * height);
	ready_w = width;
	ready_h = height;
	K_SPINLOCK(&own_lock) {
		ready = drawing;
	}
	k_sem_give(&frame_sem);
}
```
