## CMakeLists.txt
```
# SPDX-License-Identifier: Apache-2.0

cmake_minimum_required(VERSION 3.20.0)
# the litehtml module is two directories up
list(APPEND ZEPHYR_EXTRA_MODULES ${CMAKE_CURRENT_SOURCE_DIR}/../..)

find_package(Zephyr REQUIRED HINTS $ENV{ZEPHYR_BASE})
project(html_viewer)

target_sources(app PRIVATE src/main.c src/chunked.c src/assets.c)
```

## Kconfig
```
# SPDX-License-Identifier: Apache-2.0

mainmenu "HTML viewer"

config SAMPLE_HTML_FILE
	string "Page to show"
	default "/SD:/page.html"
	help
	  The page on the SD card. When it does not exist the first .html or .htm
	  file in the root of the card is used, and a built in page when there is none.

config SAMPLE_HTML_SCROLL_PX
	int "Pixels the page scrolls every frame (0: no scrolling)"
	default 2
	help
	  There is no input device bound yet, a long page scrolls by itself and
	  starts over at the end.

config SAMPLE_HTML_CHUNK_KB
	int "Size of the pieces a page is cut into, in KiB (0: the page is laid out as a whole)"
	default 12
	help
	  A page is read once to find the ends of the children of <body>; a piece ends at the first
	  one that ends after this many bytes. Only the piece on the screen and the next one are in
	  memory. A piece needs a few MiB for the tree, a page of dense markup takes more.

config SAMPLE_HTML_BENCH
	bool "Load every page_*.html of the card, smallest first, and print time and memory"
	help
	  A page is skipped when the memory used per byte of the earlier ones says it will not
	  fit. The normal viewer starts afterwards.

config SAMPLE_HTML_PAGED_MB
	int "Size of the paged heap in MiB"
	depends on LITEHTML_PAGED_HEAP
	default 200
	help
	  Virtual size of the region that holds the page; the swap file
	  (/SD:/swap.bin) grows up to the part that is used.

source "Kconfig.zephyr"
```

## prj.conf
```kconfig
CONFIG_CPP=y
CONFIG_STD_CPP17=y
CONFIG_LITEHTML=y
CONFIG_STATIC_INIT_GNU=y

CONFIG_SDHC=y
CONFIG_DISK_ACCESS=y
CONFIG_DISK_DRIVER_SDMMC=y
CONFIG_FILE_SYSTEM=y
CONFIG_FAT_FILESYSTEM_ELM=y
CONFIG_FS_FATFS_EXFAT=y
CONFIG_FS_FATFS_LFN=y
CONFIG_FS_FATFS_LFN_MODE_STACK=y

CONFIG_DISPLAY=y
CONFIG_CHARACTER_FRAMEBUFFER=y
CONFIG_CHARACTER_FRAMEBUFFER_USE_DEFAULT_FONTS=y

CONFIG_LOG=y
CONFIG_LOG_PRINTK=n
CONFIG_PRINTK=y
CONFIG_SHELL=n
CONFIG_DEVMEM_SHELL=n
CONFIG_FPU=y
CONFIG_FPU_SHARING=y
CONFIG_MAIN_STACK_SIZE=65536
CONFIG_COMMON_LIBC_MALLOC_ARENA_SIZE=-1
CONFIG_HEAP_MEM_POOL_SIZE=262144

# drivers the viewer does not use
CONFIG_G2D=n
CONFIG_USB_PHY_SUNXI=n
CONFIG_ADC=n
CONFIG_SPI=n
CONFIG_I2C=n
CONFIG_MIPI_DBI=n
CONFIG_WDT_SUNXI=n
CONFIG_VDEC=n
CONFIG_I2S=n
CONFIG_AUDIO=n
CONFIG_DMA=y
CONFIG_GPIO=y
```

## paged.conf
```kconfig
# The page lives in demand paged memory that is swapped to a file of the card.
# Build with -DEXTRA_CONF_FILE=paged.conf
CONFIG_SUN252I_F101_MMU=y
CONFIG_DEMAND_PAGING=y
CONFIG_DEMAND_PAGING_ALLOW_IRQ=y
CONFIG_DEMAND_PAGING_STATS=y
CONFIG_EVICTION_LRU=y
CONFIG_BACKING_STORE_SWAP=y
CONFIG_LITEHTML_PAGED_HEAP=y
# room for the paged region next to the image
CONFIG_KERNEL_VM_SIZE=0x10000000
# a finite arena: the frames of the display engine and the buffers of the drivers; the rest of
# the RAM is page frames for the pager
CONFIG_COMMON_LIBC_MALLOC_ARENA_SIZE=5242880
```

## src/main.c
```c
/*
 * Copyright (c) 2026 Yuzuki Tsuru
 * SPDX-License-Identifier: Apache-2.0
 */

/*
 * Shows an HTML page from the SD card (or a built in one) on the LCD, rendered by litehtml.
 * A page that is taller than the screen scrolls by itself.
 */

#include <ff.h>
#include <stdlib.h>
#include <string.h>
#include <zephyr/cache.h>
#include <zephyr/device.h>
#include <zephyr/drivers/display/display_sunxi.h>
#include <zephyr/fs/fs.h>
#include <zephyr/kernel.h>
#include <zephyr/sys/printk.h>
#include <litehtml_zephyr/lh.h>
#include "assets.h"
#include "chunked.h"
#ifdef CONFIG_LITEHTML_PAGED_HEAP
#include <zephyr/kernel/mm/demand_paging.h>
#include <litehtml_zephyr/lh_paged.h>
#endif

#define W 1024
#define H 600
#define BG 0xffff

extern const uint8_t cfb_font_1016[95][20];

static const struct device *const disp = DEVICE_DT_GET(DT_CHOSEN(zephyr_display));

static FATFS fat_fs;
static struct fs_mount_t mp = {
	.type = FS_FATFS,
	.fs_data = &fat_fs,
	.mnt_point = "/SD:",
};

static const char builtin_page[] =
	"<html><head><title>litehtml</title><style>"
	"body{margin:24px;background:#f4f6fb;color:#222}"
	"h1{color:#1a4fa0}.box{background:#fff;border:2px solid #1a4fa0;padding:12px}"
	"</style></head><body><h1>litehtml on the F101</h1>"
	"<div class=\"box\"><p>No page found on the SD card. Put a <b>page.html</b> in the root "
	"of the card.</p></div></body></html>";

static bool has_suffix_nocase(const char *name, const char *suffix)
{
	size_t n = strlen(name), e = strlen(suffix);

	if (n <= e) {
		return false;
	}
	for (size_t i = 0; i < e; i++) {
		char c = name[n - e + i];

		if (c >= 'A' && c <= 'Z') {
			c += 'a' - 'A';
		}
		if (c != suffix[i]) {
			return false;
		}
	}
	return true;
}

static bool name_is_html(const char *name)
{
	return has_suffix_nocase(name, ".html") || has_suffix_nocase(name, ".htm");
}

/* the configured file, else the first .html/.htm in the root of the card */
static bool pick_file(char *path, size_t size)
{
	struct fs_dirent ent;
	struct fs_dir_t dir;

	strncpy(path, CONFIG_SAMPLE_HTML_FILE, size - 1);
	path[size - 1] = '\0';
	if (fs_stat(path, &ent) == 0) {
		return true;
	}
	fs_dir_t_init(&dir);
	if (fs_opendir(&dir, "/SD:") != 0) {
		return false;
	}
	while (fs_readdir(&dir, &ent) == 0 && ent.name[0] != '\0') {
		if (ent.type == FS_DIR_ENTRY_FILE && name_is_html(ent.name)) {
			snprintk(path, size, "/SD:/%s", ent.name);
			fs_closedir(&dir);
			return true;
		}
	}
	fs_closedir(&dir);
	return false;
}

/*
 * The text goes through a buffer outside of the paged region: the file system must not take a
 * page fault while it holds its lock, and a page fault does file system work of its own.
 */
static uint8_t chunk[32768] __aligned(64);

#ifdef CONFIG_LITEHTML_PAGED_HEAP
static bool paged_ok;
#endif

static void paged(bool on)
{
#ifdef CONFIG_LITEHTML_PAGED_HEAP
	if (paged_ok) {
		lh_paged_heap_enable(on);
	}
#else
	ARG_UNUSED(on);
#endif
}

static char *read_file(const char *path)
{
	struct fs_dirent ent;
	struct fs_file_t f;
	char *buf;
	size_t done = 0;

	if (fs_stat(path, &ent) != 0) {
		return NULL;
	}
	paged(true);
	buf = malloc(ent.size + 1);
	paged(false);
	if (buf == NULL) {
		return NULL;
	}
	fs_file_t_init(&f);
	if (fs_open(&f, path, FS_O_READ) != 0) {
		free(buf);
		return NULL;
	}
	while (done < ent.size) {
		ssize_t n = fs_read(&f, chunk, MIN(sizeof(chunk), ent.size - done));

		if (n <= 0) {
			break;
		}
		memcpy(buf + done, chunk, n);
		done += n;
	}
	fs_close(&f);
	buf[done] = '\0';
	return buf;
}

static struct lh_page *load_page(const struct lh_font *font, const char *html)
{
	struct lh_page *page;

	paged(true);
	page = lh_load(font, html, W, H);
	paged(false);
	return page;
}

static void draw_page(struct lh_page *page, uint16_t *fb, int scroll)
{
	paged(true);
	lh_draw(page, fb, W, W, H, scroll, BG);
	paged(false);
}

/* the largest block malloc can still give, which is about the free heap while it is not fragmented */
static size_t largest_free(void)
{
	size_t lo = 0, hi = 16U << 20;

	while (hi - lo > 4096) {
		size_t mid = (lo + hi) / 2;
		void *p = malloc(mid);

		if (p != NULL) {
			free(p);
			lo = mid;
		} else {
			hi = mid;
		}
	}
	return lo;
}

/* what a page can still use: the paged heap when there is one, else the normal heap */
static size_t avail(void)
{
#ifdef CONFIG_LITEHTML_PAGED_HEAP
	struct lh_paged_stats st;

	if (!paged_ok) {
		return largest_free();
	}
	lh_paged_heap_stats(&st);
	return st.free;
#else
	return largest_free();
#endif
}

static size_t in_use(void)
{
#ifdef CONFIG_LITEHTML_PAGED_HEAP
	struct lh_paged_stats st;

	if (!paged_ok) {
		return 0;
	}
	lh_paged_heap_stats(&st);
	return st.allocated;
#else
	return 0;
#endif
}

static void paging_report(const char *what)
{
#ifdef CONFIG_DEMAND_PAGING_STATS
	struct k_mem_paging_stats_t ps;

	k_mem_paging_stats_get(&ps);
	printk("paging: %s: %lu faults, %lu clean and %lu dirty pages evicted\n", what,
	       ps.pagefaults.cnt, ps.eviction.clean, ps.eviction.dirty);
#else
	ARG_UNUSED(what);
#endif
}

#ifdef CONFIG_SAMPLE_HTML_BENCH
struct bench_file {
	char name[64];
	size_t size;
};

static int bench_cmp(const void *a, const void *b)
{
	const struct bench_file *x = a, *y = b;

	return x->size < y->size ? -1 : x->size > y->size;
}

static void bench_all(const struct lh_font *font)
{
	static struct bench_file files[16];
	struct fs_dirent ent;
	struct fs_dir_t dir;
	int n = 0;
	uint16_t *fb = aligned_alloc(64, W * H * sizeof(uint16_t));
	size_t base_use;
	/* bytes used per KiB of page by the biggest one that worked, in 1/1024 */
	size_t per_kib = 0;

	fs_dir_t_init(&dir);
	if (fb == NULL || fs_opendir(&dir, "/SD:") != 0) {
		return;
	}
	while (n < ARRAY_SIZE(files) && fs_readdir(&dir, &ent) == 0 && ent.name[0] != '\0') {
		if (ent.type == FS_DIR_ENTRY_FILE && strncmp(ent.name, "page_", 5) == 0 &&
		    name_is_html(ent.name)) {
			strncpy(files[n].name, ent.name, sizeof(files[n].name) - 1);
			files[n].size = ent.size;
			n++;
		}
	}
	fs_closedir(&dir);
	qsort(files, n, sizeof(files[0]), bench_cmp);
	base_use = in_use();
	printk("bench: %d pages, %u KiB of heap free\n", n, (unsigned int)(avail() >> 10));

	for (int i = 0; i < n; i++) {
		char path[96];
		size_t size = files[i].size, free_now = avail();
		struct lh_page *page;
		char *html;
		int64_t t0;
		size_t used, before = largest_free();

		snprintk(path, sizeof(path), "/SD:/%s", files[i].name);
		/* the text stays in memory while the page is built */
		if (size + 1 > free_now ||
		    (per_kib != 0 && size + (size / 1024) * per_kib * 12 / 10 > free_now)) {
			printk("bench: %s %u KiB: does not fit (%u KiB free, %u bytes of heap per byte of page)\n",
			       files[i].name, (unsigned int)(size >> 10), (unsigned int)(free_now >> 10),
			       (unsigned int)(per_kib / 1024));
			continue;
		}
		t0 = k_uptime_get();
		html = read_file(path);
		if (html == NULL) {
			printk("bench: %s: read failed\n", files[i].name);
			continue;
		}
		printk("bench: %s %u KiB: read in %d ms\n", files[i].name, (unsigned int)(size >> 10),
		       (int)(k_uptime_get() - t0));
		paging_report("after the read");
		t0 = k_uptime_get();
		page = load_page(font, html);
		if (page == NULL) {
			printk("bench: %s: lh_load failed\n", files[i].name);
			free(html);
			continue;
		}
		printk("bench: %s: parsed and laid out in %d ms, %d px high\n", files[i].name,
		       (int)(k_uptime_get() - t0), lh_content_height(page));
		paging_report("after the parse");
		free(html);
		used = in_use() != 0 ? in_use() - base_use : before - largest_free();
		per_kib = used * 1024 / size;
		printk("bench: %s: heap used %u KiB (%u bytes per byte of page)\n", files[i].name,
		       (unsigned int)(used >> 10), (unsigned int)(per_kib / 1024));
		for (int k = 0; k < 3; k++) {
			static const char *const where[] = {"top", "middle", "top again"};

			t0 = k_uptime_get();
			draw_page(page, fb, k == 1 ? lh_content_height(page) / 2 : 0);
			printk("bench: %s: frame at %s in %d ms\n", files[i].name, where[k],
			       (int)(k_uptime_get() - t0));
		}
		paging_report("after the frames");
#ifdef CONFIG_LITEHTML_PAGED_HEAP
		if (paged_ok) {
			/* the frees would read the whole tree back: drop the heap instead */
			lh_paged_heap_discard_frees(true);
			lh_free(page);
			lh_paged_heap_discard_frees(false);
			lh_paged_heap_reset();
		} else
#endif
		{
			lh_free(page);
		}
		printk("bench: %s: after the free %u KiB are used\n", files[i].name,
		       (unsigned int)((in_use() - base_use) >> 10));
		paging_report("after the free");
	}
	free(fb);
	printk("bench: done\n");
}
#endif

int main(void)
{
	static const struct lh_font font = {
		.glyphs = cfb_font_1016, .first = 32, .last = 126, .cell_w = 10, .cell_h = 16,
	};
	char path[128];
	char *html = NULL;
	const char *source = "built in";
	struct lh_page *page;
	/* two frames: the one on the screen is never drawn into, or the scan out sees it half done */
	uint16_t *fbs[2];
	int cur = 0;
	int64_t t0;
	int height, scroll = 0, dir = 1;

	if (!device_is_ready(disp)) {
		printk("display not ready\n");
		return 0;
	}
	size_t heap0 = largest_free();

	printk("heap: %u KiB free at the start\n", (unsigned int)(heap0 >> 10));
	/* the frames are for the display engine: they come from the normal heap */
	for (int i = 0; i < 2; i++) {
		fbs[i] = aligned_alloc(64, W * H * sizeof(uint16_t));
		if (fbs[i] == NULL) {
			printk("no memory for the frames\n");
			return 0;
		}
	}
	/* the card needs a moment after the power up */
	int mounted = -1;

	for (int i = 0; i < 10 && mounted != 0; i++) {
		mounted = fs_mount(&mp);
		if (mounted != 0) {
			k_msleep(300);
		}
	}
#ifdef CONFIG_LITEHTML_PAGED_HEAP
	if (mounted == 0) {
		int r = lh_paged_heap_init("/SD:/swap.bin", (size_t)CONFIG_SAMPLE_HTML_PAGED_MB << 20);

		paged_ok = (r == 0);
		printk("paged heap of %d MiB: %d\n", CONFIG_SAMPLE_HTML_PAGED_MB, r);
	}
#endif
	if (mounted != 0) {
		printk("cannot mount the SD card: %d\n", mounted);
	} else if (!pick_file(path, sizeof(path))) {
		printk("no .html file on the SD card\n");
	} else {
		assets_init(path);
#if CONFIG_SAMPLE_HTML_CHUNK_KB > 0
		/* returns only when the page cannot be shown piece by piece */
		chunked_run(path, &font, disp, fbs);
		printk("chunked viewer failed, trying the page as a whole\n");
#endif
		html = read_file(path);
		if (html != NULL) {
			source = path;
		}
	}
#ifdef CONFIG_SAMPLE_HTML_BENCH
	if (mounted == 0) {
		bench_all(&font);
	}
#endif
	printk("page: %s\n", source);

	t0 = k_uptime_get();
	page = load_page(&font, html != NULL ? html : builtin_page);
	if (page == NULL) {
		printk("lh_load failed\n");
		return 0;
	}
	height = lh_content_height(page);
	printk("page: \"%s\", %d px high, parsed and laid out in %d ms\n", lh_title(page), height,
	       (int)(k_uptime_get() - t0));
	free(html);
	printk("heap: page and library use %u KiB (%u KiB of the normal heap free)\n",
	       (unsigned int)(in_use() != 0 ? in_use() >> 10 : (heap0 - largest_free()) >> 10),
	       (unsigned int)(largest_free() >> 10));
	paging_report("page loaded");
	assets_report();

	while (true) {
		uint16_t *fb = fbs[cur];
		struct display_sunxi_rgb img = {
			.data = fb, .width = W, .height = H, .stride = W * 2,
		};
		int max_scroll = MAX(0, height - H);
		int ret;

		t0 = k_uptime_get();
		draw_page(page, fb, scroll);
		sys_cache_data_flush_range(fb, W * H * sizeof(uint16_t));
		if (scroll == 0 || scroll >= max_scroll) {
			printk("page: drawn in %d ms\n", (int)(k_uptime_get() - t0));
		}
		/* returns when the new frame is on the screen: the other one is free again */
		ret = display_sunxi_show_rgb(disp, &img);
		if (ret != 0) {
			printk("show_rgb failed: %d\n", ret);
			return 0;
		}
		cur ^= 1;
		if (max_scroll == 0 || CONFIG_SAMPLE_HTML_SCROLL_PX == 0) {
			k_sleep(K_SECONDS(1));
			continue;
		}
		scroll += dir * CONFIG_SAMPLE_HTML_SCROLL_PX;
		if (scroll >= max_scroll) {
			scroll = max_scroll;
			dir = -1;
			k_sleep(K_SECONDS(2));
		} else if (scroll <= 0) {
			scroll = 0;
			dir = 1;
			k_sleep(K_SECONDS(2));
		}
	}
}
```

## src/assets.c
```c
/*
 * Copyright (c) 2026 Yuzuki Tsuru
 * SPDX-License-Identifier: Apache-2.0
 */

/*
 * The pictures and the extra glyphs of a page made by tools/scrape_page.py: files next to the
 * page (img/*.lhi, font.lhf). The pictures are cached up to a limit and the oldest ones are
 * dropped.
 */

#include <stdlib.h>
#include <string.h>
#include <zephyr/fs/fs.h>
#include <zephyr/kernel.h>
#include <zephyr/sys/printk.h>
#include <litehtml_zephyr/lh.h>

#include "assets.h"

#define CACHE_ENTRIES 40
#define CACHE_LIMIT (6U << 20)

struct entry {
	char name[96];
	uint16_t *px;
	int w, h;
	size_t size;
	uint32_t used;
};

static char dir[96];
static struct entry cache[CACHE_ENTRIES];
static size_t cached;
static uint32_t tick;
static int loaded, evicted;

static uint8_t *read_all(const char *path, size_t *size)
{
	struct fs_dirent st;
	struct fs_file_t f;
	uint8_t *buf;
	size_t done = 0;

	if (fs_stat(path, &st) != 0) {
		return NULL;
	}
	buf = malloc(st.size + 1);
	if (buf == NULL) {
		return NULL;
	}
	fs_file_t_init(&f);
	if (fs_open(&f, path, FS_O_READ) != 0) {
		free(buf);
		return NULL;
	}
	while (done < st.size) {
		ssize_t n = fs_read(&f, buf + done, MIN(st.size - done, (size_t)32768));

		if (n <= 0) {
			break;
		}
		done += n;
	}
	fs_close(&f);
	*size = done;
	return buf;
}

static void drop(struct entry *e)
{
	cached -= e->size;
	free(e->px);
	memset(e, 0, sizeof(*e));
	evicted++;
}

static struct entry *oldest(void)
{
	struct entry *o = NULL;

	for (int i = 0; i < CACHE_ENTRIES; i++) {
		if (cache[i].px != NULL && (o == NULL || cache[i].used < o->used)) {
			o = &cache[i];
		}
	}
	return o;
}

/* a name that is not in the cache is read from the card; a failed read is remembered */
static const uint16_t *image_cb(void *user, const char *src, int *w, int *h)
{
	struct entry *e = NULL, *slot = NULL;
	char path[160];
	uint8_t *raw;
	size_t n;

	ARG_UNUSED(user);
	for (int i = 0; i < CACHE_ENTRIES; i++) {
		if (strcmp(cache[i].name, src) == 0 && cache[i].name[0] != '\0') {
			e = &cache[i];
			break;
		}
		if (slot == NULL && cache[i].name[0] == '\0') {
			slot = &cache[i];
		}
	}
	if (e != NULL) {
		e->used = ++tick;
		if (e->px == NULL) {
			return NULL;
		}
		*w = e->w;
		*h = e->h;
		return e->px;
	}
	if (slot == NULL) {
		slot = oldest();
		if (slot == NULL) {
			return NULL;
		}
		drop(slot);
	}
	snprintk(path, sizeof(path), "%s/%s", dir, src);
	raw = read_all(path, &n);
	strncpy(slot->name, src, sizeof(slot->name) - 1);
	slot->used = ++tick;
	if (raw == NULL || n < 8 || memcmp(raw, "LHI1", 4) != 0) {
		free(raw);
		return NULL;
	}
	slot->w = raw[4] | raw[5] << 8;
	slot->h = raw[6] | raw[7] << 8;
	if (n < 8 + (size_t)slot->w * slot->h * 2) {
		free(raw);
		return NULL;
	}
	/* make room, never by dropping this one */
	while (cached + n > CACHE_LIMIT) {
		struct entry *o = oldest();

		if (o == NULL) {
			break;
		}
		drop(o);
	}
	/* the pixels start 8 bytes into the file: keep the buffer and point into it */
	memmove(raw, raw + 8, n - 8);
	slot->px = (uint16_t *)raw;
	slot->size = n;
	cached += n;
	loaded++;
	*w = slot->w;
	*h = slot->h;
	return slot->px;
}

void assets_init(const char *html_path)
{
	char path[160];
	size_t n;
	uint8_t *font;

	strncpy(dir, html_path, sizeof(dir) - 1);
	char *slash = strrchr(dir, '/');

	if (slash != NULL) {
		*slash = '\0';
	}
	snprintk(path, sizeof(path), "%s/font.lhf", dir);
	font = read_all(path, &n);
	if (font != NULL) {
		lh_set_cjk_font(font, n);
		printk("assets: extra glyphs from %s (%u KiB)\n", path, (unsigned int)(n >> 10));
	}
	lh_set_image_loader(image_cb, NULL);
	printk("assets: images from %s/img\n", dir);
}

void assets_report(void)
{
	printk("assets: %u KiB of images cached, %d loaded, %d dropped\n", (unsigned int)(cached >> 10),
	       loaded, evicted);
}
```

## src/assets.h
```c
/*
 * Copyright (c) 2026 Yuzuki Tsuru
 * SPDX-License-Identifier: Apache-2.0
 */

#ifndef ASSETS_H_
#define ASSETS_H_

/** Use the pictures and glyphs that sit next to the page (its directory) */
void assets_init(const char *html_path);

void assets_report(void);

#endif /* ASSETS_H_ */
```

## src/chunked.c
```c
/*
 * Copyright (c) 2026 Yuzuki Tsuru
 * SPDX-License-Identifier: Apache-2.0
 */

/*
 * A page that does not fit the memory as a whole: the file is read once to find its pieces
 * (lh_index_scan), and only the piece that is on the screen and the one after it are laid out.
 * Every piece is a page of its own, made of the style sheets of the head, the <body> tag and the
 * text of the piece. The page scrolls by itself, from the first piece to the last and then
 * again.
 */

#include <stdlib.h>
#include <string.h>
#include <zephyr/cache.h>
#include <zephyr/device.h>
#include <zephyr/drivers/display/display_sunxi.h>
#include <zephyr/fs/fs.h>
#include <zephyr/kernel.h>
#include <zephyr/sys/printk.h>
#include <litehtml_zephyr/lh.h>

#include "chunked.h"

#define W 1024
#define H 600
#define BG 0xffff

static struct lh_index ix;
static struct fs_file_t file;
static char *css;
static size_t css_len;

struct piece {
	struct lh_page *page;
	int idx;
	int height;
};

static int read_cb(void *user, uint32_t off, void *buf, uint32_t len)
{
	ARG_UNUSED(user);
	if (fs_seek(&file, off, FS_SEEK_SET) != 0) {
		return -1;
	}
	return fs_read(&file, buf, len) == (ssize_t)len ? 0 : -1;
}

static bool read_css(void)
{
	size_t total = 0;

	for (int i = 0; i < ix.n_css; i++) {
		total += ix.css[i].length;
	}
	css = malloc(total + 1);
	if (css == NULL) {
		return false;
	}
	for (int i = 0; i < ix.n_css; i++) {
		if (read_cb(NULL, ix.css[i].offset, css + css_len, ix.css[i].length) != 0) {
			return false;
		}
		css_len += ix.css[i].length;
	}
	css[css_len] = '\0';
	return true;
}

/* the text of piece idx as a page of its own */
static char *piece_text(int idx)
{
	static const char head[] = "<html><head><meta charset=\"utf-8\"><style>";
	static const char mid[] = "</style></head>";
	static const char tail[] = "</body></html>";
	const char *body = ix.body_tag[0] != '\0' ? ix.body_tag : "<body>";
	size_t n = ix.chunks[idx].length;
	size_t total = sizeof(head) + css_len + sizeof(mid) + strlen(body) + n + sizeof(tail);
	char *t = malloc(total), *p;

	if (t == NULL) {
		return NULL;
	}
	p = t;
	memcpy(p, head, sizeof(head) - 1);
	p += sizeof(head) - 1;
	memcpy(p, css, css_len);
	p += css_len;
	memcpy(p, mid, sizeof(mid) - 1);
	p += sizeof(mid) - 1;
	memcpy(p, body, strlen(body));
	p += strlen(body);
	if (read_cb(NULL, ix.chunks[idx].offset, p, n) != 0) {
		free(t);
		return NULL;
	}
	p += n;
	memcpy(p, tail, sizeof(tail));
	return t;
}

static bool load_piece(const struct lh_font *font, int idx, struct piece *pc)
{
	int64_t t0 = k_uptime_get();
	char *text = piece_text(idx);

	if (text == NULL) {
		printk("chunk %d: no memory for the text\n", idx);
		return false;
	}
	pc->page = lh_load(font, text, W, H);
	free(text);
	if (pc->page == NULL) {
		printk("chunk %d: lh_load failed\n", idx);
		return false;
	}
	pc->idx = idx;
	pc->height = lh_content_height(pc->page);
	printk("chunk %d/%d: %u bytes, %d px high, loaded in %d ms\n", idx, ix.n_chunks,
	       (unsigned int)ix.chunks[idx].length, pc->height, (int)(k_uptime_get() - t0));
	return true;
}

static void drop_piece(struct piece *pc)
{
	if (pc->page != NULL) {
		lh_free(pc->page);
		pc->page = NULL;
	}
}

int chunked_run(const char *path, const struct lh_font *font, const struct device *disp,
		uint16_t *fbs[2])
{
	struct fs_dirent st;
	struct piece cur = {0}, next = {0};
	int64_t t0;
	int n, y = 0, shown = 0, cur_buf = 0;

	if (fs_stat(path, &st) != 0) {
		return -1;
	}
	fs_file_t_init(&file);
	if (fs_open(&file, path, FS_O_READ) != 0) {
		return -1;
	}
	t0 = k_uptime_get();
	n = lh_index_scan(read_cb, NULL, st.size, CONFIG_SAMPLE_HTML_CHUNK_KB * 1024U, &ix);
	if (n < 0 || !read_css()) {
		printk("chunked: cannot scan %s\n", path);
		return -1;
	}
	printk("chunked: %s, %u KiB in %d pieces of about %d KiB, scanned in %d ms, %u bytes of css\n",
	       path, (unsigned int)(st.size >> 10), n, CONFIG_SAMPLE_HTML_CHUNK_KB,
	       (int)(k_uptime_get() - t0), (unsigned int)css_len);

	if (!load_piece(font, 0, &cur)) {
		return -1;
	}
	while (true) {
		uint16_t *fb = fbs[cur_buf];
		struct display_sunxi_rgb img = {.data = fb, .width = W, .height = H, .stride = W * 2};

		/* the next piece is laid out before the end of this one is on the screen */
		if (next.page == NULL && cur.idx + 1 < n && y + 2 * H > cur.height) {
			if (!load_piece(font, cur.idx + 1, &next)) {
				return -1;
			}
		}

		t0 = k_uptime_get();
		lh_draw(cur.page, fb, W, W, H, y, BG);
		if (next.page != NULL && y + H > cur.height) {
			lh_draw_over(next.page, fb, W, W, H, y - cur.height);
		}
		sys_cache_data_flush_range(fb, W * H * sizeof(uint16_t));
		if ((shown++ % 60) == 0) {
			printk("chunked: piece %d y %d drawn in %d ms\n", cur.idx, y,
			       (int)(k_uptime_get() - t0));
		}
		if (display_sunxi_show_rgb(disp, &img) != 0) {
			printk("show_rgb failed\n");
			return -1;
		}
		cur_buf ^= 1;

		y += CONFIG_SAMPLE_HTML_SCROLL_PX;
		if (y >= cur.height) {
			/* the next piece is at the top now */
			y -= cur.height;
			drop_piece(&cur);
			if (next.page != NULL) {
				cur = next;
				next.page = NULL;
			} else {
				/* the end: start again */
				printk("chunked: the end of the page, starting again\n");
				k_sleep(K_SECONDS(2));
				y = 0;
				if (!load_piece(font, 0, &cur)) {
					return -1;
				}
			}
		}
	}
}
```

## src/chunked.h
```c
/*
 * Copyright (c) 2026 Yuzuki Tsuru
 * SPDX-License-Identifier: Apache-2.0
 */

#ifndef CHUNKED_H_
#define CHUNKED_H_

#include <stdint.h>
#include <zephyr/device.h>
#include <litehtml_zephyr/lh.h>

/**
 * Show the page in the file piece by piece and scroll it. Returns only on an error.
 */
int chunked_run(const char *path, const struct lh_font *font, const struct device *disp,
		uint16_t *fbs[2]);

#endif /* CHUNKED_H_ */
```
