/*
 * Copyright (c) 2026 Yuzuki Tsuru
 * SPDX-License-Identifier: Apache-2.0
 *
 * What litehtml and the C++ headers it is built with need from the C library and the
 * minimal C library of the image does not have. The library is compiled against the
 * headers of the toolchain's C library, whose character classification macros read the
 * table _ctype_ (flags: 1 upper, 2 lower, 4 digit, 8 space, 16 punct, 32 control,
 * 64 hex digit, 128 blank, index is the character plus one, ASCII only).
 */

#include <errno.h>
#include <zephyr/toolchain.h>
#include <stddef.h>
#include <string.h>

const char _ctype_[257] = {
	0x00, 0x20, 0x20, 0x20, 0x20, 0x20, 0x20, 0x20, 0x20, 0x20, 0x28, 0x28, 0x28, 0x28, 0x28, 0x20,
	0x20, 0x20, 0x20, 0x20, 0x20, 0x20, 0x20, 0x20, 0x20, 0x20, 0x20, 0x20, 0x20, 0x20, 0x20, 0x20,
	0x20, 0x88, 0x10, 0x10, 0x10, 0x10, 0x10, 0x10, 0x10, 0x10, 0x10, 0x10, 0x10, 0x10, 0x10, 0x10,
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	0x00,
};

#define CT(c) ((c) >= 0 && (c) < 128 ? _ctype_[(c) + 1] : 0)

__weak int isalnum(int c) { return CT(c) & (1 | 2 | 4); }
__weak int isalpha(int c) { return CT(c) & (1 | 2); }
__weak int isdigit(int c) { return CT(c) & 4; }
__weak int isupper(int c) { return CT(c) & 1; }
__weak int islower(int c) { return CT(c) & 2; }
__weak int isspace(int c) { return CT(c) & 8; }
__weak int ispunct(int c) { return CT(c) & 16; }
__weak int iscntrl(int c) { return CT(c) & 32; }
__weak int isxdigit(int c) { return CT(c) & 64; }
__weak int isprint(int c) { return CT(c) & (1 | 2 | 4 | 16 | 128); }
__weak int isgraph(int c) { return CT(c) & (1 | 2 | 4 | 16); }
__weak int tolower(int c) { return (c >= 'A' && c <= 'Z') ? c + 32 : c; }
__weak int toupper(int c) { return (c >= 'a' && c <= 'z') ? c - 32 : c; }

/* errno of the toolchain's headers */
int *__errno(void)
{
	return &errno;
}

__weak int strcasecmp(const char *a, const char *b)
{
	while (*a != '\0' && tolower((unsigned char)*a) == tolower((unsigned char)*b)) {
		a++;
		b++;
	}
	return tolower((unsigned char)*a) - tolower((unsigned char)*b);
}

__weak int strncasecmp(const char *a, const char *b, size_t n)
{
	while (n > 0 && *a != '\0' && tolower((unsigned char)*a) == tolower((unsigned char)*b)) {
		a++;
		b++;
		n--;
	}
	return n == 0 ? 0 : tolower((unsigned char)*a) - tolower((unsigned char)*b);
}

/* wide characters: std::basic_string<wchar_t> is instantiated by litehtml (4 byte wchar_t) */
__weak size_t wcslen(const int *s)
{
	size_t n = 0;

	while (s[n] != 0) {
		n++;
	}
	return n;
}

__weak int *wmemcpy(int *d, const int *s, size_t n)
{
	return memcpy(d, s, n * sizeof(int));
}

__weak int *wmemmove(int *d, const int *s, size_t n)
{
	return memmove(d, s, n * sizeof(int));
}

__weak int *wmemset(int *d, int c, size_t n)
{
	for (size_t i = 0; i < n; i++) {
		d[i] = c;
	}
	return d;
}

__weak int wmemcmp(const int *a, const int *b, size_t n)
{
	for (size_t i = 0; i < n; i++) {
		if (a[i] != b[i]) {
			return a[i] < b[i] ? -1 : 1;
		}
	}
	return 0;
}

__weak int *wmemchr(const int *s, int c, size_t n)
{
	for (size_t i = 0; i < n; i++) {
		if (s[i] == c) {
			return (int *)&s[i];
		}
	}
	return NULL;
}
