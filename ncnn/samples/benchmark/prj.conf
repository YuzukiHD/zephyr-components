## CMakeLists.txt
```
# SPDX-License-Identifier: Apache-2.0

cmake_minimum_required(VERSION 3.20.0)
# the ncnn module is two directories up
list(APPEND ZEPHYR_EXTRA_MODULES ${CMAKE_CURRENT_SOURCE_DIR}/../..)

find_package(Zephyr REQUIRED HINTS $ENV{ZEPHYR_BASE})
project(ncnn_bench)

target_sources(app PRIVATE src/main.c)
```

## sample.yaml
```
sample:
  name: ncnn benchmark
tests:
  sample.modules.ncnn_bench:
    platform_allow:
      - f101_evb
    harness: console
    harness_config:
      type: one_line
      regex:
        - "ncnn benchmark done"
```

## prj.conf
```kconfig
CONFIG_CPP=y
CONFIG_NCNN=y
CONFIG_NCNN_BENCHMARK=y

# the vector kernels of ncnn
CONFIG_SUN252I_F101_RVV=y
CONFIG_FPU=y
CONFIG_FPU_SHARING=y

CONFIG_PRINTK=y
CONFIG_LOG=n
CONFIG_SHELL=n
CONFIG_DEVMEM_SHELL=n
CONFIG_MAIN_STACK_SIZE=32768

# all RAM above the image is the heap (weights and activations)
CONFIG_COMMON_LIBC_MALLOC_ARENA_SIZE=-1
CONFIG_HEAP_MEM_POOL_SIZE=262144

# drivers the benchmark does not use; the display has a 1.2 MB frame buffer,
# the memory is worth more to the networks
CONFIG_DISPLAY=n
CONFIG_PWM=n
CONFIG_DMA=n
CONFIG_GPIO=n
CONFIG_WATCHDOG=n
CONFIG_G2D=n
CONFIG_USB_PHY_SUNXI=n
CONFIG_ADC=n
CONFIG_SPI=n
CONFIG_I2C=n
CONFIG_MIPI_DBI=n
CONFIG_WDT_SUNXI=n

# ncnn_libc.c and toolchain.cmake.in are written for the minimal C library; under picolibc
# feof() is a macro and ncnn_libc.c does not compile
CONFIG_MINIMAL_LIBC=y
```

## src/main.c
```c
/*
 * Copyright (c) 2026 Yuzuki Tsuru
 *
 * SPDX-License-Identifier: Apache-2.0
 */

#include <stdint.h>
#include <zephyr/kernel.h>
#include <zephyr/sys/printk.h>

/* benchncnn of the ncnn library: loops, threads, powersave, gpu, cooling down */
extern int ncnn_bench_main(int argc, char **argv);

int main(void)
{
	char *args[] = {"benchncnn", "4", "1", "0", "-1", "0", NULL};

#ifdef CONFIG_RISCV_ISA_EXT_V
	unsigned long vlenb;

	__asm__ volatile("csrr %0, vlenb" : "=r"(vlenb));
	printk("ncnn: vector extension on, VLEN %lu bits\n", vlenb * 8);
#else
	printk("ncnn: no vector extension\n");
#endif
	printk("ncnn: free heap is all RAM above the image, starting\n");

	int ret = ncnn_bench_main(6, args);

	printk("ncnn benchmark done, ret %d\n", ret);
	return 0;
}
```
