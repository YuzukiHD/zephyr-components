## nekobox/src/features/games/Kconfig
```kconfig
menu "Games"

config NEKOBOX_FEATURE_GAMES
	bool "NES, Game Boy, Game Boy Color (mGBA) and Game Boy Advance (gpSP)"
	default y
	depends on NEKOBOX_FEATURE_FILES
	select MGBA
	select GBSP
	select NES
	select CRC
	select RING_BUFFER
	select STATIC_INIT_GNU
	select I2S
	select AUDIO
	select AUDIO_CODEC
	select DMA

config NEKOBOX_GAMES_HOT_RAM
	bool "Run the Game Boy Advance core from RAM"
	default y
	depends on XIP && NEKOBOX_FEATURE_GAMES
	select CODE_DATA_RELOCATION
	help
	  In an XIP image every instruction that is not in the cache comes from the flash window.
	  The renderer and the memory handlers of the GBA core (gpSP) run for every frame, so they
	  are copied to RAM at boot. The translated game code is in RAM anyway. The Game Boy core
	  (mGBA) stays in the flash window.

config NEKOBOX_GAME
	string "Game to start at boot, for a check without touching (empty: none)"
	default ""
	depends on NEKOBOX_FEATURE_GAMES

endmenu
```

## nekobox/src/features/miracast/Kconfig
```kconfig
# SPDX-License-Identifier: Apache-2.0

menu "Miracast screen mirroring"

config NEKOBOX_FEATURE_MIRACAST
	bool "Miracast app on the home screen"
	default y
	depends on NEKOBOX_FEATURE_NET && DISPLAY_SUNXI && AIC8800_P2P
	select MIRACAST
	select MIRACAST_PLAYER
	select AIC8800_P2P_WFD
	select VDEC
	select I2S
	select AUDIO
	select AUDIO_CODEC
	select DMA
	help
	  Receive an Android phone's Wireless display / Screen mirroring stream.
	  Opening the app temporarily pauses normal Wi-Fi and DLNA services;
	  leaving it releases the receiver and restores those services.
	  Video and LPCM audio are played directly without an SD card.

config NEKOBOX_MIRACAST_NAME
	string "Name shown on the Android phone"
	default "NekoBox Miracast"
	depends on NEKOBOX_FEATURE_MIRACAST
	help
	  Use 1..32 printable ASCII bytes for the Wi-Fi Display device name.

config NET_DHCPV4_SERVER_ADDR_COUNT
	default 1 if NEKOBOX_FEATURE_MIRACAST

endmenu
```

## nekobox/src/features/net/Kconfig
```kconfig
menu "Network"

config NEKOBOX_FEATURE_NET
	bool "Wi-Fi and the time from the network"
	default y
	select AIC8800
	select NETWORKING
	select NET_IPV4
	select NET_UDP
	select NET_TCP
	select NET_DHCPV4
	select NET_MGMT
	select NET_MGMT_EVENT
	select NET_MGMT_EVENT_INFO
	select NET_L2_ETHERNET
	select WIFI
	select NET_L2_WIFI_MGMT
	select NET_SOCKETS
	select DNS_RESOLVER
	select SNTP
	select TEST_RANDOM_GENERATOR

config NEKOBOX_FEATURE_BT
	bool "Bluetooth, checked once at the start and then switched off"
	default y
	depends on NEKOBOX_FEATURE_NET
	select BT
	select BT_BROADCASTER
	select AIC8800_BT

config NEKOBOX_UTC_OFFSET_MIN
	int "Offset of the local time from UTC in minutes (the clock shows local time)"
	default 480
	range -720 840
	depends on NEKOBOX_FEATURE_NET

config NEKOBOX_NTP_SERVER
	string "Time server"
	default "ntp.aliyun.com"
	depends on NEKOBOX_FEATURE_NET

# tuning of the Zephyr options of the features: stacks that were used up to the last byte
config SYSTEM_WORKQUEUE_STACK_SIZE
	default 4096 if NEKOBOX_FEATURE_NET
config NET_MGMT_EVENT_STACK_SIZE
	default 3072 if NEKOBOX_FEATURE_NET
config NET_RX_STACK_SIZE
	default 3072 if NEKOBOX_FEATURE_NET
config NET_TX_STACK_SIZE
	default 2048 if NEKOBOX_FEATURE_NET
config NET_TCP_WORKQ_STACK_SIZE
	default 3072 if NEKOBOX_FEATURE_NET
config NET_SOCKETS_SERVICE_STACK_SIZE
	default 3072 if NEKOBOX_FEATURE_NET
config BT_RX_STACK_SIZE
	default 2048 if NEKOBOX_FEATURE_BT
config BT_LONG_WQ_STACK_SIZE
	default 3072 if NEKOBOX_FEATURE_BT
config BT_DEVICE_NAME
	default "NEKOBOX Player" if NEKOBOX_FEATURE_BT

endmenu
```

## nekobox/src/features/photos/Kconfig
```kconfig
config NEKOBOX_FEATURE_PHOTOS
	bool "Photo viewer (JPEG and PNG, pinch zoom)"
	default y
	depends on NEKOBOX_FEATURE_FILES
	select VDEC
```

## nekobox/src/features/settings/Kconfig
```kconfig
menu "Settings"

config NEKOBOX_FEATURE_SETTINGS
	bool "Settings screen"
	default y

config NEKOBOX_FEATURE_BRIGHTNESS
	bool "Brightness row"
	default y
	depends on NEKOBOX_FEATURE_SETTINGS

config NEKOBOX_FEATURE_THEME_PICKER
	bool "Dark or light and accent colour rows"
	default y
	depends on NEKOBOX_FEATURE_SETTINGS

endmenu
```

## nekobox/src/features/video/Kconfig
```kconfig
menu "Video player"

config NEKOBOX_FEATURE_VIDEO
	bool "Video player (MP4 and raw H.264)"
	default y
	depends on NEKOBOX_FEATURE_FILES
	select MP4_DEMUX
	select VDEC
	select I2S
	select AUDIO
	select AUDIO_CODEC
	select DMA
	select OPENCORE_AAC

config NEKOBOX_VIDEO_DEFAULT
	string "Video the Videos tile plays when it is not given a file"
	default "/SD:/video540p-ysjf.mp4"
	depends on NEKOBOX_FEATURE_VIDEO

config NEKOBOX_THREAD_STATS
	bool "Print the CPU time of the player threads with the playback statistics"
	depends on NEKOBOX_FEATURE_VIDEO
	select THREAD_RUNTIME_STATS
	select SCHED_THREAD_USAGE_ALL
	help
	  With the usage accounting of the scheduler switched on, the system stopped with a load
	  access fault inside the scheduler about 8 s after a failed open of a video (seen on the
	  board), so it is left off unless needed.

config NEKOBOX_HOT_RAM
	bool "Run the video decoder driver and the AAC decoder from RAM"
	default y
	depends on XIP && NEKOBOX_FEATURE_VIDEO
	select CODE_DATA_RELOCATION
	help
	  In an XIP image every instruction that is not in the cache comes from the flash window.
	  The decoder driver and the AAC decoder run on every frame, so their text is copied to RAM
	  at boot; the rest (kernel, other drivers, LVGL, file system) stays in the flash.

endmenu
```

## nes/Kconfig
```kconfig
# Copyright (c) 2026 Yuzuki Tsuru
# SPDX-License-Identifier: Apache-2.0

config NES
	bool "NES emulator (nofrendo core)"
	depends on RISCV
	select FILE_SYSTEM
	help
	  Build the nofrendo NES / Famicom core (nes/nofrendo/, GPL-2.0)
	  as a library. The picture is RGB565, the sound is 16 bit stereo
	  at the rate the caller asks for. ROM and save files are read
	  through the Zephyr file system.

if NES

config NES_MAX_ROM_SIZE_KB
	int "Largest ROM file accepted (KiB)"
	default 2048
	range 16 2048

endif # NES
```

## pocketjs/Kconfig
```kconfig
# Copyright (c) 2026 Yuzuki Tsuru
# SPDX-License-Identifier: Apache-2.0

config POCKETJS
	bool "PocketJS UI runtime (QuickJS guest, Rust UI core, RGB565 renderer)"
	depends on RISCV && !64BIT
	help
	  Build the caller-driven PocketJS components: .pocket package parser,
	  QuickJS-ng guest, retained UI core and the software RGB565 renderer
	  (the pocketjs submodule, hosts/esp-idf). The UI core and the renderer
	  are Rust static libraries built with cargo for riscv32imac-unknown-none-elf,
	  so cargo and that rustup target must be installed:
	    rustup target add riscv32imac-unknown-none-elf

if POCKETJS

config POCKETJS_GUEST_HEAP_LIMIT
	int "Default JavaScript heap limit (bytes)"
	range 1 2147483647
	default 4194304
	help
	  QuickJS memory limit of a guest; the native UI objects and the frame
	  buffers come on top of it.

config POCKETJS_RUST_RVV
	bool "Let the Rust code use the vector extension"
	depends on FPU && SUN252I_F101_RVV
	default y
	help
	  Build the Rust libraries with the V extension, so the compiler may vectorise loops
	  (fills, blends). The image saves the vector registers in every interrupt.

config POCKETJS_G2D
	bool "Draw big fills and blends with the G2D"
	depends on G2D
	default y
	help
	  Provides pocketjs_g2d_accelerator() for the RGB565 renderer.

config POCKETJS_G2D_MIN_FILL
	int "Smallest opaque fill (pixels) done by the G2D"
	depends on POCKETJS_G2D
	default 4096

config POCKETJS_G2D_MIN_BLEND
	int "Smallest coverage blend (pixels) done by the G2D"
	depends on POCKETJS_G2D
	default 8192

config POCKETJS_CARGO_OFFLINE
	bool "Build the Rust archives with cargo --offline"
	help
	  Use only the crates already in the cargo registry cache.

endif # POCKETJS
```
