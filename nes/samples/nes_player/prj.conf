## CMakeLists.txt
```
# SPDX-License-Identifier: Apache-2.0

cmake_minimum_required(VERSION 3.20.0)
# the NES module is two directories up
list(APPEND ZEPHYR_EXTRA_MODULES ${CMAKE_CURRENT_SOURCE_DIR}/../..)

find_package(Zephyr REQUIRED HINTS $ENV{ZEPHYR_BASE})
project(nes_player)

target_sources(app PRIVATE src/main.c src/video.c src/audio.c src/pad.c)
target_include_directories(app PRIVATE src)
```

## Kconfig
```
# SPDX-License-Identifier: Apache-2.0

mainmenu "NES player"

config SAMPLE_NES_ROM
	string "ROM file"
	default "/SD:/game.nes"

config SAMPLE_NES_RATE
	int "Sound output rate"
	default 48000
	help
	  48000 or 44100.

config SAMPLE_NES_VOLUME
	int "Output volume of the codec"
	range 0 255
	default 150

config SAMPLE_NES_BENCH
	bool "Run the emulation unpaced for a fixed number of frames and print the time"

config SAMPLE_NES_BENCH_FRAMES
	int "Frames of the benchmark, a checksum of the picture is printed every 200"
	depends on SAMPLE_NES_BENCH
	default 1200

source "Kconfig.zephyr"
```

## prj.conf
```kconfig
CONFIG_NES=y
CONFIG_CRC=y

CONFIG_SDHC=y
CONFIG_DISK_ACCESS=y
CONFIG_DISK_DRIVER_SDMMC=y
CONFIG_FILE_SYSTEM=y
CONFIG_FAT_FILESYSTEM_ELM=y
CONFIG_FS_FATFS_EXFAT=y
CONFIG_FS_FATFS_LFN=y
CONFIG_FS_FATFS_LFN_MODE_STACK=y
CONFIG_LOG=y
CONFIG_LOG_PRINTK=n
CONFIG_PRINTK=y
CONFIG_SHELL=n
CONFIG_DEVMEM_SHELL=n
CONFIG_MAIN_STACK_SIZE=16384
CONFIG_COMMON_LIBC_MALLOC_ARENA_SIZE=-1
CONFIG_HEAP_MEM_POOL_SIZE=262144
CONFIG_MAIN_THREAD_PRIORITY=6

# drivers the player does not use
CONFIG_G2D=n
CONFIG_USB_PHY_SUNXI=n
CONFIG_ADC=n
CONFIG_SPI=n
CONFIG_I2C=n
CONFIG_MIPI_DBI=n
CONFIG_WDT_SUNXI=n
CONFIG_VDEC=n

CONFIG_FPU=y
CONFIG_FPU_SHARING=y
CONFIG_I2S=y
CONFIG_AUDIO=y
CONFIG_AUDIO_CODEC=y
CONFIG_DMA=y
CONFIG_GPIO=y
CONFIG_RING_BUFFER=y

# the pad: LVGL on the ARGB frame buffer plane, over the video plane
CONFIG_DISPLAY=y
CONFIG_DISPLAY_SUNXI_ARGB8888=y
CONFIG_LVGL=y
CONFIG_LV_COLOR_DEPTH_32=y
CONFIG_LV_Z_MEM_POOL_SIZE=131072
CONFIG_LV_Z_VDB_SIZE=4
CONFIG_LV_FONT_MONTSERRAT_16=y
CONFIG_LV_FONT_MONTSERRAT_28=y
CONFIG_LV_Z_SHELL=n
CONFIG_STATIC_INIT_GNU=y
CONFIG_SUN252I_F101_RVV=y
```

## src/main.c
```c
/*
 * Copyright (c) 2026 Yuzuki Tsuru
 * SPDX-License-Identifier: Apache-2.0
 */

/*
 * Runs an NES ROM from the SD card. Real time comes from the sound: the
 * emulation stops while the audio ring holds enough.
 */

#include <errno.h>
#include <ff.h>
#include <stdio.h>
#include <stdlib.h>
#include <string.h>
#include <zephyr/fs/fs.h>
#include <zephyr/kernel.h>
#include <zephyr/sys/crc.h>
#include <zephyr/sys/printk.h>
#include <nes_zephyr/nesemu.h>

#include "app.h"

#define RATE		CONFIG_SAMPLE_NES_RATE
/* the emulation waits while this many frames of sound are queued */
#define HIGH_WATER	(RATE / 15)
#define REPORT_MS	5000
#define SAVE_MS		3000

static FATFS fat_fs;
static struct fs_mount_t mp = {
	.type = FS_FATFS,
	.fs_data = &fat_fs,
	.mnt_point = "/SD:",
};

static char rom_path[128], save_path[128];

/* the configured ROM, or else the first .nes file in the root of the card */
static int pick_rom(void)
{
	struct fs_dirent ent;
	struct fs_dir_t dir;
	char *dot;

	strncpy(rom_path, CONFIG_SAMPLE_NES_ROM, sizeof(rom_path) - 1);
	if (fs_stat(rom_path, &ent) != 0) {
		fs_dir_t_init(&dir);
		if (fs_opendir(&dir, "/SD:") != 0) {
			return -ENOENT;
		}
		rom_path[0] = '\0';
		while (fs_readdir(&dir, &ent) == 0 && ent.name[0] != '\0') {
			size_t n = strlen(ent.name);

			if (ent.type == FS_DIR_ENTRY_FILE && n > 4 &&
			    (strcmp(ent.name + n - 4, ".nes") == 0 ||
			     strcmp(ent.name + n - 4, ".NES") == 0)) {
				snprintf(rom_path, sizeof(rom_path), "/SD:/%s", ent.name);
				break;
			}
		}
		fs_closedir(&dir);
		if (rom_path[0] == '\0') {
			return -ENOENT;
		}
	}
	strncpy(save_path, rom_path, sizeof(save_path) - 5);
	dot = strrchr(save_path, '.');
	strcpy(dot != NULL && dot > strrchr(save_path, '/') ? dot : save_path + strlen(save_path),
	       ".sav");

	return 0;
}

int main(void)
{
	static int16_t pcm[2 * 2048];
	int64_t t_report, t_save;
	uint32_t frames = 0, emu_us = 0, pushed = 0;
	int ret;

	ret = fs_mount(&mp);
	if (ret != 0) {
		printk("cannot mount the SD card: %d\n", ret);
		return 0;
	}
	if (video_init() != 0 || audio_init(RATE) != 0) {
		printk("video or audio not available\n");
		return 0;
	}
	if (pick_rom() != 0) {
		printk("no .nes file on the card\n");
		return 0;
	}
	printk("ROM %s, save %s\n", rom_path, save_path);
	ret = nesemu_open(rom_path, save_path, RATE);
	if (ret != 0) {
		printk("cannot start %s: %d\n", rom_path, ret);
		return 0;
	}
	pad_start();

#ifdef CONFIG_SAMPLE_NES_BENCH
	{
		/* no sound pacing, no display: the cost of the emulation alone */
		uint32_t t0 = k_cycle_get_32(), worst = 0;
		const int n_frames = CONFIG_SAMPLE_NES_BENCH_FRAMES;

		for (int i = 0; i < n_frames; i++) {
			uint32_t c0 = k_cycle_get_32();

			nesemu_set_frame_buffer(video_acquire());
			nesemu_set_frameskip(0);
			nesemu_run_frame();
			worst = MAX(worst, k_cycle_get_32() - c0);
			if ((i + 1) % 200 == 0) {
				printk("bench: frame %d crc %08x\n", i + 1,
				       (uint32_t)crc32_ieee((const uint8_t *)video_acquire(),
							    NESEMU_WIDTH * 2 * nesemu_height()));
			}
		}
		printk("bench: %d frames, %u us/frame, worst %u us\n", n_frames,
		       (uint32_t)(k_cyc_to_us_floor64(k_cycle_get_32() - t0) / n_frames),
		       (uint32_t)k_cyc_to_us_floor64(worst));
		return 0;
	}
#endif
	t_report = t_save = k_uptime_get();
	while (true) {
		uint32_t c0 = k_cycle_get_32();
		size_t n;

		nesemu_set_keys(pad_keys());
		nesemu_set_frame_buffer(video_acquire());
		/* a frame that runs late is not drawn, the sound has priority */
		nesemu_set_frameskip(audio_queued() < RATE / 30 ? 1 : 0);
		if (nesemu_run_frame()) {
			video_present(NESEMU_WIDTH, nesemu_height());
		}
		emu_us += k_cyc_to_us_floor32(k_cycle_get_32() - c0);
		while ((n = nesemu_audio_read(pcm, ARRAY_SIZE(pcm) / 2)) > 0) {
			size_t done = 0;

			pushed += n;
			while (done < n) {
				done += audio_push(pcm + done * 2, n - done);
				if (done < n) {
					k_msleep(1);
				}
			}
		}
		frames++;

		while (audio_queued() > HIGH_WATER) {
			k_msleep(1);
		}
		if (k_uptime_get() - t_save >= SAVE_MS) {
			nesemu_save_flush();
			t_save = k_uptime_get();
		}
		if (k_uptime_get() - t_report >= REPORT_MS) {
			printk("nes: %u frames, emulation %u us/frame, sound %u frames pushed, "
			       "queued %u, underruns %u, ring empty %u, slab full %u\n", frames,
			       emu_us / frames, pushed, (unsigned int)audio_queued(),
			       audio_underruns(), audio_starved(), audio_slab_waits());
			frames = emu_us = pushed = 0;
			t_report = k_uptime_get();
		}
	}

	return 0;
}
```

## src/app.h
```c
/*
 * Copyright (c) 2026 Yuzuki Tsuru
 * SPDX-License-Identifier: Apache-2.0
 */

#ifndef APP_H_
#define APP_H_

#include <stdbool.h>
#include <stddef.h>
#include <stdint.h>

/* video.c: RGB565 frame to the video plane */
int video_init(void);
/** The buffer the next frame is drawn into, and its hand-over to the display */
uint16_t *video_acquire(void);
void video_present(unsigned int width, unsigned int height);

/* audio.c: ring between the emulation and the codec */
int audio_init(unsigned int rate);
/** Put stereo frames in, returns how many were taken */
size_t audio_push(const int16_t *pcm, size_t frames);
/** Stereo frames waiting to be played, including the blocks in the codec */
size_t audio_queued(void);
unsigned int audio_underruns(void);
unsigned int audio_starved(void);
unsigned int audio_slab_waits(void);

/* pad.c: on-screen keys, NESEMU_KEY_* mask */
int pad_start(void);
uint32_t pad_keys(void);

#endif
```

## src/audio.c
```c
/*
 * Copyright (c) 2026 Yuzuki Tsuru
 * SPDX-License-Identifier: Apache-2.0
 */

/*
 * The emulation pushes resampled stereo frames into a ring; a thread cuts it
 * into blocks for the codec. The codec consumes at a fixed rate, so a full ring
 * is what slows the emulation down to real time.
 */

#include <errno.h>
#include <string.h>
#include <zephyr/audio/codec.h>
#include <zephyr/device.h>
#include <zephyr/drivers/i2s.h>
#include <zephyr/kernel.h>
#include <zephyr/sys/printk.h>
#include <zephyr/sys/ring_buffer.h>

#include "app.h"

#define BLOCK_FRAMES	512
#define BLOCK_BYTES	(BLOCK_FRAMES * 2 * sizeof(int16_t))
#define SLAB_BLOCKS	6
#define PREFILL		3
#define RING_BLOCKS	8

static const struct device *const i2s = DEVICE_DT_GET(DT_NODELABEL(audio_codec));
static const struct device *const ctl = DEVICE_DT_GET(DT_NODELABEL(codec_analog));

K_MEM_SLAB_DEFINE_STATIC(slab, BLOCK_BYTES, SLAB_BLOCKS, 4);
K_THREAD_STACK_DEFINE(audio_stack, 4096);
static struct k_thread thread;
RING_BUF_DECLARE(ring, RING_BLOCKS * BLOCK_BYTES);

static unsigned int rate;
static volatile unsigned int underruns, starved, slab_waits;

static void audio_main(void *a, void *b, void *c)
{
	struct i2s_config cfg = {
		.word_size = 16,
		.channels = 2,
		.format = I2S_FMT_DATA_FORMAT_I2S,
		.options = I2S_OPT_BIT_CLK_MASTER | I2S_OPT_FRAME_CLK_MASTER,
		.frame_clk_freq = rate,
		.mem_slab = &slab,
		.block_size = BLOCK_BYTES,
		.timeout = 2000,
	};
	bool running = false;
	int queued = 0;

	if (i2s_configure(i2s, I2S_DIR_TX, &cfg) != 0) {
		printk("audio: i2s_configure failed\n");
		return;
	}
	audio_codec_start_output(ctl);
	audio_codec_set_property(ctl, AUDIO_PROPERTY_OUTPUT_VOLUME, AUDIO_CHANNEL_ALL,
				 (audio_property_value_t){.vol = CONFIG_SAMPLE_NES_VOLUME});

	while (true) {
		void *blk;
		uint32_t n;
		int ret;

		if (ring_buf_size_get(&ring) < BLOCK_BYTES) {
			if (running) {
				starved++;
			}
			k_msleep(1);
			continue;
		}
		if (k_mem_slab_alloc(&slab, &blk, K_NO_WAIT) != 0) {
			slab_waits++;
			if (k_mem_slab_alloc(&slab, &blk, K_SECONDS(2)) != 0) {
				continue;
			}
		}
		n = ring_buf_get(&ring, blk, BLOCK_BYTES);
		__ASSERT_NO_MSG(n == BLOCK_BYTES);
		ret = i2s_write(i2s, blk, BLOCK_BYTES);
		if (ret == -EIO) {
			/* the stream ran dry: start it again */
			underruns++;
			running = false;
			queued = 0;
			k_mem_slab_free(&slab, blk);
			i2s_trigger(i2s, I2S_DIR_TX, I2S_TRIGGER_PREPARE);
			continue;
		} else if (ret != 0) {
			k_mem_slab_free(&slab, blk);
			continue;
		}
		if (!running && ++queued >= PREFILL &&
		    i2s_trigger(i2s, I2S_DIR_TX, I2S_TRIGGER_START) == 0) {
			running = true;
		}
	}
}

int audio_init(unsigned int out_rate)
{
	if (!device_is_ready(i2s) || !device_is_ready(ctl)) {
		return -ENODEV;
	}
	rate = out_rate;
	k_thread_create(&thread, audio_stack, K_THREAD_STACK_SIZEOF(audio_stack), audio_main, NULL, NULL, NULL,
			3, 0, K_NO_WAIT);
	k_thread_name_set(&thread, "audio");

	return 0;
}

size_t audio_push(const int16_t *pcm, size_t frames)
{
	return ring_buf_put(&ring, (const uint8_t *)pcm, frames * 4) / 4;
}

size_t audio_queued(void)
{
	return ring_buf_size_get(&ring) / 4;
}

unsigned int audio_underruns(void)
{
	return underruns;
}

unsigned int audio_starved(void)
{
	return starved;
}

unsigned int audio_slab_waits(void)
{
	return slab_waits;
}
```

## src/pad.c
```c
/*
 * Copyright (c) 2026 Yuzuki Tsuru
 * SPDX-License-Identifier: Apache-2.0
 */

/*
 * The keys of the console as translucent LVGL buttons on the ARGB plane, over
 * the game picture (which the video plane shows scaled to the panel).
 *
 * With a touch panel (the chosen zephyr,touch) the fingers are read straight from the input
 * events, one per touch slot, and each is matched against the buttons here: LVGL's pointer
 * handles one finger, a game needs the directions and a button at the same time. The buttons
 * only show the state. Without a touch panel nothing writes the key mask, the
 * buttons are then only drawn.
 */

#include <lvgl.h>
#include <zephyr/devicetree.h>
#include <zephyr/kernel.h>
#include <zephyr/sys/atomic.h>
#include <nes_zephyr/nesemu.h>

#include "app.h"

#define HAS_TOUCH	DT_NODE_EXISTS(DT_CHOSEN(zephyr_touch))

#if HAS_TOUCH
#include <zephyr/input/input.h>
#endif

#define STACK_SIZE	4096
#define PRIORITY	7

K_THREAD_STACK_DEFINE(pad_stack, STACK_SIZE);
static struct k_thread thread;
static atomic_t keys;

#define MAX_KEYS	10
#define HIT_MARGIN	12
/*
 * The controller now and then reports a frame without the finger while it stays on the glass,
 * which would be a release and a new press: a key is held this long after its finger left.
 */
#define RELEASE_HOLD_MS	50

static struct pad_key {
	lv_obj_t *obj;
	int x, y, w, h;
	uint32_t bit;
	bool shown;
	uint32_t hold_until;
} pad_keys_tbl[MAX_KEYS];
static int nkeys;

#if HAS_TOUCH
#define TOUCH_SLOTS	5

static struct {
	int x, y;
	bool down;
} fingers[TOUCH_SLOTS];
static int cur_slot;

static void touch_event(struct input_event *evt, void *user_data)
{
	switch (evt->code) {
	case INPUT_ABS_MT_SLOT:
		cur_slot = CLAMP(evt->value, 0, TOUCH_SLOTS - 1);
		break;
	case INPUT_ABS_X:
		fingers[cur_slot].x = evt->value;
		break;
	case INPUT_ABS_Y:
		fingers[cur_slot].y = evt->value;
		break;
	case INPUT_BTN_TOUCH:
		fingers[cur_slot].down = evt->value != 0;
		break;
	}
}
INPUT_CALLBACK_DEFINE(DEVICE_DT_GET(DT_CHOSEN(zephyr_touch)), touch_event, NULL);

/* the keys that have a finger on them; also shows the state on the buttons */
static uint32_t touch_scan(void)
{
	uint32_t mask = 0;
	uint32_t now = k_uptime_get_32();

	for (int k = 0; k < nkeys; k++) {
		struct pad_key *key = &pad_keys_tbl[k];
		bool pressed = false;

		for (int f = 0; f < TOUCH_SLOTS; f++) {
			if (fingers[f].down && fingers[f].x >= key->x - HIT_MARGIN &&
			    fingers[f].x < key->x + key->w + HIT_MARGIN &&
			    fingers[f].y >= key->y - HIT_MARGIN &&
			    fingers[f].y < key->y + key->h + HIT_MARGIN) {
				pressed = true;
			}
		}
		if (pressed) {
			key->hold_until = now + RELEASE_HOLD_MS;
		} else if ((int32_t)(now - key->hold_until) < 0) {
			pressed = true;
		}
		if (pressed) {
			mask |= key->bit;
		}
		if (pressed != key->shown) {
			if (pressed) {
				lv_obj_add_state(key->obj, LV_STATE_PRESSED);
			} else {
				lv_obj_remove_state(key->obj, LV_STATE_PRESSED);
			}
			key->shown = pressed;
		}
	}

	return mask;
}
#endif /* HAS_TOUCH */

static void key_add(int x, int y, int w, int h, const char *text, uint32_t bit, int radius)
{
	lv_obj_t *b = lv_button_create(lv_screen_active());
	lv_obj_t *l = lv_label_create(b);

	lv_obj_set_size(b, w, h);
	lv_obj_align(b, LV_ALIGN_TOP_LEFT, x, y);
	lv_obj_set_style_radius(b, radius, 0);
	lv_obj_set_style_bg_color(b, lv_color_white(), 0);
	lv_obj_set_style_bg_opa(b, LV_OPA_30, 0);
	lv_obj_set_style_bg_color(b, lv_color_make(255, 200, 60), LV_STATE_PRESSED);
	lv_obj_set_style_bg_opa(b, LV_OPA_70, LV_STATE_PRESSED);
	lv_obj_set_style_border_color(b, lv_color_white(), 0);
	lv_obj_set_style_border_opa(b, LV_OPA_50, 0);
	lv_obj_set_style_border_width(b, 2, 0);
	lv_obj_set_style_shadow_width(b, 0, 0);
	lv_obj_set_style_text_font(l, &lv_font_montserrat_28, 0);
	lv_obj_set_style_text_color(l, lv_color_white(), 0);
	lv_label_set_text(l, text);
	lv_obj_center(l);

	if (nkeys < MAX_KEYS) {
		pad_keys_tbl[nkeys++] = (struct pad_key){
			.obj = b, .x = x, .y = y, .w = w, .h = h, .bit = bit,
		};
	}
}

static void pad_main(void *a, void *b, void *c)
{
	lv_obj_set_style_bg_opa(lv_screen_active(), LV_OPA_TRANSP, 0);

	/*
	 * The layout is for the 1024x768 panel of the yuzukineko board, origin top left. The picture
	 * (256x224 scaled by the video plane) fills the screen behind the keys.
	 */
	key_add(30, 498, 90, 90, LV_SYMBOL_LEFT, NESEMU_KEY_LEFT, 20);
	key_add(210, 498, 90, 90, LV_SYMBOL_RIGHT, NESEMU_KEY_RIGHT, 20);
	key_add(120, 408, 90, 90, LV_SYMBOL_UP, NESEMU_KEY_UP, 20);
	key_add(120, 588, 90, 90, LV_SYMBOL_DOWN, NESEMU_KEY_DOWN, 20);

	key_add(830, 528, 100, 100, "A", NESEMU_KEY_A, LV_RADIUS_CIRCLE);
	key_add(720, 598, 100, 100, "B", NESEMU_KEY_B, LV_RADIUS_CIRCLE);

	key_add(380, 688, 120, 60, "SELECT", NESEMU_KEY_SELECT, 30);
	key_add(524, 688, 120, 60, "START", NESEMU_KEY_START, 30);

	while (true) {
#if HAS_TOUCH
		atomic_set(&keys, touch_scan());
#endif
		lv_timer_handler();
		k_msleep(16);
	}
}

int pad_start(void)
{
	k_tid_t tid = k_thread_create(&thread, pad_stack, STACK_SIZE, pad_main, NULL, NULL, NULL,
				      PRIORITY, 0, K_NO_WAIT);

	k_thread_name_set(tid, "pad");

	return 0;
}

uint32_t pad_keys(void)
{
	return atomic_get(&keys);
}
```

## src/video.c
```c
/*
 * Copyright (c) 2026 Yuzuki Tsuru
 * SPDX-License-Identifier: Apache-2.0
 */

/*
 * The frame of the console is RGB565 and goes to the scaling video plane of
 * the display engine as it is. The emulator draws the next frame into its own
 * buffer while the plane still scans out the last one, so each frame is copied
 * into one of three buffers (the one shown last stays valid for one more
 * refresh).
 */

#include <errno.h>
#include <stdlib.h>
#include <string.h>
#include <zephyr/cache.h>
#include <zephyr/device.h>
#include <zephyr/drivers/display/display_sunxi.h>
#include <zephyr/kernel.h>
#include <zephyr/sys/atomic.h>
#include <zephyr/sys/printk.h>
#include <nes_zephyr/nesemu.h>

#include "app.h"

#define NESEMU_HEIGHT_MAX 240
#define STRIDE	(NESEMU_WIDTH * 2)
#define BUF_SZ	ROUND_UP(STRIDE * NESEMU_HEIGHT_MAX, 64)
#define NBUF	4

static const struct device *const disp = DEVICE_DT_GET(DT_CHOSEN(zephyr_display));
static uint8_t *buf[NBUF];
static unsigned int cur;
static atomic_t ready_idx;
static unsigned int ready_w, ready_h;

K_SEM_DEFINE(frame_sem, 0, 1);
K_THREAD_STACK_DEFINE(video_stack, 8192);
static struct k_thread video_thread;

/*
 * Putting a picture up can wait for the next refresh; that must not hold the
 * emulation, which is paced by the sound. Only the newest picture is shown.
 */
static void video_main(void *a, void *b, void *c)
{
	bool warned = false;

	while (true) {
		struct display_sunxi_rgb img = {.width = 0};
		int idx, ret;

		k_sem_take(&frame_sem, K_FOREVER);
		idx = atomic_get(&ready_idx);
		img.data = buf[idx];
		img.width = ready_w;
		img.height = ready_h;
		img.stride = STRIDE;
		img.nonblock = false;
		ret = display_sunxi_show_rgb(disp, &img);
		if (ret != 0 && !warned) {
			printk("video: show_rgb failed: %d\n", ret);
			warned = true;
		}
	}
}

int video_init(void)
{
	if (!device_is_ready(disp)) {
		return -ENODEV;
	}
	for (int i = 0; i < NBUF; i++) {
		buf[i] = aligned_alloc(64, BUF_SZ);
		if (buf[i] == NULL) {
			return -ENOMEM;
		}
	}
	k_thread_create(&video_thread, video_stack, K_THREAD_STACK_SIZEOF(video_stack), video_main,
			NULL, NULL, NULL, 5, 0, K_NO_WAIT);
	k_thread_name_set(&video_thread, "video");

	return 0;
}

uint16_t *video_acquire(void)
{
	return (uint16_t *)buf[(cur + 1) % NBUF];
}

void video_present(unsigned int width, unsigned int height)
{
	cur = (cur + 1) % NBUF;
	sys_cache_data_flush_range(buf[cur], STRIDE * height);
	ready_w = width;
	ready_h = height;
	atomic_set(&ready_idx, cur);
	k_sem_give(&frame_sem);
}
```
