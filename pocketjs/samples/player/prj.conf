## CMakeLists.txt
```
# SPDX-License-Identifier: Apache-2.0

cmake_minimum_required(VERSION 3.20.0)
# the pocketjs module is two directories up
list(APPEND ZEPHYR_EXTRA_MODULES ${CMAKE_CURRENT_SOURCE_DIR}/../..)

find_package(Zephyr REQUIRED HINTS $ENV{ZEPHYR_BASE})
project(pocketjs_player)

set(PJS ${CMAKE_CURRENT_SOURCE_DIR}/../../pocketjs)
# -DPOCKETJS_APP=hero runs apps/hero of the PocketJS tree (480x272, buttons only), the
# default is the small app in app/
set(POCKETJS_APP "" CACHE STRING "App of the PocketJS tree to run (apps/<name>)")
# -DPOCKETJS_LOCAL_APP=bench runs the app in the directory of that name next to this file
# (bench/: the renderer benchmark, with its own host profile for a 512x384 canvas)
set(POCKETJS_LOCAL_APP "" CACHE STRING "App directory of this sample to run")
if(POCKETJS_APP)
  set(APP ${PJS}/apps/${POCKETJS_APP})
  set(ROOT ${PJS})
  set(PROFILE ${CMAKE_CURRENT_SOURCE_DIR}/pocket.host.480x272.json)
elseif(POCKETJS_LOCAL_APP)
  set(APP ${CMAKE_CURRENT_SOURCE_DIR}/${POCKETJS_LOCAL_APP})
  set(ROOT ${APP})
  set(PROFILE ${APP}/pocket.host.json)
else()
  set(APP ${CMAKE_CURRENT_SOURCE_DIR}/app)
  set(ROOT ${APP})
  set(PROFILE ${APP}/pocket.host.json)
endif()
set(GEN ${CMAKE_CURRENT_BINARY_DIR}/pocketjs/player)
set(PKG ${GEN}/player.pocket)

# .pocket package of the app with the PocketJS CLI (bun); the sources it reads are
# listed in the depfile
find_package(Python3 REQUIRED)
find_program(BUN bun HINTS $ENV{HOME}/.bun/bin $ENV{HOME}/.nvm/versions/node/v24.21.0/bin REQUIRED)
add_custom_command(
  OUTPUT ${PKG}
  COMMAND ${CMAKE_COMMAND} -E make_directory ${GEN}
  COMMAND ${BUN} ${PJS}/tools/cli/bin.mjs build
    --manifest ${APP}/pocket.json --host-profile ${PROFILE}
    --project-root ${ROOT} --outdir ${GEN} --plan-dir ${GEN}/plans --output ${PKG}
    --depfile ${GEN}/player.d
  DEPFILE ${GEN}/player.d
  DEPENDS ${APP}/pocket.json ${PROFILE}
  WORKING_DIRECTORY ${PJS}
  VERBATIM)

# C header/source/assembler with the package bytes
set(EMBED ${PJS}/hosts/esp-idf/components/pocketjs_package/tools/embed_package.py)
add_custom_command(
  OUTPUT ${GEN}/pocketjs_package_player.h ${GEN}/pocketjs_package_player.c
         ${GEN}/pocketjs_package_player.S
  COMMAND ${CMAKE_COMMAND} -E env PYTHONDONTWRITEBYTECODE=1
    ${Python3_EXECUTABLE} ${EMBED} --package=${PKG} --host-profile=${PROFILE}
    --name=player --output-dir=${GEN}
  DEPENDS ${PKG} ${PROFILE}
  VERBATIM)

target_sources(app PRIVATE src/main.c src/input.c ${GEN}/pocketjs_package_player.c
  ${GEN}/pocketjs_package_player.S)
target_include_directories(app PRIVATE ${GEN})

if(CONFIG_SAMPLE_POCKETJS_PROFILE)
  target_sources(app PRIVATE src/profile.c)
endif()
```

## Kconfig
```
# SPDX-License-Identifier: Apache-2.0

mainmenu "PocketJS player"

config SAMPLE_POCKETJS_CPU_MHZ
	int "CPU clock in MHz, 0 keeps what the boot loader set up (600)"
	default 960
	help
	  The CPU PLL is raised in steps of 72 MHz and the memory is checked after each
	  step. The voltage is not changed; the limit of the PLL is 1008 MHz, two hangs were
	  seen above 960 MHz in another application.

config SAMPLE_POCKETJS_PROFILE
	bool "Sample the program counter of the main thread and print the busiest code blocks"

source "Kconfig.zephyr"
```

## prj.conf
```kconfig
CONFIG_POCKETJS=y
CONFIG_POCKETJS_GUEST_HEAP_LIMIT=4194304
CONFIG_POCKETJS_TURN_STATS=y

CONFIG_LOG=y
CONFIG_LOG_PRINTK=n
CONFIG_PRINTK=y
CONFIG_SHELL=n
CONFIG_MAIN_STACK_SIZE=98304
CONFIG_COMMON_LIBC_MALLOC_ARENA_SIZE=-1
CONFIG_HEAP_MEM_POOL_SIZE=262144

CONFIG_DISPLAY=y

# drivers the sample does not use
CONFIG_G2D=y
CONFIG_USB_PHY_SUNXI=n
CONFIG_ADC=n
CONFIG_SPI=n
CONFIG_MIPI_DBI=n
CONFIG_WDT_SUNXI=n
CONFIG_VDEC=n
CONFIG_MAIN_THREAD_PRIORITY=6

# hardware floats and vectors for QuickJS and the Rust renderer
CONFIG_SPEED_OPTIMIZATIONS=y
CONFIG_FPU=y
CONFIG_FPU_SHARING=y
CONFIG_SUN252I_F101_RVV=y

CONFIG_INPUT=y
CONFIG_I2C=y
```

## src/main.c
```c
/*
 * Copyright (c) 2026 Yuzuki Tsuru
 * SPDX-License-Identifier: Apache-2.0
 *
 * PocketJS on the F101: the embedded app runs in the QuickJS guest, every tick the UI core
 * produces a frame, the damaged rectangles are drawn into an RGB565 buffer and the buffer
 * is put on the scaling video plane.
 */

#include <stdlib.h>
#include <string.h>

#include <zephyr/kernel.h>
#include <zephyr/cache.h>
#include <zephyr/sys/atomic.h>
#include <zephyr/device.h>
#include <zephyr/drivers/clock_control.h>
#include <zephyr/drivers/display/display_sunxi.h>
#include <zephyr/dt-bindings/clock/sun252i-f101-ccu.h>

#include "pocketjs/guest.h"
#include "pocketjs/guest_quickjs.h"
#include "pocketjs/package.h"
#include "pocketjs/render_rgb565.h"
#include "pocketjs/ui_core.h"
#include "pocketjs/ui_qjs.h"
#include "input.h"
#ifdef CONFIG_POCKETJS_G2D
#include "pocketjs_zephyr/g2d_accel.h"
#ifdef CONFIG_POCKETJS_TURN_STATS
#include "pocketjs_zephyr/turn_stats.h"
#endif
#endif
#include "pocketjs_package_player.h"

/* two thirds of the main stack, the rest is for the native code below the interpreter */
#define JS_STACK_LIMIT (CONFIG_MAIN_STACK_SIZE / 3 * 2)
#define CONTRACT pocketjs_package_player_contract
#define PACKAGE	 pocketjs_package_player

static const struct device *const disp = DEVICE_DT_GET(DT_CHOSEN(zephyr_display));

#define NPIC 4

static uint8_t *pic[NPIC];
static uint32_t pic_w, pic_h;
static size_t pic_stride;
static atomic_t ready_idx;
K_SEM_DEFINE(frame_sem, 0, 1);
K_THREAD_STACK_DEFINE(video_stack, 4096);
static struct k_thread video_thread;

/*
 * Putting a picture up waits for the refresh; that must not hold the tick. Only the newest
 * picture is shown, and the ring is longer than what the plane and the thread can hold.
 */
static void video_main(void *a, void *b, void *c)
{
	bool warned = false;

	while (true) {
		struct display_sunxi_rgb img = {.xrgb8888 = false, .pixel_perfect = true};
		int ret;

		k_sem_take(&frame_sem, K_FOREVER);
		img.data = pic[atomic_get(&ready_idx)];
		img.width = pic_w;
		img.height = pic_h;
		img.stride = pic_stride;
		ret = display_sunxi_show_rgb(disp, &img);
		if (ret != 0 && !warned) {
			printk("[E] pocketjs_player: show_rgb failed: %d\n", ret);
			warned = true;
		}
	}
}

/* A busy loop over a checksummed block of memory: a CPU that is too fast corrupts it */
static bool cpu_selftest(void)
{
	static uint32_t blk[16 * 1024];
	uint32_t sum = 0, ref = 0;

	for (unsigned int i = 0; i < ARRAY_SIZE(blk); i++) {
		blk[i] = i * 2654435761U;
	}
	for (int round = 0; round < 50; round++) {
		sum = 0;
		for (unsigned int i = 0; i < ARRAY_SIZE(blk); i++) {
			sum = (sum << 1 | sum >> 31) ^ blk[i] ^ (sum * 3U);
		}
		if (round == 0) {
			ref = sum;
		} else if (sum != ref) {
			return false;
		}
	}
	return true;
}

/* In steps of 72 MHz, the memory is checked after each one; the voltage is not changed. */
static void cpu_clock_setup(void)
{
	const struct device *cctl = DEVICE_DT_GET(DT_NODELABEL(cctl));
	uint32_t rate, target = CONFIG_SAMPLE_POCKETJS_CPU_MHZ * 1000000U;

	clock_control_get_rate(cctl, (clock_control_subsys_t)CLK_CPU, &rate);
	while (target != 0U && rate < target) {
		uint32_t next = MIN(rate + 72000000U, target);

		if (clock_control_set_rate(cctl, (clock_control_subsys_t)CLK_CPU,
					   (clock_control_subsys_rate_t)next) != 0) {
			break;
		}
		if (!cpu_selftest()) {
			printk("[W] cpu: %u MHz BAD, back to %u MHz\n", next / 1000000U,
			       rate / 1000000U);
			clock_control_set_rate(cctl, (clock_control_subsys_t)CLK_CPU,
					       (clock_control_subsys_rate_t)rate);
			return;
		}
		rate = next;
	}
	printk("cpu: %u MHz\n", rate / 1000000U);
}

#ifdef CONFIG_SAMPLE_POCKETJS_PROFILE
void profile_start(struct k_thread *target);
#endif

static int check(esp_err_t err, const char *what)
{
	if (err != ESP_OK) {
		printk("[E] pocketjs_player: %s failed: 0x%x\n", what, err);
		return -1;
	}
	return 0;
}

#define CHECK(x) do { if (check((x), #x) != 0) { return 0; } } while (0)

int main(void)
{
	if (!device_is_ready(disp)) {
		printk("[E] pocketjs_player: display not ready\n");
		return 0;
	}
	cpu_clock_setup();
#ifdef CONFIG_SAMPLE_POCKETJS_PROFILE
	profile_start(k_current_get());
#endif

	pocketjs_package_t *package = NULL;
	pocketjs_package_variant_t app = {.struct_size = sizeof(app)};

	CHECK(pocketjs_package_open(PACKAGE.data, PACKAGE.size, 0, &package));
	CHECK(pocketjs_package_select(package, &CONTRACT, &app));

	pocketjs_guest_config_t guest_config;
	pocketjs_guest_t *guest = NULL;

	pocketjs_guest_config_defaults(&guest_config);
	CHECK(pocketjs_guest_create(&guest_config, &guest));
	/* QuickJS assumes 1 MiB of stack by default; the main thread has CONFIG_MAIN_STACK_SIZE,
	 * of which the interpreter may use JS_STACK_LIMIT before it throws a RangeError.
	 */
	JS_SetMaxStackSize(JS_GetRuntime(pocketjs_guest_quickjs_context(guest)), JS_STACK_LIMIT);

	pocketjs_ui_core_config_t core_config;
	pocketjs_ui_core_t *core = NULL;

	pocketjs_ui_core_config_defaults(&core_config);
	core_config.logical_width = CONTRACT.logical_width;
	core_config.logical_height = CONTRACT.logical_height;
	core_config.raster_density = CONTRACT.raster_density;
	core_config.tick_hz = CONTRACT.tick_hz;
	CHECK(pocketjs_ui_core_create(&core_config, &core));

	const pocketjs_ui_qjs_config_t binding_config = {
		.struct_size = sizeof(binding_config),
		.target_id = CONTRACT.target_id,
		.host_abi = CONTRACT.host_abi,
	};
	pocketjs_ui_qjs_t *binding = NULL;

	CHECK(pocketjs_ui_qjs_create(guest, core, &binding_config, &binding));
	CHECK(pocketjs_ui_qjs_feed_pak(binding, app.pak.data, app.pak.size));
	CHECK(pocketjs_ui_qjs_mount(binding));
	CHECK(pocketjs_guest_eval(guest, (const char *)app.javascript.data,
				  app.javascript.size - 1U, "player"));

	pocketjs_rgb565_renderer_config_t renderer_config;
	pocketjs_rgb565_renderer_t *renderer = NULL;
	pocketjs_rgb565_target_t *targets[NPIC] = {NULL};

	pocketjs_rgb565_renderer_config_defaults(&renderer_config);
	renderer_config.scale = CONTRACT.raster_density;
#ifdef CONFIG_POCKETJS_G2D
	pocketjs_g2d_t *g2d = pocketjs_g2d_create(NULL);
	const pocketjs_rgb565_accelerator_t *accel = pocketjs_g2d_accelerator(g2d);

	if (g2d != NULL) {
		renderer_config.min_fill_pixels = pocketjs_g2d_min_fill(g2d);
		renderer_config.min_blend_pixels = pocketjs_g2d_min_blend(g2d);
	} else {
		printk("[W] pocketjs_player: no G2D, software rendering\n");
	}
#else
	const pocketjs_rgb565_accelerator_t *accel = NULL;
#endif
	CHECK(pocketjs_rgb565_renderer_create(&renderer_config, &renderer));
	for (int i = 0; i < NPIC; i++) {
		CHECK(pocketjs_rgb565_target_create(&targets[i]));
	}

	/*
	 * The damaged strips are drawn straight into the next picture of the ring, which the video
	 * thread shows; every picture has its own render target, so each one is repainted by what
	 * changed since it was last drawn. A picture that is on the plane is never written.
	 */
	pic_w = CONTRACT.logical_width * CONTRACT.raster_density;
	pic_h = CONTRACT.logical_height * CONTRACT.raster_density;
	pic_stride = pic_w * 2;
	const size_t size = ROUND_UP(pic_stride * pic_h, 64);

	for (int i = 0; i < NPIC; i++) {
		pic[i] = aligned_alloc(64, size);
		if (pic[i] == NULL) {
			printk("[E] pocketjs_player: out of memory\n");
			return 0;
		}
		memset(pic[i], 0, size);
	}
	input_init(CONTRACT.logical_width, CONTRACT.logical_height);
	k_thread_create(&video_thread, video_stack, K_THREAD_STACK_SIZEOF(video_stack), video_main,
			NULL, NULL, NULL, 5, 0, K_NO_WAIT);
	k_thread_name_set(&video_thread, "video");

	const int64_t period_us = 1000000 / CONTRACT.tick_hz;
	int64_t next = k_ticks_to_us_floor64(k_uptime_ticks());
	unsigned int cur = 0, frames = 0, shown = 0;
	int64_t report = next;
	unsigned int ppa_ops = 0, last_touches = 0;
	unsigned int n_fill = 0, n_blend = 0, n_srm = 0, n_sw = 0, n_sw_words = 0;
	uint64_t n_pixels = 0;
	uint32_t last_buttons = 0;
	int64_t busy_sum = 0, busy_max = 0, t_turn = 0, t_render = 0, t_copy = 0;

	printk("pocketjs_player: %s %ux%u at %u Hz, guest %u KiB\n", CONTRACT.target_id,
	       (unsigned int)pic_w, (unsigned int)pic_h, (unsigned int)CONTRACT.tick_hz,
	       (unsigned int)(app.javascript.size / 1024));

	while (true) {
		const int64_t started = k_ticks_to_us_floor64(k_uptime_ticks());
		pocketjs_ui_frame_view_t frame = {.struct_size = sizeof(frame)};
		pocketjs_ui_input_t input = {.struct_size = sizeof(input)};
		pocketjs_ui_touch_t touches[INPUT_MAX_TOUCHES];
		pocketjs_rgb565_damage_plan_t plan = {.struct_size = sizeof(plan)};

		input_sample(&input, touches);
		if (input.buttons != last_buttons || input.touch_count != last_touches) {
			printk("input: buttons 0x%04x, %u finger(s)\n", input.buttons,
			       (unsigned int)input.touch_count);
			last_buttons = input.buttons;
			last_touches = input.touch_count;
		}
		CHECK(pocketjs_ui_turn(binding, &input, &frame));
		const int64_t t1 = k_ticks_to_us_floor64(k_uptime_ticks());

		const unsigned int nxt = (cur + 1) % NPIC;

		CHECK(pocketjs_rgb565_prepare(renderer, targets[nxt], &frame, &plan));
		frames++;

		if (plan.region_count != 0) {
			for (uint32_t i = 0; i < plan.region_count; i++) {
				const pocketjs_rgb565_rect_t region = plan.regions[i];
				pocketjs_rgb565_render_stats_t stats = {.struct_size = sizeof(stats)};

				/* a strip is full width: its rows lie in the picture as they are */
				CHECK(pocketjs_rgb565_render_strip(
					renderer, &frame,
					(uint16_t *)(pic[nxt] + (size_t)region.y * pic_stride),
					(size_t)pic_w * region.height, region, accel, &stats));
				ppa_ops += stats.ppa_fills + stats.ppa_blends;
				n_fill += stats.ppa_fills;
				n_blend += stats.ppa_blends;
				n_srm += stats.ppa_srm;
				n_sw += stats.software_ops;
				n_sw_words += stats.software_words;
				n_pixels += stats.damage_pixels;
			}
			CHECK(pocketjs_rgb565_commit(renderer, targets[nxt], &frame));

			const int64_t t2 = k_ticks_to_us_floor64(k_uptime_ticks());

			t_render += t2 - t1;
			for (uint32_t i = 0; i < plan.region_count; i++) {
				const pocketjs_rgb565_rect_t region = plan.regions[i];

				sys_cache_data_flush_range(pic[nxt] + (size_t)region.y * pic_stride,
							   (size_t)region.height * pic_stride);
			}
			cur = nxt;
			atomic_set(&ready_idx, cur);
			k_sem_give(&frame_sem);
			t_copy += k_ticks_to_us_floor64(k_uptime_ticks()) - t2;
			shown++;
		}

		next += period_us;
		const int64_t now = k_ticks_to_us_floor64(k_uptime_ticks());

		t_turn += t1 - started;
		busy_sum += now - started;
		busy_max = MAX(busy_max, now - started);
		if (next > now) {
			k_usleep(next - now);
		} else if (now - next > 4 * period_us) {
			next = now;
		}
		if (now - report >= 5000000) {
			printk("pocketjs_player: %u ticks, %u pictures in 5 s, busy %u us avg %u max "
			       "(turn %u, render %u, flush %u) g2d %u\n",
			       frames, shown, (unsigned int)(busy_sum / MAX(frames, 1U)),
			       (unsigned int)busy_max, (unsigned int)(t_turn / MAX(frames, 1U)),
			       (unsigned int)(t_render / MAX(shown, 1U)),
			       (unsigned int)(t_copy / MAX(shown, 1U)), ppa_ops);
			printk("pocketjs_player: ops fill %u blend %u srm %u software %u (%u words), "
			       "damage %u kpx per picture\n",
			       n_fill, n_blend, n_srm, n_sw, n_sw_words,
			       (unsigned int)(n_pixels / MAX(shown, 1U) / 1000U));
#ifdef CONFIG_POCKETJS_TURN_STATS
			const struct pocketjs_turn_stats ts = pocketjs_turn_stats_take();

			printk("pocketjs_player: turn script %u us, tick %u us, draw %u us, "
			       "script %u kcycles %u kinstr (ipc %u/100)\n",
			       (unsigned int)(ts.script_us / MAX(ts.turns, 1U)),
			       (unsigned int)(ts.tick_us / MAX(ts.turns, 1U)),
			       (unsigned int)(ts.draw_us / MAX(ts.turns, 1U)),
			       (unsigned int)(ts.script_cycles / MAX(ts.turns, 1U) / 1000U),
			       (unsigned int)(ts.script_instrs / MAX(ts.turns, 1U) / 1000U),
			       (unsigned int)(ts.script_instrs * 100U / MAX(ts.script_cycles, 1U)));
#endif
			n_fill = n_blend = n_srm = n_sw = n_sw_words = 0;
			n_pixels = 0;
			ppa_ops = 0;
			frames = shown = 0;
			busy_sum = busy_max = t_turn = t_render = t_copy = 0;
			report = now;
		}
	}
	return 0;
}
```

## src/input.c
```c
/*
 * Copyright (c) 2026 Yuzuki Tsuru
 * SPDX-License-Identifier: Apache-2.0
 */

/*
 * Input of the player:
 *  - the touch panel (chosen zephyr,touch): fingers, one per slot of the controller
 *  - gestures on the first finger as buttons, for the apps that are made for a d-pad
 *  - the keys of the console UART as buttons (the terminal sends no release, a key
 *    holds its button for a moment)
 */

#include <zephyr/device.h>
#include <zephyr/drivers/display.h>
#include <zephyr/drivers/uart.h>
#include <zephyr/input/input.h>
#include <zephyr/kernel.h>
#include <zephyr/spinlock.h>

#include "input.h"

#define HAS_TOUCH DT_NODE_EXISTS(DT_CHOSEN(zephyr_touch))

#define PULSE_MS	110
#define SWIPE_STEP	36	/* screen pixels of movement per direction pulse */
#define TAP_MAX_MS	450
#define TAP_MAX_MOVE	20

static const struct device *const disp = DEVICE_DT_GET(DT_CHOSEN(zephyr_display));
static unsigned int logical_w, logical_h;
static int screen_w, screen_h;

static struct k_spinlock lock;
static uint32_t pulse_until[16];

static void pulse(uint32_t bits)
{
	uint32_t until = k_uptime_get_32() + PULSE_MS;

	for (int i = 0; i < 16; i++) {
		if (bits & BIT(i)) {
			pulse_until[i] = until;
		}
	}
}

static uint32_t pulsed(void)
{
	uint32_t now = k_uptime_get_32(), bits = 0;

	for (int i = 0; i < 16; i++) {
		if (pulse_until[i] != 0U && (int32_t)(pulse_until[i] - now) > 0) {
			bits |= BIT(i);
		}
	}
	return bits;
}

#if HAS_TOUCH
static struct {
	int x, y;
	bool down;
} fingers[INPUT_MAX_TOUCHES];
static int cur_slot;

static void touch_event(struct input_event *evt, void *user_data)
{
	k_spinlock_key_t key = k_spin_lock(&lock);

	switch (evt->code) {
	case INPUT_ABS_MT_SLOT:
		cur_slot = CLAMP(evt->value, 0, INPUT_MAX_TOUCHES - 1);
		break;
	case INPUT_ABS_X:
		fingers[cur_slot].x = evt->value;
		break;
	case INPUT_ABS_Y:
		fingers[cur_slot].y = evt->value;
		break;
	case INPUT_BTN_TOUCH:
		fingers[cur_slot].down = evt->value != 0;
		break;
	}
	k_spin_unlock(&lock, key);
}
INPUT_CALLBACK_DEFINE(DEVICE_DT_GET(DT_CHOSEN(zephyr_touch)), touch_event, NULL);
#endif /* HAS_TOUCH */

/* ---- console keys ------------------------------------------------------------- */

static uint32_t key_buttons(int c)
{
	switch (c) {
	case 'w': case 'W': return BTN_UP;
	case 's': case 'S': return BTN_DOWN;
	case 'a': case 'A': return BTN_LEFT;
	case 'd': case 'D': return BTN_RIGHT;
	case 'j': case 'J': case ' ': return BTN_CROSS;
	case 'k': case 'K': return BTN_CIRCLE;
	case 'u': case 'U': return BTN_SQUARE;
	case 'i': case 'I': return BTN_TRIANGLE;
	case 'q': case 'Q': return BTN_LTRIGGER;
	case 'e': case 'E': return BTN_RTRIGGER;
	case '\r': case '\n': return BTN_START;
	case '\t': case 'b': return BTN_SELECT;
	default: return 0;
	}
}

#define UART_NODE DT_CHOSEN(zephyr_console)

K_THREAD_STACK_DEFINE(uart_stack, 1024);
static struct k_thread uart_thread;

/* above the main thread (6): a scene that keeps the main thread busy must not starve the keys */
static void uart_main(void *a, void *b, void *c)
{
	const struct device *uart = DEVICE_DT_GET(UART_NODE);
	unsigned char ch;

	while (true) {
		if (uart_poll_in(uart, &ch) == 0) {
			uint32_t bits = key_buttons(ch);

			if (bits != 0U) {
				k_spinlock_key_t key = k_spin_lock(&lock);

				pulse(bits);
				k_spin_unlock(&lock, key);
			}
		} else {
			k_msleep(5);
		}
	}
}

void input_init(unsigned int w, unsigned int h)
{
	struct display_capabilities caps;

	logical_w = w;
	logical_h = h;
	display_get_capabilities(disp, &caps);
	screen_w = caps.x_resolution;
	screen_h = caps.y_resolution;
	if (device_is_ready(DEVICE_DT_GET(UART_NODE))) {
		k_thread_create(&uart_thread, uart_stack, K_THREAD_STACK_SIZEOF(uart_stack),
				uart_main, NULL, NULL, NULL, 5, 0, K_NO_WAIT);
		k_thread_name_set(&uart_thread, "keys");
	}
}

/* screen pixel -> logical pixel of the centred, aspect kept picture; false outside it */
static bool to_logical(int sx, int sy, int *lx, int *ly)
{
	/* the picture is a whole multiple of its size when it fits (pixel perfect), else it is
	 * scaled by the smaller factor, in 1/256 steps */
	int64_t sc = MIN((int64_t)screen_w * 256 / logical_w, (int64_t)screen_h * 256 / logical_h);

	if (sc >= 256) {
		sc = sc / 256 * 256;
	}
	int pw = logical_w * sc / 256, ph = logical_h * sc / 256;
	int ox = (screen_w - pw) / 2, oy = (screen_h - ph) / 2;

	if (sc == 0 || sx < ox || sy < oy || sx >= ox + pw || sy >= oy + ph) {
		return false;
	}
	*lx = CLAMP((int)((int64_t)(sx - ox) * 256 / sc), 0, (int)logical_w - 1);
	*ly = CLAMP((int)((int64_t)(sy - oy) * 256 / sc), 0, (int)logical_h - 1);
	return true;
}

#if HAS_TOUCH
/* swipes and taps of the first finger as buttons; called with the lock held */
static void gesture(bool down, int x, int y)
{
	static bool tracking, moved;
	static int ox, oy, sx, sy;
	static uint32_t t0;
	uint32_t now = k_uptime_get_32();

	if (down) {
		if (!tracking) {
			tracking = true;
			moved = false;
			ox = sx = x;
			oy = sy = y;
			t0 = now;
			return;
		}
		int dx = x - ox, dy = y - oy;

		if (MAX(abs(dx), abs(dy)) >= SWIPE_STEP) {
			if (abs(dx) >= abs(dy)) {
				pulse(dx > 0 ? BTN_RIGHT : BTN_LEFT);
			} else {
				pulse(dy > 0 ? BTN_DOWN : BTN_UP);
			}
			moved = true;
			ox = x;
			oy = y;
		}
	} else if (tracking) {
		tracking = false;
		if (!moved && now - t0 < TAP_MAX_MS &&
		    MAX(abs(x - sx), abs(y - sy)) <= TAP_MAX_MOVE) {
			pulse(BTN_CROSS);
		}
	}
}
#endif

void input_sample(pocketjs_ui_input_t *input, pocketjs_ui_touch_t *touches)
{
	size_t n = 0;
	uint32_t buttons;
	k_spinlock_key_t key = k_spin_lock(&lock);

#if HAS_TOUCH
	static int last_x, last_y;

	for (int f = 0; f < INPUT_MAX_TOUCHES; f++) {
		int lx, ly;

		if (fingers[f].down && to_logical(fingers[f].x, fingers[f].y, &lx, &ly)) {
			touches[n++] = (pocketjs_ui_touch_t){.id = f, .x = lx, .y = ly};
		}
	}
	if (fingers[0].down) {
		last_x = fingers[0].x;
		last_y = fingers[0].y;
	}
	gesture(fingers[0].down, last_x, last_y);
#endif
	buttons = pulsed();
	k_spin_unlock(&lock, key);

	input->buttons = buttons;
	input->touches = touches;
	input->touch_count = n;
}
```

## src/input.h
```c
/* SPDX-License-Identifier: Apache-2.0 */
#pragma once

#include "pocketjs/ui_qjs.h"

/* PSP button bits of the PocketJS frame contract */
#define BTN_SELECT	0x0001
#define BTN_START	0x0008
#define BTN_UP		0x0010
#define BTN_RIGHT	0x0020
#define BTN_DOWN	0x0040
#define BTN_LEFT	0x0080
#define BTN_LTRIGGER	0x0100
#define BTN_RTRIGGER	0x0200
#define BTN_TRIANGLE	0x1000
#define BTN_CIRCLE	0x2000
#define BTN_CROSS	0x4000
#define BTN_SQUARE	0x8000

#define INPUT_MAX_TOUCHES 5

/*
 * Starts the readers of the touch panel and of the console. The picture of
 * logical_w x logical_h is shown centred on the screen with its aspect kept.
 */
void input_init(unsigned int logical_w, unsigned int logical_h);

/*
 * The state for this tick: the fingers in logical coordinates, and the buttons of the
 * console keys plus the ones the touch gestures stand for (a swipe is a direction,
 * a tap is CROSS). touches[] must hold INPUT_MAX_TOUCHES entries.
 */
void input_sample(pocketjs_ui_input_t *input, pocketjs_ui_touch_t *touches);
```

## src/profile.c
```c
/*
 * Copyright (c) 2026 Yuzuki Tsuru
 * SPDX-License-Identifier: Apache-2.0
 */

/*
 * A poor man's profiler: a thread that preempts the emulation every
 * millisecond reads the program counter the emulation thread was interrupted
 * at, and after a while prints the busiest 64 byte blocks of code.
 */

#include <stdlib.h>
#include <zephyr/arch/exception.h>
#include <zephyr/kernel.h>
#include <zephyr/sys/printk.h>

#define MAX_SAMPLES	2500
#define CODE_LO		0x40000000UL
#define CODE_HI		0x40200000UL

K_THREAD_STACK_DEFINE(prof_stack, 2048);
static struct k_thread prof_thread;
static uint32_t pcs[MAX_SAMPLES];
static uint32_t ras[MAX_SAMPLES];

extern volatile int pocketjs_scene_tag;

static int cmp(const void *a, const void *b)
{
	uint32_t x = *(const uint32_t *)a, y = *(const uint32_t *)b;

	return x < y ? -1 : (x > y);
}

/* Collect MAX_SAMPLES program counters, then print the busiest blocks */
static void sample_window(struct k_thread *t, int tag)
{
	int n = 0, bad = 0;

	while (n < MAX_SAMPLES) {
		const struct arch_esf *esf = (const struct arch_esf *)t->callee_saved.sp;
		unsigned long pc = esf->mepc;

		if (pc >= CODE_LO && pc < CODE_HI) {
			ras[n] = esf->ra & ~63UL;
			pcs[n++] = pc & ~63UL;
		} else {
			bad++;
		}
		k_msleep(1);
	}
	/* callers: the return address register of the samples, as a second histogram */
	qsort(ras, n, sizeof(ras[0]), cmp);
	printk("callers: scene %d\n", tag);
	for (int top = 0; top < 12; top++) {
		int best = -1, best_cnt = 0;

		for (int i = 0; i < n;) {
			int j = i;

			while (j < n && ras[j] == ras[i]) {
				j++;
			}
			if (ras[i] != 0 && j - i > best_cnt) {
				best_cnt = j - i;
				best = i;
			}
			i = j;
		}
		if (best < 0) {
			break;
		}
		uint32_t v = ras[best];

		printk("ra %08x %d\n", v, best_cnt);
		for (int i = best; i < n && ras[i] == v; i++) {
			ras[i] = 0;
		}
	}
	qsort(pcs, n, sizeof(pcs[0]), cmp);
	printk("profile: scene %d: %d samples, %d unusable (thread blocked)\n", tag, n, bad);
	for (int top = 0; top < 24; top++) {
		int best = -1, best_cnt = 0;

		for (int i = 0; i < n;) {
			int j = i;

			while (j < n && pcs[j] == pcs[i]) {
				j++;
			}
			if (pcs[i] != 0 && j - i > best_cnt) {
				best_cnt = j - i;
				best = i;
			}
			i = j;
		}
		if (best < 0) {
			break;
		}
		uint32_t v = pcs[best];

		printk("prof %08x %d\n", v, best_cnt);
		for (int i = best; i < n && pcs[i] == v; i++) {
			pcs[i] = 0;
		}
	}
}

static void prof_main(void *target, void *b, void *c)
{
	k_sleep(K_SECONDS(4));
	while (true) {
		/* one window per scene change, taken a little after the change */
		const int tag = pocketjs_scene_tag;

		k_sleep(K_SECONDS(2));
		sample_window(target, tag);
		while (pocketjs_scene_tag == tag) {
			k_sleep(K_MSEC(200));
		}
	}
}

void profile_start(struct k_thread *target)
{
	k_thread_create(&prof_thread, prof_stack, K_THREAD_STACK_SIZEOF(prof_stack), prof_main,
			target, NULL, NULL, 1, 0, K_NO_WAIT);
}
```
